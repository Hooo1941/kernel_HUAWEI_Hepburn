## kernel/platform_source/cee/drivers/lpcpu_pmu/Kconfig
```kconfig
config LP_ARM_PMU_PER_CPU_EVENT_HOOK
	bool "arm pmu per cpu envents"
	depends on CEE_CPU_HCK
	default n
	help
	  Enable arm pmu per cpu envents hook
```

## kernel/platform_source/cee/drivers/lpcpu_timer/Kconfig
```kconfig
config LPCPU_HITIMER
    bool "Support for HITIMER"
    default n
    depends on ARM_TIMER_SP804
    help
      This option enables HITIMER instead of Hrtimer SP804
```

## kernel/platform_source/cee/drivers/mips_mem/Kconfig
```kconfig
config MIPS_MEM_FREQ
        bool "mips memfreq governor"
        depends on MIPS_LOAD_TRACKING
        help
          Note that use mips informance to change mem freq
```

## kernel/platform_source/cee/drivers/mpam/Kconfig
```kconfig
menu "MPAM"
config MPAM
	depends on ARM64
	tristate "CPU MPAM ARMv8"
	help
	  MPAM Support for ARMv8.
	  For debugging issues having to do with stability and overall system
	  health, you should probably say 'Y' here.

config MPAM_DEBUG
	depends on MPAM
	bool "MPAM debug"
	default n
	help
	  Say y if you want to use MPAM debug function.
endmenu
```

## kernel/platform_source/cee/drivers/perf_stat/Kconfig
```kconfig
config DFX_PERF_STAT
	bool "perf_stat driver 32bit driver"
	default n
	help
	perf_stat driver support
config DFX_PERF_STAT64
	bool "perf_stat driver 64bit driver"
	default n
	help
	perf_stat 64 bit driver support
config DFX_PERF_STAT_DUAL
	bool "perf_stat dual controller driver"
	default n
	help
	perf_stat dual controller driver support
config DFX_PERF_STAT_LAT_MON
	bool "perf_stat latency monitor"
	default n
	help
	perf_stat latency monitor support
```

## kernel/platform_source/cee/drivers/pm/Kconfig
```kconfig
menu "S/R Configuration Options"

config SR
	bool "SR adaptation"
	depends on SUSPEND
	default n
	help
	   Support suspend and resume
if SR
	source "platform_source/cee/drivers/pm/main/Kconfig"
endif

config SR_DEBUG
	bool "SR debug"
	depends on SR
	default n
	help
	   debug for SR

config SR_MNTN
	bool "SR maintenance"
	depends on SR
	default n
	help
	   Support maintenance for SR

if SR_MNTN
	source "platform_source/cee/drivers/pm/mntn/Kconfig"
endif

endmenu
```

## kernel/platform_source/cee/drivers/pm/main/Kconfig
```kconfig
menu "S/R options for main function"

config SR_SYNC
	bool "The optimizes file synchronization in the SR process"
	depends on SR
	default n
	help
	  Optimizes file synchronization in the SR process

config PM_LPCTRL
	bool "ap kernel can control functions of sr in lpm3"
	depends on SR
	default n
	help
	  The ap kernel controls the sr function of lpm3

config SR_SWITCH_32K
	bool "Switch 32K clock source when the system is suspend or resume for more power saving"
	depends on PM_LPCTRL
	default n
	help
	  Switch 32K clock source

config SYS_PM_ULSR
	bool "ultra lowpower system suspend"
	depends on SR
	default n
	help
	  Ultra lowpower system suspend
config SYS_PM_DOZE
	bool "Support doze state"
	depends on SR
	default n
	help
	  Support doze state
config SYS_PM_DOZE_INDEPEND_VOTE
	bool "Support doze state"
	depends on SYS_PM_DOZE
	default n
	help
	  Support doze state independ control
config FORCE_SUSPEND
	bool "Force suspend"
	depends on SR
	default n
	help
	  Force suspend, ignor pm wakeup pending
config HM_SR_PHONE
	bool "Support HM SR for phone products only, but not for cdc"
	depends on SR
	default n
	help
	  Support HM SR for phone products only, but not for cdc

config SR_HIBERNATION_WATCHDOG
	bool "S4 suspend watchdog timeout adjust"
	default n
	help
	  Hibernation watchdog timeout
config S4_RESERVE_BIGCORE
	bool "Reserve big core as the primary cpu when hibernate"
	default n
	help
	   Reserve big core as the primary cpu when hibernate
endmenu
```

## kernel/platform_source/cee/drivers/qos/Kconfig
```kconfig
menu "platform qos Options"
config PLATFORM_QOS
	bool "platform qos enable"
	default n
	help
	  platform qos enable.

config NETWORK_LATENCY_PLATFORM_QOS
	bool "Network latency switch for Platform QoS"
	default n
	help
	  Enable /dev/network_latency platform qos file to configure network
	  latency by demand.

config FREQ_PLATFORM_QOS_DEBUG
	bool "show freq platform qos vote owner"
	default n
	help
	  Make a debug sysfs to show freq platform qos vote owner.

endmenu
```

## kernel/platform_source/cee/drivers/rtm/Kconfig
```kconfig
config RTM_DEBUG
	depends on ARM64 && DFX_DEBUG_FS
	bool "rtm"
	default n
	help
		Say y if you want to use rtm feature.
```

## kernel/platform_source/cee/drivers/thermal_platform/hw_dpm/Kconfig
```kconfig
config DPM_HWMON
	bool "dpm hwmon driver config"
	default n
	help
	  Driver for kernel dpm
config DPM_HWMON_V1
	bool "dpm hwmon first version config"
	depends on DPM_HWMON
	default n
	help
	  First version for kernel dpm
config DPM_HWMON_V2
	bool "dpm hwmon second version config"
	depends on DPM_HWMON
	default n
	help
	  Second version for kernel dpm
config DPM_HWMON_PERIPCR
	bool "dpm hwmon peri pcr config"
	depends on DPM_HWMON_V2
	default n
	help
	  Peri pcr for kernel dpm v2
config DPM_HWMON_V3
	bool "dpm hwmon third version config"
	depends on DPM_HWMON
	default n
	help
	  Third version for kernel dpm
config DPM_HWMON_PWRSTAT
	bool "dpm hwmon powerstat config"
	depends on DPM_HWMON_V3
	default n
	help
	  Powerstat for kernel dpm v3
config DPM_HWMON_DEBUG
	bool "dpm hwmon driver for fitting debug"
	depends on DPM_HWMON
	default n
	help
	  Driver for kernel dpm debug
config MODEM_DPM
	bool "modem dpm hwmon config"
	depends on DPM_HWMON
	default n
	help
	  Driver for modem dpm
config CPU_DPM
	bool "cpu dpm config"
	depends on DPM_HWMON_V3
	default n
	help
	  Driver for cpu dpm
config DPM_DUBAI_STUB
	bool "dpm dubai stub config"
	depends on CPU_DPM
	default n
	help
	  Driver for dpm dubai api stub
```

## kernel/platform_source/cee/kernel/sched/ffrt/Kconfig
```kconfig
# SPDX-License-Identifier: GPL-2.0-only

config FFRT_RTG
	bool "FFRT rtg control"
	depends on SCHED_RTG
	default n
	help
	  FFRT RTG Control. If you say Y here, /proc/<pid>/ffrt
	  file will be created. Functions of RTG can be realized
	  from userspace by using ioctl.

config SCHED_COMMON_QOS_CTRL
	bool "Common qos ctrl for task"
	default n
	help
	  If set, a proc fs will generated for per task qos control. The truly
	  implementations should be registered by specific module

config QOS_CTRL
	bool "Multiple Level Qos Control for thread"
	default n
	help
	  If set, thread can apply qos for less execution latency and get more
	  cpu supply.

config QOS_POLICY_MAX_NR
	int "Number of supported qos policy"
	range 5 20
	default 5
	depends on QOS_CTRL
	help
	  Qos policy number limit. Truly initialized qos policy could small then
	  this value.

config FFTS_SCHED
	bool "Hardware FFTS Sched Control"
	default n
	help
	  y means FFRT need work with FFTS
```

## kernel/platform_source/cee/kernel/sched/smt/Kconfig
```kconfig
config SMT_MODE_GOV
	bool "smt mode switch governor"
	default n
	depends on SCHED_SMT

config SMT_ENABLE_CORE_SCHED
	bool "smt core use core scheduling default"
	default n
	depends on SCHED_SMT && SCHED_CORE

config SCHED_SMT_EXPELLING
	bool "SMT expelling support"
	default n
	depends on SCHED_SMT && SCHED_CORE
	help
	  Expell the expellee task. If unsure say N here.

config SCHED_CORE_PREFER
	bool "Tasks prefer to co-run on SMT core"
	default n
	depends on SCHED_SMT && SCHED_CORE
	help
	  Scheduler support tasks prefer to co-run on SMT core.

config SCHED_CORE_LAZY_FORCEIDLE
	bool "Forceidle reduce"
	default n
	depends on SCHED_SMT && SCHED_CORE
	help
	  Reduce forceidle trigger times due to smt expel and cookie not match.

config SCHED_SMT_USER_HIDE
	bool "hide SMT to user"
	default n
	depends on SCHED_SMT
	help
	  Make apps don't aware SMT feature.
```

## kernel/platform_source/display/drivers/Kconfig
```kconfig
menu "driver Configuration"

source "platform_source/display/drivers/drmdriver/Kconfig"
source "platform_source/display/drivers/jpu/Kconfig"
source "platform_source/display/drivers/dpu_drm/Kconfig"

endmenu
```

## kernel/platform_source/display/drivers/dpu_drm/Kconfig
```kconfig
config DPU_DRM
	tristate "DRM Support for Hisi DPU SoC Platform"
	depends on DRM && OF && ARM64 && DPU_COMPOSER
	select DRM_KMS_HELPER
	select DRM_GEM_CMA_HELPER
	select DRM_KMS_CMA_HELPER
	select DRM_MIPI_DSI
	select DRM_PANEL
	help
	  Choose this option if you have a hisi dpu chipsets.
	  If M is selected the module will be called dpu_drm.

config DPU_COMPOSER
	tristate "Dpu composer driver support"
	depends on DRM && OF && ARM64 && DPU_OPR_MGR
	select DRM_KMS_HELPER
	select DRM_GEM_CMA_HELPER
	select DRM_KMS_CMA_HELPER
	select DRM_MIPI_DSI
	select DRM_PANEL
	help
	  This feature driver supports dpu composer device driver.

config DPU_MIPI_DSI
	tristate "Hisi DPU MIPI-DSI Controller Support"
	select DRM_MIPI_DSI
	help
	  Choose this option if you want have an Hisi Dpu SoC with
	  MIPI-DSI support. If M is selected the module will be called
	  dpu_mipi_dsi.

config DPU_PANEL
	tristate "DPU panel support"
	depends on OF
	depends on DRM_MIPI_DSI
	depends on BACKLIGHT_CLASS_DEVICE
	help
	  Say Y here if you want to enable support for TFT-LCD modules.

config DPU_OPR_MGR
	tristate "Hisi Dpu operator manager support"
	help
	  Say Y here if you want to enable support for Hisi Dpu operator manager.

config DPU_CMDLIST
	tristate "Hisi Dpu cmdlist support"
	help
	  Say Y here if you want to enable support for Hisi Dpu cmdlist.

config DPU_DEBUG_ENABLE
	tristate "DPU debug info"
	default y if DPU_MIPI_DSI
	help
	  Say y here if you want show debug info

config DPU_DRM_GEM
	tristate "Hisi DPU drm support GEM memory manager"
	depends on DPU_DRM
	help
	  It is mainly responsible for displaying the allocation and release of buffer,
	  and it is also the only place where GPU uses DRM, directly dealing with physical buffer,
	  linking fb and physical buffer

config DRM_DSS_IOMMU
	tristate "Enable dss iommu"
	default n
	help
	  Choose this option if you have a need dss iommu support.

config DPU_FFA_SUPPORT
	tristate "Hisi Dpu support ffa"
	depends on PLATDRV_SUPPORT_FFA
	default n
	help
	  Hisi Dpu support ffa or not.

source "platform_source/display/drivers/dpu_drm/heap/Kconfig"
```

## kernel/platform_source/display/drivers/drmdriver/Kconfig
```kconfig
config DRMDRIVER
    tristate "dpu drm module driver"
    default n
    help
      Provides a secure configuration between kernel and BL31,
	  and drm module driver

config DPU_FFA_SUPPORT
    bool "dpu choose ffa support"
    depends on ARM_FFA_TRANSPORT
    default n
    help
      Say yes here to support ffa.

config DKMD_HIMATRIX_STUB
    bool "DKMD_HIMATRIX_STUB"
    default n
    help
      Say yes here to support himatrix stub.
```

## kernel/platform_source/display/drivers/video/dkmd/connector/Kconfig
```kconfig
config DKMD_DPU_CONNECTOR
	bool "Enable connector support in dpu driver"
	default n
	depends on DKMD_DKSM
	select DKMD_DPU_MIPI_DSI
	help
	  Choose this option if need connector support.

config DKMD_DPU_MIPI_DSI
	bool "Enable DSI support in dpu driver"
	default n
	depends on DKMD_DPU_COMPOSER
	help
	  Choose this option if need mipi dsi driver support.

config DKMD_DPU_PANEL
	bool "Enable panel support in dpu driver"
	default n
	depends on DKMD_DPU_MIPI_DSI
	help
	  Choose this option if need panel driver support.

config DKMD_DPU_DP
	bool "Enable dp tx support in dpu driver"
	default n
	depends on DKMD_DPU_COMPOSER
	help
	  Choose this option if need dp tx driver support.

config DKMD_DPU_DP_RX
	bool "Enable dp rx support in dpu driver"
	default n
	depends on DKMD_DPU_COMPOSER
	help
	  Choose this option if need dp rxdriver support.

config DKMD_DPU_HDMI_TX
	bool "Enable hdmi tx support in dpu driver"
	default n
	depends on DKMD_DPU_COMPOSER
	help
	  Choose this option if need hdmi tx driver support.

config DKMD_DPU_HDMI_RX
	bool "Enable hdmi rx support in dpu driver"
	default n
	depends on DKMD_DPU_COMPOSER
	help
	  Choose this option if need hdmi rx driver support.

config DKMD_DPU_OFFLINE
	bool "Enable offline device support in dpu driver"
	default n
	depends on DKMD_DPU_COMPOSER
	help
	  Choose this option if need offline driver support.
```

## kernel/platform_source/ffrt/Kconfig
```kconfig
menu "FFRT Kernel Configuration"

-source "platform_source/ffrt/ffts/Kconfig"
-source "platform_source/ffrt/hts/Kconfig"
-source "platform_source/ffrt/uniform_id/Kconfig"

endmenu
```

## kernel/platform_source/ffrt/hts/Kconfig
```kconfig
config FFRT_HTS
	tristate "FFRT_HTS"
	default n
	help
	Say m here to support hts kernel driver ko.
```

## kernel/platform_source/hisecally/fuzz/Kconfig
```kconfig
menu "fuzz Kernel Configuration"

source "platform_source/hisecally/fuzz/atf_fuzz/Kconfig"

source "platform_source/hisecally/fuzz/rda_fuzz/Kconfig"

endmenu
```

## kernel/platform_source/hisecally/fuzz/rda_fuzz/Kconfig
```kconfig
config RDA_SANITIZER
        tristate "Config for RDA SANITIZER"
	help
        enable te support for RDA SANITIZER
```

## kernel/platform_source/isp/drivers/isp/Kconfig
```kconfig
config ISP
    tristate "Histar ISP device"
    depends on REMOTEPROC
    depends on ARCH_HISI
    depends on RPMSG

config HISP_RPMSG
    tristate "HISP RPMSG bus driver"
    select RPMSG
    select VIRTIO

config HISP_DEBUG
	bool "hisp debug"
	default n
	help
		Say yes here to support hisp debug.

config HISP_DPM
	tristate "HISP DPM(digital power monitor) support"
	depends on DPM_HWMON
	default n
	help
		This framebuffer driver supports dpm function.

config HISP_EXCLUDE_NOC_DEBUG
	bool "hisp exclude noc modid debug"
	default n
	help
		Say yes here to not support hisp noc modid debug.

config HISP_FFA_SUPPORT
	bool "hisp choose ffa support"
	depends on FFA_SUPPORT
	default n
	help
		Say yes here to support ffa.

config HISP_MEMECC_SUPPORT
	bool "hisp choose memecc dmd support"
	default n
	help
		Say yes here to support memecc dmd report.

config HISP_LOAD_SECISPIMAGE
	bool "hisp load secispimage support"
	default n
	help
		Say yes here to load secispimge by ap not uefi.

config ISP_BUF_PRIVATIZE
	bool "hisp buffer privatize"
	default n
	help
		Say yes here to support hisp buffer privatize.

config HISP_FUZZ_ENOPEN
	bool "hisp fuzz enable rpm open"
	depends on HISP_DEBUG
	default n
	help
		Say yes here to support hisp debug node open when fuzz.

config HISP_KERNEL_FUZZ
	bool "hisp kernel fuzz"
	depends on HISP_DEBUG
	depends on KCOV
	depends on HISP_FUZZ_ENOPEN
	default y
	help
		Say yes here to support hisp debug node open when fuzz.
menuconfig HISP_FUZZ
	bool "Histar ISP device Fuzz"
	depends on ISP
	depends on HISP_DEBUG
	default n
	help
		Say yes here to support hisp fuzz test.
	if HISP_FUZZ
		config HISP_KCOV_ENABLE_DUMP
			bool "Histar ISP device Fuzz dump kcov mem to file"
			default y
	endif
config ISP_INTERNAL_MSG
	bool "hisp internal rpmsg"
	depends on KERNEL_CAMERA_ISPV500
	default y
	help
		Say yes here to support hisp internal rpmsg.
```

## kernel/platform_source/isp/drivers/isp/v500/Kconfig
```kconfig
comment "MODULE ISP"

choice
	prompt "HISP Version"
	default HISP_USE_V500
	depends on ISP_BUF_PRIVATIZE
	help
        Select ISP version.

config HISP_USE_V500
	bool "V500"
	depends on ISP_BUF_PRIVATIZE

endchoice
```
