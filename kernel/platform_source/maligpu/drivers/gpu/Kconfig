## kernel/platform_source/maligpu/drivers/gpu/Kconfig
```kconfig
source "platform_source/maligpu/drivers/gpu/gmc/Kconfig"

source "platform_source/maligpu/drivers/gpu/arm/Kconfig"
```

## kernel/platform_source/see/drivers/Kconfig
```kconfig
menu "driver Configuration"

source "platform_source/see/drivers/bl2_log/Kconfig"
source "platform_source/see/drivers/bl31_hibernate/Kconfig"
source "platform_source/see/drivers/bl31_log/Kconfig"
source "platform_source/see/drivers/cpusec_test/Kconfig"
source "platform_source/see/drivers/crypto_core/Kconfig"
source "platform_source/see/drivers/seplat/Kconfig"
source "platform_source/see/drivers/crypto_enhance/Kconfig"
source "platform_source/see/drivers/efuse/Kconfig"
source "platform_source/see/drivers/general_see/Kconfig"
source "platform_source/see/drivers/harden/Kconfig"
source "platform_source/see/drivers/thee/Kconfig"
source "platform_source/see/drivers/kernel_harden_test/Kconfig"
source "platform_source/see/drivers/load_image/Kconfig"
source "platform_source/see/drivers/dev_secinfo/Kconfig"
source "platform_source/see/drivers/hhee/Kconfig"
source "platform_source/see/drivers/prmem/Kconfig"
source "platform_source/see/drivers/uapp/Kconfig"
source "platform_source/see/drivers/cust_atf_shmem/Kconfig"
source "platform_source/see/drivers/secboot/Kconfig"
source "platform_source/see/drivers/sharevpu_sec_irq/Kconfig"
source "platform_source/see/drivers/pac_stub/Kconfig"
source "platform_source/see/drivers/ffa/Kconfig"
source "platform_source/see/drivers/ffa_rpmbmspc/Kconfig"
source "platform_source/see/drivers/hicrypto/Kconfig"
source "platform_source/see/drivers/vbmeta/Kconfig"

endmenu
```

## kernel/platform_source/see/drivers/cpusec_test/Kconfig
```kconfig
config EL3_PA_TEST
	bool "El3 PA Restriction feature test support"
	depends on HAVE_ARM_SMCCC
	default n
	help
          El3 PA Restriction test function

config BTI_TEST
	bool "bti test support"
	depends on HAVE_ARM_SMCCC
	default n
	help
          bti test function

config PAC_TEST
	bool "pac test "
	depends on HAVE_ARM_SMCCC
	default n
	help
	  pac test function

config FAC_TEST
	bool "fac test "
	depends on HAVE_ARM_SMCCC
	default n
	help
	  fac test function
```

## kernel/platform_source/see/drivers/crypto_core/Kconfig
```kconfig
config CRYPTO_CORE
	bool "crypto core "
	default n
	help
	  crypto core driver

config CRYPTO_CORE_MNTN_RESET_IRQ_SEPARATE
        depends on CRYPTO_CORE
        bool "crypto_core reset use separate interrupts."
        default n
        help
          whether crypto_core reset support separate interrupts feature

config CRYPTO_CORE_SUPPORT_DCS
        depends on CRYPTO_CORE
	bool "Support for Dynamic Binaries upgrade"
        default n
        help
	  whether to support dynamic binaries upgrade in crypto_core

config CRYPTO_CORE_DISABLE_KEY
	depends on CRYPTO_CORE
	bool "crypto_core disable open and close key."
	default n
	help
	  whether crypto_core support disable open and close key

config CRYPTO_CORE_PINCODE
	depends on CRYPTO_CORE
	bool "crypto_core support pincode."
	default n
	help
	  whether crypto_core support pincode

config CRYPTO_CORE_V2
	depends on CRYPTO_CORE
	bool "crypto core v2"
	default n
	help
	  whether crypto core v2 driver

config CRYPTO_CORE_FFA_SUPPORT
	bool "crypto core ffa support"
	depends on RPMBMSPC_SUPPORT_FFA
	default n
	help
	   config crypto core ffa support

config CRYPTO_CORE_APM_KCA_NOTIFY
	depends on CRYPTO_CORE_V2
	bool "crypto core support apm kernel ca notify"
	default n
	help
	  whether crypto core support apm kernel ca notify
```

## kernel/platform_source/see/drivers/efuse/Kconfig
```kconfig
config VENDOR_EFUSE
	bool "Support vendor efuse driver"
	default n
	help
	vendor efuse driver support

config EFUSE_SUPPORT_FFA
	bool "efuse support ffa"
	depends on ARM_FFA_TRANSPORT
	default n
	help
	Registering the ffa probe with efuse.
	The component invokes the ffa interface of efuse.
```

## kernel/platform_source/see/drivers/ffa/Kconfig
```kconfig
config PLATDRV_SUPPORT_FFA
	bool "platdrv support ffa"
	depends on ARM_FFA_TRANSPORT
	default n
	help
	  Registering the ffa probe with the platdrv.
	  The component invokes the ffa interface of the platdrv.
```

## kernel/platform_source/see/drivers/ffa_rpmbmspc/Kconfig
```kconfig
config RPMBMSPC_SUPPORT_FFA
	bool "rpmbmspc support ffa"
	depends on ARM_FFA_TRANSPORT
	default n
	help
	  Registering the ffa probe with the rpmbmspc.
	  The component invokes the ffa interface of the rpmbmspc.
```

## kernel/platform_source/see/drivers/harden/Kconfig
```kconfig
menu "Kernel Harden"

config KERNEL_REGION_PROTECT
	bool "Secure region protect for ACPU access of kernel region"
	depends on !DDRC_KERNEL_CODE_PROTECTION
	default n
	help
	  This module is for kernel code protection within ddrc mechanism.
	  Include:
	  kernel code,
	  kernel ro data,
	  etc ...

config DDRC_SUPPORT_FFA
	bool "ddrc support ffa"
	depends on ARM_FFA_TRANSPORT
	default n
	help
	  Registering the ffa probe with the ddrc.
	  The component invokes the ffa interface of the ddrc.

endmenu
```

## kernel/platform_source/see/drivers/hhee/Kconfig
```kconfig
menu "HHEE options"

config HHEE
	bool "HHEE support"
	default n
	help
	  Say yes here to support the HHEE

config HKIP_MODULE_ALLOC
	bool "HKIP overload module_alloc for hhee"
	depends on HHEE
	default n
	help
	  Say yes when overload is needed

config HHEE_DEBUG
	bool "HKIP HHEE test support"
	depends on !UBSAN && !KCOV && !KASAN
	depends on HHEE
	depends on DFX_DEBUG_FS
	default n
	help
	  Say yes here to support the HHEE debug

config ACE_ENABLE_TVM
	bool "HKIP support for cdc ace tvm enable"
	depends on HHEE
	default n
	help
	  Say yes here to support HKIP in cdc ace devices

config HHEE_USING_IPI
	bool "HKIP HHEE Using IPI interrupt"
	depends on HHEE
	default n
	help
	  Say yes here to support using IPI not GIC

config HKIP_XOM_CODE
	bool "HKIP XOM protection of kernel code"
	depends on HHEE
	default y
	help
	  Say yes here to enable kernel XOM protection

config HKIP_MAP_KERNEL_PROTECT
	bool "Protect kernel text and rodata pagetable in map_kernel"
	depends on HHEE
	default y
	help
	  Protect kernel text and rodata pagetable in map_kernel.

config HHEE_OHOS
	bool "openharmony hhee adapt"
	depends on HHEE
	default n
	help
	  Openharmony hhee adapt, only enabled in linux-5.10-lts kernel.

config HHEE_HIBERNATE
	bool "HHEE S4 Hibernate feature support"
	default HIBERNATION
	help
	---help---
	  This module supports the safe configuration or saving and recovery of
	  data for hhee modules. HHEE implements the saving and recovery
	  mechanism of S4 state, which is used by hhee module.
	  If unsure, say N.

endmenu
```

## kernel/platform_source/see/drivers/hicrypto/Kconfig
```kconfig
menu "hicrypto options"

config CRYPTO_HICRYPTO
	tristate "Support Hisilicon hardware crypto engine driver"
	select CRYPTO_USER
	select CRYPTO_ENGINE
	select CRYPTO_USER_API
	select CRYPTO_USER_API_HASH
	select CRYPTO_USER_API_SKCIPHER
	select CRYPTO_USER_API_AEAD
	default n
	help
		vendor hardware crypto engine driver support

config CRYPTO_HICRYPTO_DEBUG
	tristate "Support Hisilicon hardware debug crypto"
	depends on CRYPTO_HICRYPTO
	default n
	help
	  vendor hardware crypto engine debug support

config CRYPTO_HICRYPTO_INTR
	tristate "Support Hisilicon hardware interrupt crypto"
	depends on CRYPTO_HICRYPTO
	default n
	help
	  vendor hardware crypto engine interrupt support

config CRYPTO_HICRYPTO_SYS_CACHE
	tristate "Support Hisilicon hardware syscache crypto"
	depends on CRYPTO_HICRYPTO
	default n
	help
	  vendor hardware crypto engine syscache support

config CRYPTO_HICRYPTO_SHA
	tristate "Support Hisilicon hardware hash crypto"
	depends on CRYPTO_HICRYPTO
	default n
	help
	  vendor hardware crypto engine hash support

config CRYPTO_HICRYPTO_CIPHER
	tristate "Support Hisilicon hardware cipher crypto"
	depends on CRYPTO_HICRYPTO
	default n
	help
	  vendor hardware crypto engine cipher support

config CRYPTO_HICRYPTO_MAC
	tristate "Support Hisilicon hardware mac crypto"
	depends on CRYPTO_HICRYPTO
	default n
	help
	  vendor hardware crypto engine mac support

config CRYPTO_HICRYPTO_AEAD
	tristate "Support Hisilicon hardware aead crypto"
	depends on CRYPTO_HICRYPTO
	default n
	help
	  vendor hardware crypto engine aead support
endmenu
```

## kernel/platform_source/see/drivers/load_demo/Kconfig
```kconfig
config LOAD_DEMO
	bool "Support load demo image"
	default n
	depends on TZDRIVER
	help
	  This driver supports load demo image
```

## kernel/platform_source/see/drivers/pac_stub/Kconfig
```kconfig
config PAC_FEATURE_STUB
	bool "stub pac feacture"
	default n
config PAC_QARMA3_ENABLE
	bool "pac for qarma3"
	default n
```

## kernel/platform_source/see/drivers/sharevpu_sec_irq/Kconfig
```kconfig
config SHAREVPU_SEC_IRQ
	bool "SHAREVPU_SEC_IRQ support"
	default n
	help
	    sharevpu sec irq support

config SHAREVPU_SEC_IRQ_TEST
	bool "SHAREVPU_SEC_IRQ_TEST support"
	default n
	help
	    sharevpu sec irq test support
```

## kernel/platform_source/see/drivers/thee/Kconfig
```kconfig
config THEED
	bool "THEE support"
	depends on HAVE_ARM_SMCCC
	default n
	help
	  thee linux kernel despitch

config THEE_TEST
        bool "THEE test support"
        default n
        help
          Say yes here to support the THEE debug
```

## kernel/platform_source/see/drivers/vbmeta/Kconfig
```kconfig
config VBMETA_ROLLBACK
	bool "vbmeta_rollback"
	default n
	help
	  config update vbmeta rollback value
```

## kernel/platform_source/smart/drivers/Kconfig
```kconfig
config CONTEXTHUB
	bool "Sensor CONTEXTHUB driver"
	default n
	help
	Sensor CONTEXTHUB driver.

config CONTEXTHUB_BOOT_STAT
	bool "sensorhub boot stat"
	depends on CONTEXTHUB
	default n
	help
	Say yes here if you want to record boot stat during sensorhub startup

config CONTEXTHUB_TZSP
	bool "sensorhub tzsp"
	depends on CONTEXTHUB && ARM_FFA_TRANSPORT
	default n
	help
	Say yes here if you want to use tzsp to send messages.

config CONTEXTHUB_SH_NOCZERO
	bool "Sensor CONTEXTHUB_SH_NOCZERO"
	default n
	help
	Sensor CONTEXTHUB_SH_NOCZERO

config CONTEXTHUB_DFX_NOCMID
	bool "Sensor CONTEXTHUB_DFX_NOCMID"
	default n
	help
	New platform has no MID, So you need to open this Kconfig.

config SECURITY_HEADER_FILE_REPLACE
	bool "Security header file Replacement"
	default n
	help
	If the kernel use the security header file information,
	you can say yes here and use DTS to obtain it .

config SUPPORT_EXTEND_TAGS
	bool "sensorhub support more tags"
	depends on CONTEXTHUB
	default n
	help
	Say yes here if you want to extend more tags during sensorhub startup

config CONTEXTHUB_DSS_TRISTATEID  
	bool "CONTEXTHUB DSS TRISTATEID"
	default n
	help
	Added three state IDs for DSS

source "platform_source/smart/drivers/bsp/Kconfig"
source "platform_source/smart/drivers/channels/Kconfig"
source "platform_source/smart/drivers/syscounter/Kconfig"
```

## kernel/platform_source/smart/drivers/bsp/Kconfig
```kconfig
config INPUTHUB_30
	bool "INPUTHUB_30"
	depends on  CONTEXTHUB
	help
	support INPUTHUB_30.

config SMART_WATCHDOG_V500
	bool "SMART WATCHDOG V500 support"
	depends on CONTEXTHUB
	default n
	help
	Enable support for watchdog v500 driver

config IPC_V5
	bool "IPC_V5"
	depends on  INPUTHUB_30
	help
	support IPC_V5.

config RISCV_DUMP_ADAPT
	bool "RISCV_DUMP_ADAPT"
	depends on  INPUTHUB_30
	default n
	help
	RISCV dump adapt

config CONTEXTHUB_LOAD_IOMCU_IMAGE
	bool "LOAD IOMCU IMAGE"
	depends on  INPUTHUB_30
	default n
	help
	support kernel load iomcu iamge
```

## kernel/platform_source/smart/drivers/channels/igs/Kconfig
```kconfig
config CONTEXTHUB_IGS
	bool "intelligent gesture sensor driver"
	depends on INPUTHUB_20
	default n
	help
	Igs driver support aonn.

config CONTEXTHUB_IGS_DBG
	bool "intelligent gesture sensor dbg drvier"
	depends on INPUTHUB_20
	default n
	help
	Igs debug drvier support aonn.

config CONTEXTHUB_IGS_20
	bool "intelligent gesture sensor 2.0"
	default n
	help
	  intelligent gesture sensor 2.0 config

config CONTEXTHUB_IGS_30
	bool "intelligent gesture sensor 3.0"
	default n
	help
	  intelligent gesture sensor 3.0 config

config CONTEXTHUB_IGS_TOF
	bool "intelligent gesture sensor tof"
	default n
	help
	Igs tof driver
config CONTEXTHUB_IGS_DBG_50
	bool "intelligent gesture sensor dbg for cpro"
	default n
	help
	Igs driver support aonn.
config CONTEXTHUB_IGS_TQM_SUPPORT_6_OUTPUT
	bool "intelligent gesture sensor tqm support 6 output"
	default n
	help
	Igs tqm driver support 6 output.
```

## kernel/platform_source/smart/drivers/channels/sdc/Kconfig
```kconfig
config SENSOR_DIRECT_CHANNEL
	bool "sensor direct channel support"
	depends on INPUTHUB_30
	default n
	help
	Say yes here to support the sensor direct channel
```
