## kernel/platform_source/cee/drivers/hwtracing/dfx_coresight/Kconfig
```kconfig
#
# Coresight configuration
#
menuconfig CORESIGHT
	bool "CoreSight Tracing Support"
	depends on DEBUG_FS
	select ARM_AMBA
	help
	  This framework provides a kernel interface for the CoreSight debug
	  and trace drivers to register themselves with. It's intended to build
	  a topological view of the CoreSight components based on a DT
	  specification and configure the right serie of components when a
	  trace source gets enabled.

config CORESIGHT_LINKS_AND_SINKS
	depends on CORESIGHT
	bool "CoreSight Link and Sink drivers"
	help
	  This enables support for CoreSight link and sink drivers that are
	  responsible for transporting and collecting the trace data
	  respectively.  Link and sinks are dynamically aggregated with a trace
	  entity at run time to form a complete trace path.

config CORESIGHT_LINK_AND_SINK_TMC
	bool "Coresight generic TMC driver"
	depends on CORESIGHT_LINKS_AND_SINKS
	help
	  This enables support for the Trace Memory Controller driver.
	  Depending on its configuration the device can act as a link (embedded
	  trace router - ETR) or sink (embedded trace FIFO).  The driver
	  complies with the generic implementation of the component without
	  special enhancement or added features.

config CORESIGHT_TRBE
	  bool "Trace Buffer Extension (TRBE) driver"
	  depends on CORESIGHT
	  help
		This driver provides support for percpu Trace Buffer Extension (TRBE).
		TRBE always needs to be used along with it's corresponding percpu ETE
		component. ETE generates trace data which is then captured with TRBE.
		Unlike traditional sink devices, TRBE is a CPU feature accessible via
		system registers. But it's explicit dependency with trace unit (ETE)
		requires it to be plugged in as a coresight sink device.

		To compile this driver as a module, choose M here: the module will be
		called coresight-trbe.

config CORESIGHT_SINK_TPIU
	bool "Coresight generic TPIU driver"
	depends on CORESIGHT_LINKS_AND_SINKS
	help
	  This enables support for the Trace Port Interface Unit driver,
	  responsible for bridging the gap between the on-chip coresight
	  components and a trace for bridging the gap between the on-chip
	  coresight components and a trace port collection engine, typically
	  connected to an external host for use case capturing more traces than
	  the on-board coresight memory can handle.

config CORESIGHT_SOURCE_ETM4X
	bool "CoreSight Embedded Trace Macrocell 4.x driver"
	depends on ARM64
	depends on CORESIGHT
	select CORESIGHT_LINKS_AND_SINKS
	help
	  This driver provides support for the ETM4.x tracer module, tracing the
	  instructions that a processor is executing. This is primarily useful
	  for instruction level tracing. Depending on the implemented version
	  data tracing may also be available.

config DFX_CORESIGHT_TRACE
	bool "HISI CoreSight TRACE driver"
	depends on CORESIGHT
	help
	  This enables support for hisi coresight trace driver.

config DFX_CORESIGHT_STM
	bool "CoreSight STM driver"
	depends on CORESIGHT
	depends on CORESIGHT_LINK_AND_SINK_TMC
	depends on CORESIGHT_SOURCE_ETM4X
	help
	  This driver provides support for the STM tracer module, tracing the
	  instructions that a processor is executing. This is primarily useful
	  for instruction level tracing. Depending on the implemented version
	  data tracing may also be available.

config DFX_CORESIGHT_NOC
	bool "CoreSight NOC trace driver"
	depends on CORESIGHT
	depends on CORESIGHT_LINK_AND_SINK_TMC
	depends on CORESIGHT_SOURCE_ETM4X
	help
	  This driver provides support for the noc tracer module, tracing the
	  instructions that a processor is executing. This is primarily useful
	  for instruction level tracing. Depending on the implemented version
	  data tracing may also be available.

config DFX_CORESIGHT_QIC
	bool "CoreSight QIC trace driver"
	depends on CORESIGHT
	help
	  This driver provides support for the qic tracer module, tracing the
	  instructions that a processor is executing. This is primarily useful
	  for instruction level tracing.
```
