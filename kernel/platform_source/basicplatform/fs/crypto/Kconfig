## kernel/platform_source/basicplatform/fs/crypto/Kconfig
```kconfig
config FS_ENCRYPT_CASEFOLD
	bool "Enable casefold for encrypt"
	depends on UNICODE && FS_ENCRYPTION
	help
		Enable casefold for encrypt.
```

## kernel/platform_source/basicplatform/fs/filemap_manager/Kconfig
```kconfig
config MM_PAGECACHE_HELPER
	tristate "page cache helper module"
	default n
	help
	  This selects the page cache helper module.
	  Select this if you want to optimize your Android system.
	  If unsure, say N.

config MM_BUFFERED_READAHEAD
	bool "enlarge readahead for buffered read"
	default n
	help
	  for buffered readahead.
```

## kernel/platform_source/basicplatform/kernel/Kconfig
```kconfig
menu "Kernel Configuration"

source "platform_source/basicplatform/kernel/hisi_gcov/Kconfig"

endmenu
```

## kernel/platform_source/basicplatform/mm/Kconfig
```kconfig
menuconfig H_MM
	bool "H_MM support"
	help
	  This option add some h_mm codes, needed by following modules.

if H_MM

config H_MM_SLOW_PATH_COUNT
	bool "page alloc enter slow path count"
	default n
	help
	  Say 'Y' here is you want to count page alloc slow path.

config H_MM_PAGE_TRACE
	bool "HMM page trace"
	help
	  This option enables h_mm page trace, needed by memleak check modules.

config H_MM_PAGE_TRACE_TEST
	bool "HMM page trace test"
	depends on H_MM_PAGE_TRACE
	help
	  This option enables h_mm page trace test, needed by h_mm page trace modules.
endif

config MM_MEM_OFFLINE
	bool "Dynamic Memory Region Offline driver"
	depends on MEMORY_HOTPLUG
	help
	  Add support for DDR Self-Refresh power management through the dynamic
	  memory offline framework. This driver interfaces between the memory
	  hotplug subsystem and AOP which hot adds or removes memory blocks and
	  controls the start/stop of self-refresh of these DDR regions. This
	  helps reduce power consumption during idle mode of the system.
	  If unsure, say N

config MM_BOOTMEM_OPTIMIZE
	bool "MM bootmem optimize"
	default n
	depends on HAVE_ARCH_PFN_VALID
	depends on !HAVE_MEMBLOCK_NODE_MAP
	help
	  Orign bootmem_init in zone init function "memmap_init_zone" waste too much time
	  in iterate zone [start, end) pfn and judge if the pfn is valid, and when memory
	  has hole, it will cost too much time. So let it only iterate memory which in memblock.
	  if unsure, say N

config PM_PEAK
	bool "Physical Memory Peak"
	default n
	help
	  Record physical memory peak for each task.

config KSWAPD_DEBUG
	bool "kswapd debug"
	default n
	help
	  Provide extra log to find why kswapd is running frequently.

config PARA_SWAPD
	bool "Enable parallel kz/swapd to reclaim anon page per memcg"
	default n
	depends on HYPERHOLD_ZSWAPD
	help
	  Para swapd is a new implement of shrink_anon/shrink_hyperhold_anon.
	  It separately reclaim anon page by memcg, and limit running cpu to
	  middle cluster.

config MM_AMA
	bool "Enable AMA mempolicy for asymmetrical memory access"
	default n
	depends on NUMA
	help
	  AMA mempolicy is a new MemoryManagement Architecture for memory alloc&reclaim.
	  It builds a new memory allocation strategy by page Attributes, and using
	  differential recycling strategy to improve memory usage efficiency.

config PROCESS_RECLAIM
	bool "Enable process reclaim"
	depends on PROC_FS
	default n
	help
	  It allows to reclaim pages of the process by /proc/pid/reclaim.
	  (echo file > /proc/PID/reclaim) reclaims file-backed pages only.
	  (echo anon > /proc/PID/reclaim) reclaims anonymous pages only.
	  (echo all > /proc/PID/reclaim) reclaims all pages.
	  (echo addr size-byte > /proc/PID/reclaim) reclaims pages in
	  (addr, addr + size-bytes) of the process.
	  Any other vaule is ignored.

config MM_SMART_RECLAIM
	bool "Enable smart reclaim"
	default y
	depends on PROCESS_RECLAIM
	help
	  When enabled, memory pages of background processes will be reclaimed.
	  Depending on if the process is an application or service.
	  In case of service, advise kernel to reclaim file backed pages
	  of background processes(file tpyes .dex, .jar and/or .apk).
	  This triggered by writting soft to /proc/<pid>/reclaim from user space.

config HISI_SWAP_ZDATA
	bool "Compressed data to swap"
	depends on SWAP
	depends on PROCESS_RECLAIM
	default n
	help
	  Save compressed data to swap page.
	  If unsure, say Y to enable swap_zdata.
config MM_VIP
	bool "Enable memory vip allocation"
	default n
	help
	  Support memory vip allocation for vip process.
```

## kernel/platform_source/camera/drivers/media/native/camera/hisp/Kconfig
```kconfig
comment "MODULE ISP"


if KERNEL_CAMERA_ISPV110
endif

if KERNEL_CAMERA_ISPV150
endif

if KERNEL_CAMERA_ISPV160
endif

if KERNEL_CAMERA_ISPV120 || KERNEL_CAMERA_ISPV130
endif

if KERNEL_CAMERA_ISPV200
endif

if KERNEL_CAMERA_ISPV250
endif

if KERNEL_CAMERA_ISPV210
endif

if CAMERA_ISPV220 || CAMERA_ISPV230
endif

if KERNEL_CAMERA_ISPV310
endif

if KERNEL_CAMERA_ISPV300
endif

if KERNEL_CAMERA_ISPV350 || KERNEL_CAMERA_ISPV360
source "platform_source/camera/drivers/media/native/camera/hisp/hisp350/Kconfig"
endif

if KERNEL_CAMERA_ISPV500
endif
```

## kernel/platform_source/camera/drivers/media/native/camera/hisp/hisp350/Kconfig
```kconfig
comment "MODULE ISP"

choice
	prompt "HISP Version"
	default KERNEL_CAMERA_USE_HISP350
	depends on KERNEL_CAMERA
	help
        Select ISP version.

config KERNEL_CAMERA_USE_HISP350
	bool "HISP350"
	depends on KERNEL_CAMERA

endchoice
```

## kernel/platform_source/camera/drivers/media/native/camera/idi2axi/Kconfig
```kconfig
config CAM_IDI2AXI
    tristate "idi2axi driver"
    default n
    select VIDEOBUF2_CORE
    select VIDEOBUF2_DMA_CONTIG
    select VIDEO_V4L2
    help
        enable idi2axi device, if enabled, need select idi2axi version
        and sensor gen if needed

if CAM_IDI2AXI
choice
    prompt "idi2axi version"
    default IDI2AXI_V100
    config IDI2AXI_V100
        bool "idi2axi v100"
endchoice

config CAM_IDI2AXI_DEBUG
    bool "enable debug fs props"
    default n
    help
        create i2a debug fs, provide some dynamic control

#if IDI2AXI_V100
#source "platform_source/camera/drivers/media/native/camera/idi2axi/platform/v100/Kconfig"
#endif # IDI2AXI_V100

endif # CAM_IDI2AXI
```

## kernel/platform_source/camera/drivers/media/native/camera/idi2axi_sensor/Kconfig
```kconfig
config CAM_IDI2AXI_SENSOR
    tristate "idi2axi sensors driver"
    default n
    select CAM_IDI2AXI
    help
        enable idi2axi sensor device, if enabled, need select idi2axi

#if CAM_IDI2AXI_SENSOR
#choice
#    prompt "idi2axi version"
#    default IDI2AXI_V100
#    config IDI2AXI_V100
#        bool "idi2axi v100"
#endchoice

#if IDI2AXI_V100
#source "platform_source/camera/drivers/media/native/camera/idi2axi_sensor/platform/v100/Kconfig"
#endif # IDI2AXI_V100

#endif # CAM_IDI2AXI_SENSOR
```

## kernel/platform_source/camera/drivers/media/native/camera/sensor/cam_misc/Kconfig
```kconfig
comment "camera misc device"

config KERNEL_CAMERA_USE_MISC_DEVICE
    bool "camera use misc dev"
    default n
    help
        Say Y here to enable camera misc device
```

## kernel/platform_source/cee/Kconfig
```kconfig
menu "cee Kernel Configuration"

source "platform_source/cee/drivers/Kconfig"
source "platform_source/cee/kernel/sched/Kconfig"

config KERNEL_CODEMERGE
	bool "enable CodeMerge in kernel"
	default n
	help
	  Improve the kernel performance by using compiler optimization.
	  CodeMerge includes these compiler passes:PGO, Function Reorder,
	  Hot-Cold Split and Unplt.
	  It is a feature based on profiling data and needs to update when
	  version of kernel changes.

endmenu
```

## kernel/platform_source/cee/drivers/Kconfig
```kconfig
menu "driver Configuration"

source "platform_source/cee/drivers/mpam/Kconfig"
source "platform_source/cee/drivers/hck/Kconfig"
source "platform_source/cee/drivers/hw_vote/Kconfig"
source "platform_source/cee/drivers/qos/Kconfig"
source "platform_source/cee/drivers/file_encry/Kconfig"
source "platform_source/cee/drivers/pm/Kconfig"
source "platform_source/cee/drivers/gpufreq/Kconfig"
source "platform_source/cee/drivers/npu_pm/Kconfig"
source "platform_source/cee/drivers/onsys_avs/Kconfig"
source "platform_source/cee/drivers/adc/Kconfig"
source "platform_source/cee/drivers/dpm/Kconfig"
source "platform_source/cee/drivers/ddrc/Kconfig"
source "platform_source/cee/drivers/lpmcu_debug/Kconfig"
source "platform_source/cee/drivers/hotplug_agent/Kconfig"
source "platform_source/cee/drivers/freqdump/Kconfig"
source "platform_source/cee/drivers/bus_monitor/Kconfig"
source "platform_source/cee/drivers/devfreq/Kconfig"
source "platform_source/cee/drivers/drg/Kconfig"
source "platform_source/cee/drivers/hwtracing/dfx_coresight/Kconfig"
source "platform_source/cee/drivers/cpuidle/Kconfig"
source "platform_source/cee/drivers/lpcpu_timer/Kconfig"
source "platform_source/cee/drivers/lpcpu_pmu/Kconfig"
source "platform_source/cee/drivers/freq_qos_debug/Kconfig"
source "platform_source/cee/drivers/mips_mem/Kconfig"
source "platform_source/cee/drivers/amu/Kconfig"
source "platform_source/cee/drivers/rtm/Kconfig"
source "platform_source/cee/drivers/cpu_hide/Kconfig"

if ARM || ARM64
source "platform_source/cee/drivers/cpufreq/lpcpu/Kconfig"
endif

if EDAC
source "platform_source/cee/drivers/edac/lpedac/Kconfig"
endif

source "platform_source/cee/drivers/heca/Kconfig"

menu "ithermal drivers"
depends on ARCH_PLATFORM
source "platform_source/cee/drivers/thermal_platform/Kconfig"
endmenu
endmenu
```

## kernel/platform_source/cee/drivers/amu/Kconfig
```kconfig
menu "AMU Driver"

config PLATFORM_ARM64_AMU
    bool "enable amu extension"
    help
      This enables the amu driver.
endmenu
```

## kernel/platform_source/cee/drivers/cpu_hide/Kconfig
```kconfig
config CPUID_MIDR_HIDE
	bool "hide the real cpu midr"
	default n
	help
	  hide the real cpu midr

config CPUID_BIG_MID_UNIQUE
	bool "unique big and middle cpu id"
	depends on CPUID_MIDR_HIDE
	default n
	help
	  unique big and middle cpu id in some platform

config CPUID_MID_LIT_EXCLUSIVE
	bool "exclusive middle and little cpu id"
	depends on CPUID_MIDR_HIDE
	default n
	help
	  exclusive middle and little cpu id in some platform
```

## kernel/platform_source/cee/drivers/cpuidle/Kconfig
```kconfig
if CPU_IDLE

config LPCPU_IDLE_SLEEP
	bool "Support cpu idlesleep vote"
	default n
	help
	  Only used for s1 state(32k).

config CPUIDLE_MENU_GOV_HIST
	bool "Support C-state reselect with history record"
	depends on CPU_IDLE_GOV_MENU
	default n
	help
	  Allows the cpuidle C-state reselect with history record.
	  If unsure say N.

config CPUIDLE_LITTLE_SKIP_CORRECTION
	bool "Little cpu predict time skip correction"
	depends on CPUIDLE_MENU_GOV_HIST
	default n
	help
	  Allows little cpu predict time skip correction
	  If unsure say N.

config CPUIDLE_LP_MODE
    bool "Support C-state reselect with lowpower mode"
    depends on CPU_IDLE
    default n
    help
     Allows the cpuidle C-state reselect with lowpower mode.
     If unsure say N.

config CPUIDLE_SKIP_ALL_CORE_DOWN
	bool "Last little cpu core down to wfi"
	depends on CPU_IDLE_GOV_MENU
	default n
	help
	  Allows the last little cpu core down to wfi
	  If unsure say N.

config CPUIDLE_SKIP_DEEP_CSTATE
    bool "Support to select non-deepest C-state after select deepest continually."
    depends on CPU_IDLE
    default n
    help
     Allows the cpuidle C-state reselect after select deepest C-state continually.
     If unsure say N.

config CPU_IDLE_GOV_ALIGN
	bool "Cluster CPU Align idle governor (for system Dou and FCM power down)"
	depends on SCHED_INDICATE_FCM_IDLE
	default n
	help
	  In our system, core idle isn't power saving enough, only clusteridle
	  and FCM power down can achieve the best power status.
	  So in this governor, we use ipi to make all of the cpu enter deepest idle
	  as contemporaneous as possible.

config CPUIDLE_STATE_NOTIFY
	bool "Notify which C-state CPU entered"
	depends on CPU_IDLE
	default n
	help
	  Register the notifier to monitor the C-sate of CPU if interested.

if ARM || ARM64

config LPCPU_MULTIDRV_CPUIDLE
	bool "Generic Multiple Driver CPU idle Driver"
	depends on ARM_PSCI_FW
	select CPU_IDLE_MULTIPLE_DRIVERS
	select DT_IDLE_STATES
	help
	  Select this to enable generic cpuidle driver for CPU lowpower.
	  It provides a generic idle driver whose idle states are configured
	  at run-time through DT nodes. The CPUidle suspend backend is
	  initialized by calling the CPU operations init idle hook
	  provided by architecture code.

endif

endif
```

## kernel/platform_source/cee/drivers/ddrc/ddr_test/Kconfig
```kconfig
config DDR_TEST
    bool "ddr test support"
    depends on DFX_DEBUG_FS
    default n
    help
      Say yes here to support the ddr test module.
```

## kernel/platform_source/cee/drivers/ddrc/ddrcflux/Kconfig
```kconfig
config DDR_DDRC_FLUX_SOFTTIMER
    bool "ddrc flux module support"
    default n
    help
      Say yes here to support the ddrc flux module.
```

## kernel/platform_source/cee/drivers/ddrc/dmsspt/Kconfig
```kconfig
config DDR_DMSS_PT
    bool "dmss pattern trace module support"
    depends on DFX_DEBUG_FS
    default n
    help
      Say yes here to support the dmss pattern trace module.
```

## kernel/platform_source/cee/drivers/ddrc/pattern_trace/Kconfig
```kconfig
config DDR_QICE_PT
    bool "qice pattern trace module support"
    depends on DFX_DEBUG_FS
    default n
    help
      Say yes here to support the dmss pattern trace module.
```

## kernel/platform_source/cee/drivers/devfreq/Kconfig
```kconfig
# SPDX-License-Identifier: GPL-2.0-only
source "platform_source/cee/drivers/devfreq/mem_lat/Kconfig"
source "platform_source/cee/drivers/devfreq/gpu_devfreq/Kconfig"
source "platform_source/cee/drivers/devfreq/npu_devfreq/Kconfig"
if PM_DEVFREQ
source "platform_source/cee/drivers/devfreq/l3c_devfreq/Kconfig"
endif
```

## kernel/platform_source/cee/drivers/file_encry/Kconfig
```kconfig
config FILE_BASED_ENCRYPTO
	bool "FEB3 support"
	default n
	help
	  Say yes here to support the FBE3

config FBE3_1
	bool "FEB3_1 support with UFSC KM"
	depends on FILE_BASED_ENCRYPTO
	default n
	help
	  Say yes here to support the FBE3_1 ufsc KM

config FILE_BASED_ENCRYPTO_FOR_HM_FSCRYPTO
	bool "FEB3 for fs crypto support"
	default n
	help
	  Say yes here to support the FBE3 for fs crypto

config FILE_BASED_ENCRYPTO_DBG
	bool "FEB3 debug support"
	depends on FILE_BASED_ENCRYPTO
	depends on DFX_DEBUG_FS
	default n
	help
	  Say yes here to support the FBE3 debug

config FBE_MSPC_ABSENT
	bool "FEB3 not to use MSPC"
	depends on FILE_BASED_ENCRYPTO
	default n
	help
	  Say yes here FBE3 not to use MSPC

config FBE_FPGA
	bool "FEB3 FPGA mode"
	depends on FILE_BASED_ENCRYPTO
	default n
	help
	  Say yes here to adapt the FBE3 in FPGA
```

## kernel/platform_source/cee/drivers/freq_qos_debug/Kconfig
```kconfig
config FREQ_QOS_DEBUG
	bool "show freq qos vote value"
	default n
	help
	  Make a debug sysfs to show freq qos vote value.
```

## kernel/platform_source/cee/drivers/gpufreq/guest/Kconfig
```kconfig
menu "GUEST GPU VOTE Options"

config GUEST_GPUFREQ_VOTE
    tristate "Guest gpufreq vote"
    depends on PRODUCT_CDC_ACE
    help
      This enables the guest gpufreq vote.

endmenu
```

## kernel/platform_source/cee/drivers/hck/Kconfig
```kconfig
# SPDX-License-Identifier: GPL-2.0
menu "CEE Hck"

config CEE_CPU_HCK
	bool "CEE CPU Hck Drivers"
	default n
	help
	  Enable support for cpu drivers needed on the HiSilicon Common Kernel

endmenu
```

## kernel/platform_source/cee/drivers/heca/Kconfig
```kconfig
config HECA
	bool "HECA"
	default n
	help
	  Hisilicon Efficiency Control Algorithm

config HECA_DEBUG
	bool "HECA Debug"
	depends on HECA
	default n
	help
		HECA Debug
```
