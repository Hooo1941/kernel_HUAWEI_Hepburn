## kernel/platform_source/basicplatform/drivers/mntn/dfx_sh/Kconfig
```kconfig
config DFX_SH
	bool "DFX sh driver"
	default n
	help
		Say 'Y' here if you want to use enable dfx sh
```

## kernel/platform_source/basicplatform/drivers/mntn/ecall/Kconfig
```kconfig
config PLATFORM_DFX_EASYSHELL
	bool "Support Easy Shell"
	default n
	help
	  This driver supports XXX SOC,
	  including easy shell, etc.
config KERNEL_NOCFI_NONE
	bool "Support config nocfi"
	default n
	help
	  Config none nocfi.
```

## kernel/platform_source/basicplatform/drivers/mntn/powerkey_reboot/Kconfig
```kconfig
config MNTN_POWERKEY_REBOOT
	bool "powerkey reboot support"
	default n
	depends on PLATFORM_DFX_MNTN && LIBLINUX
	help
	  Say yes here to support powerkey reboot
```

## kernel/platform_source/basicplatform/drivers/net/ethernet/hisi/Kconfig
```kconfig
config NET_VENDOR_HISI_HIXGEMAC
        bool "Hisilicon XGE MAC"
        help
          If you have a Hisilicon xGE MAC, say Y.

config NET_VENDOR_HIXGEMAC_GPTP
        bool "Hisilicon XGE MAC GPTP"
        help
          If gptp is supportted, say Y.

config NET_VENDOR_HIXGEMAC_10CC
        bool "Hisilicon XGE PMA 10CC"
        help
          If XGE uses the 10CC PMA, say Y.
```

## kernel/platform_source/basicplatform/drivers/net/phy/Kconfig
```kconfig
if PHYLIB
config MOTORCOMM_PHY
        tristate "Motorcomm PHYS"
        help
          Support the YT8521
endif
```

## kernel/platform_source/basicplatform/drivers/partition/Kconfig
```kconfig
config PARTITION_TABLE
	bool "partition ptable"
	default n

config PARTITION_ARMPC
	bool "armpc partition"
	depends on PARTITION_TABLE
	default n
	help
	  config partition for armpc platform

config PRODUCT_CDC
	bool "cdc partition"
	depends on PARTITION_TABLE
	default n
	help
	  config partition for cdc platform

config PRODUCT_CDC_ACE
	bool "cdc ace partition"
	depends on PARTITION_TABLE
	default n
	help
	  config partition for cdc ace platform

config PARTITION_TARGET_OHOS
	bool "ohos partition"
	depends on PARTITION_TABLE
	default n
	help
	  config partition for ohos platform

config PARTITION_PC
	bool "new pc partition"
	depends on PARTITION_TABLE
	default n
	help
	  config partition for new pc platform

config PARTITION_PATH_BY_LABEL
	bool "/dev/disk/by-partlabel"
	depends on PARTITION_TABLE
	default n
	help
	  This enable use /dev/disk/by-partlable path to access in kernel
```

## kernel/platform_source/basicplatform/drivers/pci/Kconfig
```kconfig
source "platform_source/basicplatform/drivers/pci/host/Kconfig"
source "platform_source/basicplatform/drivers/pci/controller/Kconfig"
```

## kernel/platform_source/basicplatform/drivers/pci/controller/Kconfig
```kconfig
#
# Kirin PCIe driver configuration
#

config HIPCIE_CORE
	bool "HiPCIe controller"
	depends on PCI
	depends on PCI_MSI_IRQ_DOMAIN
	select PCIEPORTBUS
	help
	  Say Y here to enable PCIe controller support on Kirin SoCs.

config HIPCIE_PHY
	tristate "HiPCIe phy"
	depends on HIPCIE_CORE
	help
	  Say Y here to enable PCIe phy support on Kirin SoCs.

config HIPCIE_SUPPORT_FFA
	tristate "HiPCIe controller support ffa"
	depends on PLATDRV_SUPPORT_FFA
	default n
	help
	  Say Y here to enable PCIe FFA

source "platform_source/basicplatform/drivers/pci/controller/ctrl/Kconfig"
source "platform_source/basicplatform/drivers/pci/controller/phy/Kconfig"
source "platform_source/basicplatform/drivers/pci/controller/plat/Kconfig"
source "platform_source/basicplatform/drivers/pci/controller/test/Kconfig"
```

## kernel/platform_source/basicplatform/drivers/pci/controller/core/Kconfig
```kconfig
#
# Kirin PCIe driver configuration
#

config HIPCIE_IDLE
	tristate "HiPCIe IDLE"
	depends on HIPCIE_CORE
	help
	  Say Y here to enable PCIe Idle support on Kirin Soc.
```
