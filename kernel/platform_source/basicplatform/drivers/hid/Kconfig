## kernel/platform_source/basicplatform/drivers/hid/Kconfig
```kconfig
# SPDX-License-Identifier: GPL-2.0-only
#
# HID driver configuration
#

config HID_VR
	tristate "VR device support"
	depends on USB_HID
	help
	  Support for VR devices.
	  Say Y here if you have a VR device.

config HID_HUAWEI
	tristate "HUAWEI TypeC Headset"
	depends on HID
	help
	  Support for Huawei TypeC headset.
```

## kernel/platform_source/basicplatform/drivers/hp/Kconfig
```kconfig
# SPDX-License-Identifier: GPL-2.0
# Heterogeneous memory container backend device configuration

# Selected when system need heterogeneous memory container
config HP_CORE
	bool "Heterogeneous memory container device support"
	depends on ZRAM && HYPERHOLD && ZS_MALLOC_EXT
	default n
	help
	  Say Y here if you want to use the heterogeneous memory
	  as the backend device in ZRAM.
	  If unsure, say N here.
	  This module can't be compiled as a module,
	  the module is as one part of the ZRAM driver.

config HP_FILE
	bool "Heterogeneous memory file preallocate functions"
	depends on HP_CORE
	default n
	help
	  Say Y here if you want to allocate a file in /data for heterogeneous memory.
	  If unsure, say N here.
	  This module can't be compiled as a module,
	  the module is as one part of the ZRAM driver.

config HP_DEFAULT_FILE_SPACE
	bool "set default file space"
	depends on HP_FILE
	default n

config RAMTURBO
	bool "RAM Turbo"
	depends on HP_CORE
	default n
	help
	  RAM Turbo features, swapout background tasks

config HH_REMAP
	bool "hyperhold remap"
	depends on HP_CORE
	default n
	help
	  hyperhold remap features

config HH_REMAP_DEBUG
	bool "hyperhold remap debug"
	depends on HP_CORE
	default n
	help
	  hyperhold remap debug

config HP_TURBO
	bool "hyperhold turbo"
	depends on HP_CORE
	default n
	help
	  hyperhold turbo features, swap without zram

config HP_TURBO_DEBUG
	bool "hyperhold turbo debug"
	depends on HP_TURBO
	default n
	help
	  hyperhold turbo debug
```

## kernel/platform_source/basicplatform/drivers/hp_ohos/Kconfig
```kconfig
config HYPERHOLD_INLINE_CRYPTO
	bool "hyperhold inline crypto"
	depends on ZRAM && HYPERHOLD
	default n
	help
	  Say Y here if you want to use hyperhold inline crypto.
	  If unsure, say N here.
	  This module can't be compiled as a module,
	  the module is as one part of the ZRAM driver.
```

## kernel/platform_source/basicplatform/drivers/hsdt_bus/Kconfig
```kconfig
#
# Kirin HSDT BUS Configurate
#
config HSDT_BUS_DOMAIN
	bool "HSDT_BUS DOMAIN"
	default n
	help
	  Say Y here to enable HSDT BUS support on Kirin SoCs.

source "platform_source/basicplatform/drivers/hsdt_bus/platform/Kconfig"
```

## kernel/platform_source/basicplatform/drivers/hsdt_bus/platform/Kconfig
```kconfig
#
# Kirin HSDT BUS platform configuration
#
config HSDT_BUS_OCT
	tristate "HSDT BUS Oct, Cpxx use this macro"
	select HSDT_BUS_DOMAIN
```

## kernel/platform_source/basicplatform/drivers/hw_info/Kconfig
```kconfig
if PROC_FS=y

config HISI_PROC_HARDWARE
	bool "/proc/hardware support"
	depends on HISI_PROC && OF
	help
	  read the /proc/hardware to get hardware info.

endif # PROC_FS
```

## kernel/platform_source/basicplatform/drivers/i2c/Kconfig
```kconfig
# SPDX-License-Identifier: GPL-2.0

config I2C_V300_DESIGNWARE
	tristate "Synopsys DesignWare I2C_V300"
	depends on HAVE_CLK
	select I2C_DESIGNWARE_CORE
	help
	  If you say yes to this option, support will be included for the
	  Synopsys DesignWare I2C adapter on some plat.
	  Only master mode is supported.


config I2C_V400_MASTER
	tristate "I2C_V400 MASTR"
	depends on HAVE_CLK
	help
	  If you say yes to this option, support will be included for the
	  I2C adapter on some plat.

config I2C_FFA_SUPPORT
	depends on PLATDRV_SUPPORT_FFA
	bool "i2c support ffa"
	default n
	help
	 i2c support ffa or not.
```

## kernel/platform_source/basicplatform/drivers/mfd/scharger_spmi/Kconfig
```kconfig
config SCHARGER_SPMI
    tristate "scharger spmi base driver"
    depends on OF
    depends on SPMI_PLATFORM
    help
      This driver supports scharger spmi.
```

## kernel/platform_source/basicplatform/drivers/mfd/scharger_v700/Kconfig
```kconfig
config SCHARGER_V700
    tristate "schargerV700 base driver"
    depends on OF
    help
      This driver supports schargerV700.
```

## kernel/platform_source/basicplatform/drivers/mm_lb/Kconfig
```kconfig
config MM_LB
	bool "last buffer"
	help
	  Enable last buffer.

	  If unsure, say N here.

config MM_LB_DEBUG
	bool "Lb debug"
	depends on MM_LB
	help
	  Enable last buffer debug.

	  If unsure, say N here.

config MM_LB_ENG_DEBUG
	bool "Lb eng debug"
	depends on MM_LB
	help
	  Enable last buffer eng debug.

	  If unsure, say N here.

config MM_LB_TST
	bool "Lb ip test"
	depends on MM_LB
	help
	  Enable last buffer ip test
	  and need disable lb debug

	  if unsure, say N here

config MM_LB_PMU
	bool "Lb pmu"
	depends on MM_LB
	help
	  Enable last buffer ip test
	  and need disable lb debug

	  if unsure, say N here

config MM_LB_L3_EXTENSION
	bool "Lb l3 extension"
	depends on MM_LB
	help
	  Enable last buffer debug.

	  If unsure, say N here.

config MM_LB_V100
	bool "Lb v100"
	depends on MM_LB
	help
	  Enable last buffer driver v100.

	  If unsure, say N here.

config MM_LB_V200
	bool "Lb v200"
	depends on MM_LB
	help
	  Enable last buffer driver v200.

	  If unsure, say N here.

config MM_LB_V300
	bool "Lb v300"
	depends on MM_LB
	help
	  Enable last buffer driver v300.

	  If unsure, say N here.

config MM_LB_V400
	bool "Lb v400"
	depends on MM_LB
	help
	  Enable last buffer driver v400.

	  If unsure, say N here.

config MM_LB_V500
	bool "Lb v500"
	depends on MM_LB
	help
	  Enable last buffer driver v500.

	  If unsure, say N here.

config MM_LB_V550
	bool "Lb v550"
	depends on MM_LB
	select MM_LB_FULL_COHERENCY
	help
	  Enable last buffer driver v550.

	  If unsure, say N here.

config MM_LB_FULL_COHERENCY
	bool "Lb support full coherency"
	depends on MM_LB_V550
	help
	  This option is selected by MM_LB_V550 automatically.
	  It Indicates that the cache coherency is supported by the
	  last buffer hardware.
	  With this feature, the cpu cache flush function by set/way
	  is not available. Drivers should, alternatively, flush cache
	  by va range.

config MM_LB_GID_PBHA
	bool "support gid to pbha"
	depends on MM_LB
	help
	  Support gid to pbha.

	  If unsure, say N here.

config MM_LB_PMU_V500
	bool "Lb pmu"
	depends on MM_LB
	help
	  Enable system cache pmu v500.

	  if unsure, say N here

config MM_LB_GM_TEST
	bool "LB test with GM"
	depends on MM_LB_V550
	help
		Enable GM test drv.
```

## kernel/platform_source/basicplatform/drivers/mmc/Kconfig
```kconfig
config ZODIAC_MMC
	bool "ZODIAC MMC"
	depends on MMC
	default y
	help
	   config ZODIAC mmc driver

config MMC_SIM_GPIO_EXCHANGE
	bool "MMC SIM GPIO EXCHANGE"
	depends on MMC
	default n
	help
	   config ZODIAC sd driver

config SD_SDIO_CRC_RETUNING
	bool "SD SDIO CRC RETUNING"
	depends on MMC
	default n
	help
	   config ZODIAC sd driver

config SDIO_HI_CLOCK_RETUNING
	bool "SDIO HI CLOCK RETUNING"
	depends on MMC
	default n
	help
	   config ZODIAC sd driver

config SD_TIMEOUT_RESET
	bool "SD STIMEOUT RESET"
	depends on MMC
	default n
	help
	   config ZODIAC sd driver

config ZODIAC_MMC_FLUSH_REDUCE
	bool "Flush Reduce on MMC"
	depends on MMC != n
	default n
	help
	   Enable this config will provide the flush reduce support in MMC

config ZODIAC_MMC_FLUSH_REDUCE_WHITE_LIST
	bool "Flush Reduce eMMC devices white list"
	depends on ZODIAC_MMC_FLUSH_REDUCE != n
	default n
	help
	   Enable this config will enfore white list check on eMMC devices for flush reduce

config ZODIAC_MMC_MANUAL_BKOPS
	bool "MMC manual BKOPS support"
	depends on MAS_BKOPS
	default n
	help
	 MMC manual BKOPS support

config HUAWEI_SDCARD_DSM
	bool "Listen sdcard kernel err"
	depends on MMC != n
	default n
	help
	   use huawei sdcard log radar

config HUAWEI_EMMC_DSM
	bool "Listen eMMC kernel err"
	depends on MMC != n
	default n
	help
	   use huawei emmc log radar

source "platform_source/basicplatform/drivers/mmc/core/Kconfig"
source "platform_source/basicplatform/drivers/mmc/host/Kconfig"
```

## kernel/platform_source/basicplatform/drivers/mmc/core/Kconfig
```kconfig
config MMC_BLOCK_DEFERRED_RESUME
	bool "Deferr MMC layer resume until I/O is requested"
	depends on MMC_BLOCK
	default n
	help
	  Say Y here to enable deferred MMC resume until I/O
	  is requested. This will reduce overall resume latency and
	  save power when theres an SD card inserted but not being used.

config MMC_CRYPTO
	bool "MMC Crypto Engine Support"
	depends on BLK_INLINE_ENCRYPTION
	help
	  Enable Crypto Engine Support in MMC.
	  Enabling this makes it possible for the kernel to use the crypto
	  capabilities of the MMC device (if present) to perform crypto
	  operations on data being transferred to/from the device.

config MMC_FFU
	bool "FFU SUPPORT"
	depends on MMC != n
	help
	  This is an option to run firmware update on eMMC 5.0.
	  Field firmware updates (FFU) enables features enhancment
	  in the field.

config HW_SD_HEALTH_DETECT
	bool "SD HEALTH DIAG SUPPORT"
	default y
	help
	  This is an option to diag sd health status.

config MMC_PASSWORDS
	bool "MMC card lock/unlock passwords (EXPERIMENTAL)"
	select KEYS
	default y
	help
	  Say Y here to enable the use of passwords to lock and unlock
	  MMC cards.  This uses the access key retention support, using
	  request_key to look up the key associated with each card.
	  For example, if you have an MMC card that was locked using
	  Symbian OS on your cell phone, you won't be able to read it
	  on Linux without this support.
```

## kernel/platform_source/basicplatform/drivers/mmc/host/Kconfig
```kconfig
config MMC_SDHCI_ZODIAC
	tristate "SDHCI OF support for the zodiac SDHCI controllers"
	depends on MMC_SDHCI_PLTFM
	help
	  If you have a controller with this interface, say Y or M here.

config MMC_SDHCI_ZODIAC_AQUILA
	tristate "SDHCI OF support for the aquila SDHCI controllers"
	depends on MMC_SDHCI_ZODIAC
	help
	  This selects the Arasan Secure Digital Host Controller Interface
	  (SDHCI). This hardware is found e.g. in Xilinx' Zynq SoC.

	  If you have a controller with this interface, say Y or M here.

	  If unsure, say N.

config MMC_SDHCI_ZODIAC_ANTLIA
	tristate "SDHCI OF support for the antlia SDHCI controllers"
	depends on MMC_SDHCI_ZODIAC
	help
	  This selects the Arasan Secure Digital Host Controller Interface
	  (SDHCI). This hardware is found e.g. in Xilinx' Zynq SoC.

	  If you have a controller with this interface, say Y or M here.

	  If unsure, say N.

config MMC_SDHCI_ZODIAC_SCORPIO
	tristate "SDHCI OF support for the scorpio SDHCI controllers"
	depends on MMC_SDHCI_ZODIAC
	help
	  This selects the Arasan Secure Digital Host Controller Interface
	  (SDHCI). This hardware is found e.g. in Xilinx' Zynq SoC.

	  If you have a controller with this interface, say Y or M here.

	  If unsure, say N.

config MMC_SDHCI_ZODIAC_ANDROMEDA
	tristate "SDHCI OF support for the andromeda SDHCI controllers"
	depends on MMC_SDHCI_ZODIAC
	help
	  This selects the Arasan Secure Digital Host Controller Interface
	  (SDHCI). This hardware is found e.g. in Xilinx' Zynq SoC.

	  If you have a controller with this interface, say Y or M here.

	  If unsure, say N.

config MMC_SDHCI_ZODIAC_APUS
	tristate "SDHCI OF support for the apus SDHCI controllers"
	depends on MMC_SDHCI_ZODIAC
	help
	  This selects the Arasan Secure Digital Host Controller Interface
	  (SDHCI). This hardware is found e.g. in Xilinx' Zynq SoC.

	  If you have a controller with this interface, say Y or M here.

	  If unsure, say N.

config MMC_SDHCI_MUX_SDSIM
	tristate "SDHCI MUX SDSIM supoort"
	depends on MMC_SDHCI_ZODIAC
	default n
	help
	  this select supoort for sdhci controller for sd/sim

	  If unsure, say N.

config MMC_DW_IDMAC
	bool "Internal DMAC interface"
	depends on MMC_DW
	help
	  This selects support for the internal DMAC block within the Synopsys
	  Designware Mobile Storage IP block. This disables the external DMA
	  interface.
config MMC_DW_HI3XXX
	tristate "zodiac 9Serial specific extensions for Synopsys DW Memory Card Interface"
	depends on MMC_DW
	select MMC_DW_PLTFM
	select MMC_DW_IDMAC
	default n
	help
	  This selects support for zodiac SoC specific extensions to the
	  Synopsys DesignWare Memory Card Interface driver. Select this option
	  for platforms based on zodiac 9 serial SoC's.

config MMC_DW_MUX_SDSIM
	tristate "MUX SDSIM support"
	depends on MMC_DW
	default n
	help
	  This selects support for MMC_DW MUX_SDSIM.

config MMC_DW_MUX_SDSIM_LIBRA
	tristate "MUX SDSIM support for libra platform"
	depends on MMC_DW && MMC_DW_MUX_SDSIM
	default n
	help
	  This selects support for MMC_DW MUX_SDSIM in libra platform.

config MMC_DW_EMMC_USED_AS_MODEM
	tristate "zodiac eMMC used as third_party modem for Synopsys DW Memory Card Interface"
	depends on MMC_DW && MMC_DW_HI3XXX
	default n
	help
	  This selects support for zodiac SoC use eMMC IP as the third_party to the
	  Synopsys DesignWare Memory Card Interface driver.


config MMC_DW_SD_CLK_SLOWDOWN
	tristate "zodiac specific extensions for Synopsys DW Memory Card Interface"
	depends on MMC_DW && MMC_DW_HI3XXX
	select MMC_DW_PLTFM
	default n
	help
	  This selects support for zodiac SoC specific extensions to the
	  Synopsys DesignWare Memory Card Interface driver. Select this option
	  for platforms based on zodiac 9 serial SoC's.

config MMC_CQ_HCI
	tristate "Command Queue Support"
	depends on HAS_DMA && ZODIAC_MMC
	help
	  This controller supports eMMC devices with command queue support.

	  If you have a controller with this interface, say Y or M here.

	  If unsure, say N.

config MMC_MQ_CQ_HCI
	tristate "Command Queue Support mq"
	depends on MAS_BLK
	default n
	help
	  This controller supports eMMC devices with command queue support.

	  If you have a controller with this interface, say Y or M here.

	  If unsure, say N.

config MMC_SDHCI_DWC_MSHC
	tristate "SDHCI OF support for the Synopsys controllers"
	depends on MMC_SDHCI_PLTFM
	depends on ZODIAC_MMC
	help
	  This selects Synopsys DesignWare Cores Mobile Storage Host
	  Controller(SDHCI protocol compliance). This hardware is found
	  e.g. in zodiac SoC.

	  If you have a controller with this interface, say Y or M here.

	  If unsure, say N.

config MMC_SDHCI_MSHC_LIBRA
	tristate "controllers for LIBRA"
	depends on MMC_SDHCI_DWC_MSHC
	help
	  If you have a controller for libra, say Y or M here.
	  If unsure, say N.

config EMMC_FAULT_INJECT
	tristate "eMMC Fault Inject"
	depends on FAULT_INJECTION_DEBUG_FS
	help
	  The infrastructure can be used for debugging the driver from user space
	  by injecting fault to the driver.

	  Select this if you want to enable fault injection.
	  If unsure, say N.
```

## kernel/platform_source/basicplatform/drivers/mntn/ball_crack/Kconfig
```kconfig
config BALL_CRACK_DETECT
    bool "ball crack support"
    default n
    help
      Say yes here to support the ball crack detect.
```

## kernel/platform_source/basicplatform/drivers/mntn/blackbox/platform_ap/Kconfig
```kconfig
config DFX_IRQ_REGISTER
	bool "record irq register"
	depends on DFX_BB
	default n
	help
	  This module can record irq register.

config DFX_REENTRANT_EXCEPTION
	bool "reentrant exception"
	depends on DFX_BB
	default n
	help
	  this module deal with reentrant exception.

config DFX_TIME_HOOK
	bool "support print time call trace "
	depends on DFX_BB
	default n
	help
	  Say 'Y' here if you want to print time call trace.

config OPTIMIZE_DFX_RINGBUFFER_WRITE
	bool "optimize ringbuffer write"
	default n
	help
	  this module optimze ringbuffer write

config LIBLINUX_REBOOT_WITH_SNAPSHOT
	bool "Reboot with snapshot printed in the HM kernel."
	depends on LIBLINUX
	default n

config DFX_CONTEXTHUB_LOG_SAVE
	bool "save contexthub log"
	default n
	help
	  this module save contexthub log
```
