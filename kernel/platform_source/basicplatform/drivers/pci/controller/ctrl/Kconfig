## kernel/platform_source/basicplatform/drivers/pci/controller/ctrl/Kconfig
```kconfig
#
# Kirin PCIe driver configuration
#

config HIPCIE_CTRL
	tristate "HiPCIe ctrl"
	depends on HIPCIE_CORE
	select HIPCIE_CTRL_RC
	help
	  Say Y here to enable PCIe controller support on Kirin SoCs.

config HIPCIE_CTRL_RC
	tristate "HiPCIe rc ctrl"
	depends on HIPCIE_CTRL
	help
	  Say Y here to enable PCIe rc controller support on Kirin SoCs.

config HIPCIE_CTRL_EP
	tristate "HiPCIe ep ctrl"
	depends on HIPCIE_CTRL
	help
	  Say Y here to enable PCIe ep controller support on Kirin SoCs.

config HIPCIE_CTRL_DMA
	tristate "HiPCIe ctrl dma"
	depends on HIPCIE_CTRL
	help
	  Say Y here to enable PCIe controller dma support on Kirin SoCs.
```

## kernel/platform_source/basicplatform/drivers/pci/controller/phy/Kconfig
```kconfig
#
# Kirin PCIe driver configuration
#

config HIPCIE_KPHY
	tristate "HiPCIe kphy"
	depends on HIPCIE_PHY
	help
	  Say Y here to enable PCIe kphy support on Kirin SoCs.

config HIPCIE_COMBPHY
	tristate "HiPCIe combphy"
	depends on HIPCIE_PHY
	help
	  Say Y here to enable PCIe combphy support on Kirin SoCs.
```

## kernel/platform_source/basicplatform/drivers/pci/controller/plat/Kconfig
```kconfig
#
# Kirin PCIe driver platform configuration
#
config HIPCIE_IDLE
	tristate "HiPCIe IDLE"
	depends on HIPCIE_CORE
	help
	  Say Y here to enable PCIe Idle support on Kirin Soc.

config HIPCIE_OCT
	tristate "HiPCIe controller-Oct"
	select HIPCIE_CORE
	select HIPCIE_CTRL
	select HIPCIE_PHY

config HIPCIE_NSV
	tristate "HiPCIe controller-Nsv"
	select HIPCIE_CORE
	select HIPCIE_CTRL
	select HIPCIE_PHY
```

## kernel/platform_source/basicplatform/drivers/pci/controller/test/Kconfig
```kconfig
#
# Kirin PCIe driver configuration
#

config HIPCIE_TEST
	tristate "HiPCIe test"
	depends on HIPCIE_CTRL
	depends on HIPCIE_PHY
	help
	  Say Y here if you want to use testcases for PCIe controller on Kirin SoCs.

config HIPCIE_SLT
	tristate "HiPCIe slt"
	depends on HIPCIE_CORE
	help
	  Say Y here to enable PCIe Slt test.
```

## kernel/platform_source/basicplatform/drivers/pci/controller/vm/Kconfig
```kconfig
#
# Kirin PCIe driver platform configuration
#

config HIPCIE_VM_IOCTL
	tristate "HiPCIe controller-vm-ioctl"
	depends on HIPCIE_VM_CORE

config HIPCIE_VM_CTRL
	tristate "HiPCIe controller-vm-ctrl"
	depends on HIPCIE_VM_CORE

config HIPCIE_VM_OCT
     tristate "HiPCIe controller-Oct"
     depends on HIPCIE_VM_CORE
```

## kernel/platform_source/basicplatform/drivers/phy/Kconfig
```kconfig
# SPDX-License-Identifier: GPL-2.0-only
#
# PHY
#

source "platform_source/basicplatform/drivers/phy/hisilicon/Kconfig"

config PHY_HISI_USB2_T5
	tristate "USB2 PHY T5 support"
	select GENERIC_PHY
	select MFD_SYSCON
	help
	  Enable this to support the HISILICON USB2 T5 PHY.
	  To compile this driver as a module, choose M here.

config PHY_HISI_USB3_LITE
	tristate "HISI USB3 Lite PHY support"
	select GENERIC_PHY
	select MFD_SYSCON
	help
	  Enable this to support the HISILICON USB3 Lite PHY.
	  To compile this driver as a module, choose M here.
```

## kernel/platform_source/basicplatform/drivers/power/Kconfig
```kconfig
config POWER_PLATFORM
    bool "platform power charger/coul driver"
	default n
	help
	  support platform power charger/coul driver

if POWER_PLATFORM
source "platform_source/basicplatform/drivers/power/platform/Kconfig"
endif
```

## kernel/platform_source/basicplatform/drivers/power/platform/Kconfig
```kconfig
config BATTERY_DATA
	bool "battery data"
	default n

config BCI_BATTERY
        bool "bci battery"
        default n

config CHARGE_TIME
        bool "Calculate the remaining time of charging"
        default n

config BATTERY_ISCD
        bool "battery iscd module"
        default n

config BATTERY_SYSFS
	bool "battery power sysfs control"
	default n

-source "platform_source/basicplatform/drivers/power/platform/charger/Kconfig"
source "platform_source/basicplatform/drivers/power/platform/coul/Kconfig"
-source "platform_source/basicplatform/drivers/power/platform/soh/Kconfig"
-source "platform_source/basicplatform/drivers/power/platform/eis/Kconfig"
-source "platform_source/basicplatform/drivers/power/platform/polar/Kconfig"
```

## kernel/platform_source/basicplatform/drivers/power/platform/charger/Kconfig
```kconfig
config SCHARGER
	bool "scharger driver"
	default n
	help
	  Compiling the platform/charger.
config SCHARGER_ARCH
	bool "scharger arch"
	default n
	help
	  enable scharger core.
config SCHARGER_V200
	bool "schargerV200"
	default n
config SCHARGER_V300
	bool "schargerV300"
	default n
config SCHARGER_V600
	bool "schargerV600"
	default n
config CHARGER_SYS_WDG
	bool "pmic charger sys watchdog"
	default n
config CHARGER_WDG
	bool "pmic charger watchdog"
	default n
config SCHARGER_SCP_PROTOCOL
	bool "scharger scp protocol"
	default n
config SCHARGER_DYNAMIC_CV
	bool "scharger dynamic cv"
	default n
config HISI_UFCS_DRV
	bool "scharger ufcs protocol"
	default n
config HISI_FCP_DRV
	bool "scharger fcp protocol"
	default n
config SCHARGER_V800
	bool "schargerV800"
	default n
```

## kernel/platform_source/basicplatform/drivers/power/platform/coul/Kconfig
```kconfig
config COUL_DRV
        bool "pmic coul"
        default n

config COUL_TEST
        bool "coul test"
        default n

config COUL_ALGORITHM_CORE
        bool "coul algorithm"
        default n

source "platform_source/basicplatform/drivers/power/platform/coul/coul_core/Kconfig"
```

## kernel/platform_source/basicplatform/drivers/power/platform/eis/Kconfig
```kconfig
config BATT_EIS
	bool "batt eis"
	default n
	help
	  Electrochemical Impedance Spectroscopy.

if BATT_EIS
config BATT_EIS_FREQ
	bool "batt eis freq"
	default n
	help
	  batt eis frequency domain method.

config BATT_EIS_TIME
	bool "batt eis time"
	default n
	help
	   batt eis time domain method.

config BATT_EIS_WAVELET
	bool "batt eis wavelet"
	default n
	help
	  batt eis wavelet method.
endif

-source "platform_source/basicplatform/drivers/power/platform/eis/pmic/Kconfig"
-source "platform_source/basicplatform/drivers/power/platform/eis/scharger/Kconfig"
```

## kernel/platform_source/basicplatform/drivers/power/platform/eis/scharger/Kconfig
```kconfig
config BATT_EIS_SCHARGER
	bool "batt eis hardware in scharger"
	default n
	depends on BATT_EIS
	help
	  hardware in scharger for eis.
```

## kernel/platform_source/basicplatform/drivers/pwm/Kconfig
```kconfig
# SPDX-License-Identifier: GPL-2.0

config PWM_HISI
	bool "hisilicon kirin pwm"
	default n

config BLPWM
	bool "hisilicon kirin pwm"
	default n

config BLPWM_TEST
	bool "hisilicon kirin pwm"
	depends on BLPWM
	help
		This keep blpwm_test case open or not.
		If unsure, say n.
```

## kernel/platform_source/basicplatform/drivers/qic/Kconfig
```kconfig
config DFX_SEC_QIC
	bool "Support Secure QIC"
	default n
	help
	  This driver supports xxx secure QIC,
	  including qic driver
config DFX_SEC_QIC_V100
	depends on DFX_SEC_QIC
	bool "Support Secure QIC V100"
	default n
	help
	  Support Secure QIC V100
config DFX_SEC_QIC_V100_MODID_REGISTER
	depends on DFX_SEC_QIC_V100
	bool "Support Secure QIC V100 modid register"
	default n
	help
	  Support Secure QIC V100 modid register
config DFX_SEC_QIC_V300
	depends on DFX_SEC_QIC
	bool "Support Secure QIC V300"
	default n
	help
	  Support Secure QIC V300
config DFX_SEC_QIC_V300_MODID_REGISTER
	depends on DFX_SEC_QIC_V300
	bool "Support Secure QIC V300 modid register"
	default n
	help
	  Support Secure QIC V300 modid register
```

## kernel/platform_source/basicplatform/drivers/rpmb/Kconfig
```kconfig
menu "RPMB support"

config VENDOR_RPMB
	bool "rpmb"
	default n
	help
	   config rpmb driver

config RPMB_MMC
	bool "rpmb mmc"
	depends on VENDOR_RPMB && ZODIAC_MMC
	default n
	help
	   config mmc rpmb driver

config RPMB_UFS
	bool "rpmb ufs"
	depends on VENDOR_RPMB && SCSI_HUFS
	default n
	help
	   config ufs rpmb driver

config RPMB_STORAGE_INTERFACE
	bool "storage interface"
	depends on VENDOR_RPMB
	default n
	help
	   config rpmb storage interface

config RPMB_SET_MULTI_KEY
	bool "rpmb set multi key"
	depends on VENDOR_RPMB
	default n
	help
	   config rpmb set multi key

config RPMB_DEBUG_FS
	bool "rpmb debugfs"
	depends on VENDOR_RPMB
	default n
	help
	   config rpmb debug

config RPMB_TIME_DEBUG
	bool "rpmb time debug"
	depends on VENDOR_RPMB
	default n
	help
	   config rpmb time debug

config RPMB_KEY_ENABLE
	bool "rpmb key enable"
	depends on VENDOR_RPMB
	default n
	help
	   config rpmb key enable

config RPMB_DMD_REPORT
	bool "rpmb dmd report"
	depends on VENDOR_RPMB
	default n
	help
	   config rpmb dmd report

config RPMB_SHARE_MEM
	bool "rpmb share mem addr config in DTS"
	depends on VENDOR_RPMB
	default n
	help
	   config rpmb share mem addr config in DTS

config RPMB_FFA_SUPPORT
	bool "rpmb ffa support"
	depends on RPMBMSPC_SUPPORT_FFA
	default n
	help
	   config rpmb ffa support

config RPMB_REQ_LOCK_DISABLE
	bool "rpmb req lock disable"
	depends on VENDOR_RPMB
	default n
	help
	   disable rpmb counter lock and cmd lock

config UFS_RPMB_SUPPORT_FROM_TEEOS_IN_KERNEL
	bool "support call from teeos in kernel"
	depends on HIBERNATION
	default n
	help
	   support call from teeos in kernel
endmenu
```
