## kernel/platform_source/basicplatform/drivers/scsi/ufs/Kconfig
```kconfig
config VENDOR_UFS
	tristate "vendor ufs"
	help
	This selects use VENDOR UFS.

config HUFS_HC
	tristate "HUFS Host Controller"
	help
	This selects use HUFS host controller.

config HUFS_HC_CORE_UTR
	depends on HUFS_HC
	tristate "HUFS Host Controller Core Utrs Instead Of Spec Utrs"
	help
		This selects use HUFS host controller Core Utr.

config SCSI_HUFS
	  tristate "UFS Host Controller Driver"
	  depends on SCSI_UFSHCD && SCSI_UFSHCD_PLATFORM
	  help
	  This selects the UFS host controller driver.
	  If you have a controller with this interface, say Y or M here.
	  If unsure, say N.

config SCSI_UFS_TAURUS
	  tristate "UFS Host TAURUS Controller Driver"
	  depends on SCSI_UFSHCD && SCSI_UFSHCD_PLATFORM && SCSI_HUFS
	  help
	  This selects the UFS TAURUS host controller driver.

	  If you have a controller with this interface, say Y or M here.

	  If unsure, say N.

config SCSI_UFS_PISCES
	  tristate "UFS Host PISCES Controller Driver"
	  depends on SCSI_UFSHCD && SCSI_UFSHCD_PLATFORM && SCSI_HUFS
	  help
	  This selects the UFS PISCES host controller driver.
	  If you have a controller with this interface, say Y or M here.
	  If unsure, say N.

config SCSI_UFS_SCORPIO
	  tristate "UFS Host SCORPIO Controller Driver"
	  depends on SCSI_UFSHCD && SCSI_UFSHCD_PLATFORM && SCSI_HUFS
	  help
	  This selects the UFS SCORPIO host controller driver.
	  If you have a controller with this interface, say Y or M here.
	  If unsure, say N.

config SCSI_UFS_AQUILA
	  tristate "UFS Host aquila Controller Driver"
	  depends on SCSI_UFSHCD && SCSI_UFSHCD_PLATFORM && SCSI_HUFS
	  help
	  This selects the UFS SCORPIO host controller driver.
	  If you have a controller with this interface, say Y or M here.
	  If unsure, say N.

config SCSI_UFS_ARA
	  tristate "UFS Host qra Controller Driver"
	  depends on SCSI_UFSHCD && SCSI_UFSHCD_PLATFORM && SCSI_HUFS
	  help
	  This selects the UFS SCORPIO host controller driver.
	  If you have a controller with this interface, say Y or M here.
	  If unsure, say N.

config SCSI_UFS_INTR_HUB
	  tristate "UFS Host Intr Hub Support"
	  depends on SCSI_UFSHCD && SCSI_UFSHCD_PLATFORM && SCSI_HUFS
	  help
	  This selects the hufs intr hub.

	  If you have a controller with this interface, say Y or M here.

	  If unsure, say N.

config SCSI_UFS_LIBRA
        tristate "UFS Host LIBRA Controller Driver"
        depends on SCSI_UFSHCD && SCSI_UFSHCD_PLATFORM && SCSI_HUFS
        help
        This selects the UFS LIBRA host controller driver.

        If you have a controller with this interface, say Y or M here.

        If unsure, say N.

config SCSI_UFS_ENHANCED_INLINE_CRYPTO
       tristate "UFS inline crytpo driver based on HUFS Host Controller (enhanced)"
       depends on SCSI_UFS_INLINE_CRYPTO

       help
       This selects the HUFS inline enhanced crypto driver.

       Select this if you want to use Hardware Crypto Engine
       and using its interface for some special cryto func.
       Otherwise, if you love my driver code, say Y or M here.

       If unsure, say N.

config SCSI_UFS_ENHANCED_INLINE_CRYPTO_V2
       tristate "UFS inline crytpo driver based on HUFS Host Controller (enhanced v2)"
       depends on SCSI_UFS_ENHANCED_INLINE_CRYPTO

       help
       This selects the HUFS inline enhanced crypto driver V2.

       Select this if you want to use Hardware Crypto Engine
       and using its interface for some special cryto func.
       Otherwise, if you love my driver code, say Y or M here.

       If unsure, say N.

config SCSI_UFS_ENHANCED_INLINE_CRYPTO_V3
       tristate "UFS inline crytpo driver based on HUFS Host Controller (enhanced v3)"
       depends on FILE_BASED_ENCRYPTO
       depends on SCSI_UFS_ENHANCED_INLINE_CRYPTO_V2

       help
       This selects the HUFS inline enhanced crypto driver V3.

       Select this if you want to use Hardware Crypto Engine
       and using its KDF function for some special cryto func.
       Otherwise, if you love my driver code, say Y or M here.

       If unsure, say N.

config SCSI_UFS_LEO
	 tristate "UFS Host LEO Controller Driver"
	 depends on SCSI_UFSHCD && SCSI_UFSHCD_PLATFORM && SCSI_HUFS
	 help
	 This selects the UFS LEO host controller driver.
	 If you have a controller with this interface, say Y or M here.
	 If unsure, say N.

config SCSI_UFS_SGR
	 tristate "UFS Host SGR Controller Driver"
	 depends on SCSI_UFSHCD && SCSI_UFSHCD_PLATFORM && SCSI_HUFS
	 help
	 This selects the UFS SGR host controller driver.
	 If you have a controller with this interface, say Y or M here.
	 If unsure, say N.

config SCSI_UFS_ANTLIA
	 tristate "UFS Host ANTLIA Controller Driver"
	 depends on SCSI_UFSHCD && SCSI_UFSHCD_PLATFORM && SCSI_HUFS
	 help
	 This selects the UFS ANTLIA host controller driver.
	 If you have a controller with this interface, say Y or M here.
	 If unsure, say N.

config HUFS_MANUAL_BKOPS
	bool "hisi manual BKOPS support for UFS"
	depends on MAS_BKOPS && SCSI_UFSHCD
	default n

config SCSI_UFS_CUST_MAX_SECTORS
	bool "enable custom max sectors in UFS"
	depends on SCSI_UFSHCD && MAS_BLK
	default n
	help
	   enable custom max sectors in UFS

config SCSI_UFS_HI1861_VCMD
	bool "UFS Hi1861 Device Vendor Command"
	depends on SCSI_UFSHCD
	help
		This adds UFS Hufs Device defined vendor command.
		contained that query fsr and so on.

config SCSI_HUFS_MQ_DEFAULT
	bool "Active MAS UFS MQ as default IO Scheduler"
	default n
	help
	   Active MAS UFS MQ as default IO Scheduler

config SCSI_UFS_SYNCCACHE_RECORD
	bool "UFS sync cache status record"
	depends on SCSI_UFSHCD

config SCSI_UFS_UNISTORE
	bool "enable unistore in UFS"
	depends on SCSI_UFSHCD && SCSI_UFS_HI1861_VCMD
	default n
	help
		This enable unistore in UFS.

config SCSI_UFS_INLINE_CRYPTO
	tristate "UFS inline crytpo driver based on HUFS Host Controller"
	depends on SCSI_UFSHCD && SCSI_HUFS
	help
	This selects the HUFS inline crypto driver.

	Select this if you want to use Hardware Crypto Engine
	and using its interface for some special cryto func.
	Otherwise, if you love my driver code, say Y or M here.

	If unsure, say N.

config SCSI_UFS_ENHANCED_INLINE_CRYPTO
	tristate "UFS inline crytpo driver based on HUFS Host Controller (enhanced)"
	depends on SCSI_UFS_INLINE_CRYPTO
	help
	This selects the HUFS inline enhanced crypto driver.

	Select this if you want to use Hardware Crypto Engine
	and using its interface for some special cryto func.
	Otherwise, if you love my driver code, say Y or M here.

	If unsure, say N.

config SCSI_UFS_ENHANCED_INLINE_CRYPTO_V2
	tristate "UFS inline crytpo driver based on HUFS Host Controller (enhanced v2)"
	depends on SCSI_UFS_ENHANCED_INLINE_CRYPTO
	help
	This selects the HUFS inline enhanced crypto driver V2.

	Select this if you want to use Hardware Crypto Engine
	and using its interface for some special cryto func.
	Otherwise, if you love my driver code, say Y or M here.

	If unsure, say N.

config SCSI_UFS_ENHANCED_INLINE_CRYPTO_V3
	tristate "UFS inline crytpo driver based on HUFS Host Controller (enhanced v3)"
	depends on FILE_BASED_ENCRYPTO || LIBLINUX
	depends on SCSI_UFS_ENHANCED_INLINE_CRYPTO_V2
	help
	This selects the HUFS inline enhanced crypto driver V3.

	Select this if you want to use Hardware Crypto Engine
	and using its KDF function for some special cryto func.
	Otherwise, if you love my driver code, say Y or M here.

	If unsure, say N.

config SCSI_UFS_ENHANCED_INLINE_CRYPTO_KM
	tristate "UFS inline crytpo driver based on HUFS Host Controller (enhanced km)"
	depends on FILE_BASED_ENCRYPTO || LIBLINUX
	depends on SCSI_UFS_ENHANCED_INLINE_CRYPTO_V3
	help
	This selects the HUFS inline enhanced crypto driver km.

	Select this if you want to use Hardware Crypto Engine
	and using its KDF function for some special cryto func.
	Otherwise, if you love my driver code, say Y or M here.

	If unsure, say N.

config HUAWEI_UFS_DSM
	bool "Listen UFS Kernel Error"
	depends on SCSI_UFSHCD

config HUAWEI_UFS_TRACE
	bool "Trace UFS kernel Error"
	depends on SCSI_UFSHCD

config HUAWEI_UFS_VENDOR_MODE
	bool "Enter UFS vendor mode"
	depends on SCSI_UFSHCD

config SCSI_UFS_FAULT_INJECT
	tristate "UFS Fault Inject"
	depends on SCSI_UFSHCD && FAULT_INJECTION && FAULT_INJECTION_DEBUG_FS
	help
	This adds the UFS Fault Inject Interface to the ufshcd.
	The infrastructure can be used for debugging the driver from user space
	by injecting fault to the driver.

	Select this if you want to enable fault injection.
	If unsure, say N.

config SCSI_DISK_PARTITION_DRIFT
	tristate "disk partition drift"
	depends on SCSI

config SCSI_UFS_GEAR_CTRL
	bool "UFS gear control support"
	default n
	help
	This selects the ufs support gear ctrl ability.

config HUFS_BOOTROM_MODE
	bool "UFS BootRom Mode"
	depends on HUFS_HC && BOOTDEVICE
	default n
	help
	Select this if you want to enable the capability of UFS switching to
	HSG1 in onchiprom stage.

config HUFS_BOOTROM_MODE_NO_CHARGER
	bool "UFS BootRom Mode without Charger Check"
	depends on HUFS_BOOTROM_MODE
	default n
	help
	Select this if you want to stop charger check.

config UFS_FFA_SUPPORT
	bool "ufs ffa support"
	depends on ARM_FFA_TRANSPORT && PLATDRV_SUPPORT_FFA
	default n
	help
	   config ufs ffa support

config UFS_2DW_PRDT
	bool "UFS 2dw prdt"
	depends on HUFS_HC
	help
	This selects the ufs 4.0 version support.

	Select this if host support 4.0 spec, the OoO feature depend on 2dw prdt selected.
	if device OoO opened, cannot be closed never.

config UFS_4_0_HC
	bool "UFS 4.0 host"
	depends on HUFS_HC
	help
	This selects the ufs 4.0 version support.

	Select this if host support 4.0 spec, the OoO feature depend on 4.0 host selected.

config DFA_MCQ
	bool "DFA MCQ driver"
	depends on UFS_4_0_HC && MAS_MCQ
	help
	This selects the dfa driver support.

config SCSI_UFS_VIRTUALIZ_AGENT
	tristate "UFS virtualization agent"
	depends on (VIRTIO_BLK || SCSI_VIRTIO) && (SCSI_UFS_INLINE_CRYPTO || RPMB_UFS || AB_PARTITION_TABLE)
	help
	This selects the ufs virtualization agent.

	Select this if you want to use storage virtualization
	based on virtio-blk or virtio-scsi.

	If unsure, say N.

config SCSI_UFS_VIRTUALIZ_SERVICE
	tristate "UFS virtualization service"
	depends on LIBLINUX && SCSI_UFSHCD
	help
	This selects the ufs virtualization service.

	Select this if you want to use storage virtualization
	based on virtio-blk or virtio-scsi.

	If unsure, say N.

config SCSI_UFS_SMMU
	bool "UFS smmu enable"
	depends on HUFS_HC && MM_SMMU_V3
	default n
	help
	Select this if you want to enable ufs smmu.

config UFS_H8_IDLE_3MS
	bool "UFS H8 IDLE 3MS enable"
	default n
	help
	Select this if you want to enable ufs h8 idle time 3ms.
```

## kernel/platform_source/basicplatform/drivers/sdcu/Kconfig
```kconfig
config MM_SDCU
	bool "System Data Compress Unit"
	help
	  Enable SDCU.
	  When enabling this macro, SDCU hardware will be used
	  to perform page compress/decompress operations.
	  If unsure, say N here.

config MM_SDCU_STATISTICS
	bool "Display SDCU Statistics"
	depends on MM_SDCU
	help
	  Enable SDCU statistics display interface.

config MM_SDCU_TEST
	bool "SDCU Unit Test"
	depends on MM_SDCU
	help
	  Enable SDCU Unit Test.
	  If unsure, say N here.

config CRYPTO_SDCU
	tristate "System Data Compression Unit Algorithm"
	depends on MM_SDCU
	select CRYPTO_ALGAPI
	help
	  This is the sdcu algorithm registered in crypto.
```

## kernel/platform_source/basicplatform/drivers/secmem/Kconfig
```kconfig
config MEMORY_VLTMM
	bool "Enable mm secure memory dynamic allocate"
	depends on DMABUF_MM
	help
	  Support allocate secure volatile memory form secos.

config MM_SECMEM_TEST
	bool "sec memory alloc test"
	depends on DMABUF_HEAPS_SECSG
	help
	  Only for sec memory alloc test in develop version.
```

## kernel/platform_source/basicplatform/drivers/spi_nor_agent/Kconfig
```kconfig
config SPI_NOR_AGENT
	bool "spi nor agent support"
	default n
	help
	  Say Y here if support spi nor agent.
```

## kernel/platform_source/basicplatform/drivers/usb/dwc3/chip/Kconfig
```kconfig
config USB_DWC3_CHIP
	tristate "Platforms"
	default USB_DWC3
	select CHIP_USB_HELPER
	select CHIP_USB_REG_CFG
	help
	  Support of USB2/3 functionality in platforms,
	  Say 'Y' or 'M' here if you have one such device.

config CONTEXTHUB_PD
	bool "Sensor CONTEXTHUB PD driver"
	default n
	help
	  Say yes here if you want to use contexthub pd function

if CONTEXTHUB_PD
config CHIP_COMBOPHY
	tristate "CHIP_COMBOPHY driver"
	default n
	help
	  Support of USB2/3/3.1 functionality in platforms,
	  Say 'Y' or 'M' here if you have one such device.
endif # CONTEXTHUB_PD

if USB_DWC3_CHIP

config USB_DWC3_NOV
       tristate "Platforms NOV USB"
       default n
       help
         Support of USB2 functionality in platforms,
         Say 'Y' or 'M' here if you have one such device.

config USB_DWC3_OCT
       tristate "Platforms OCT USB"
       default n
       help
         Support of USB2 functionality in platforms,
         Say 'Y' or 'M' here if you have one such device.

config USB_DWC3_SEP
       tristate "Platforms SEP USB"
       default n
       help
         Support of USB2 functionality in platforms,
         Say 'Y' or 'M' here if you have one such device.

config USB_DWC3_AUG
       tristate "Platforms AUG USB"
       default n
       help
         Support of USB2 functionality in platforms,
         Say 'Y' or 'M' here if you have one such device.

config USB_DWC3_APR
	tristate "Platforms APR USB"
	select CHIP_USB_XHCI_HUB_PORT_DIS
	default n
	select CHIP_USB_REG_CFG
	help
	  Support of USB2/3/3.1 functionality in platforms,
	  Say 'Y' or 'M' here if you have one such device.

config USB_DWC3_MAR
	tristate "Platforms MAR USB"
	select CHIP_USB_XHCI_HUB_PORT_DIS
	default n
	select CHIP_USB_REG_CFG
	help
	  Support of USB2/3/3.1 functionality in platforms,
	  Say 'Y' or 'M' here if you have one such device.

config CHIP_USB_NEW_FRAME
       tristate "USB new hardware config frame for Platforms"
       default n
       help
         Support for new usb phy and controller config frame for USB
         Say 'Y' or 'M' here if you have one such device.

config VENDOR_USB_CLASS_NAME
       string "VENDOR USB CLASS NAME"
       default "soc_usb_class"
       help
         Chip usb for usb_class_name.

config VENDOR_USB_DEV_NAME
       string "VENDOR USB DEV NAME"
       default "soc_usb_dev"
       help
         Chip usb for usb_dev_name.

config PD_NOTIFY_TEMPORARY
       tristate "Q release branch temporary use for device"
       default n
       help
         Say yes here set the device on as the default for USB.

endif # USB_DWC3_CHIP
```

## kernel/platform_source/basicplatform/drivers/usb/hiusb/Kconfig
```kconfig
# SPDX-License-Identifier: GPL-2.0
config USB_HIUSB
	tristate "HIUSB Support"
	depends on USB
	help
	  Say Y or M here if your system has USB Hardware based on the HIUSB.

	  If you choose to build this driver is a dynamically linked
	  module, the module will be called hiusb.ko.
config HIUSB_SUPPORT_FFA
	tristate "HIUSB Support"
	depends on USB_HIUSB && PLATDRV_SUPPORT_FFA
	help
	  Say Y here to enable hiusb FFA.
```

## kernel/platform_source/basicplatform/drivers/usb/pd/Kconfig
```kconfig
config USB_VBUS_CTRL
	bool "Hisilicon USB type-c rt1711 power controller"
	depends on TCPC_CLASS
	help
	  Say Y to enable rt1711 vbus gpio control power

config CS32G_USB_PD
	bool "Cs32g050 Usb Pd Driver"
	help
	  Say Y to enable Cs32g050 Usb Pd Driver
```
