## kernel/drivers/huawei_platform/sparklink/Kconfig
```kconfig
#
# huawei sparklink configuration
#

config HUAWEI_SPARKLINK
	bool "huawei sparklink"
	default n
	help
	  If you say yes here you get support for huawei spartlink.

config HUAWEI_1162
	bool "huawei 1162 device support"
	default n
	depends on HUAWEI_SPARKLINK
	help
	  If you say yes here you get support for huawei 1162 device.

config HUAWEI_SPARKLINK_UART
	bool "huawei sparklink uart"
	default n
	depends on HUAWEI_SPARKLINK
	help
	  If you say yes here you get support for huawei spartlink uart.
```

## kernel/drivers/huawei_platform/touthscreen/touchpad/Kconfig
```kconfig
#
# huawei touchpad drivers  configuration
#

config HUAWEI_TOUCHPAD
	bool "huawei touchpad drvier"
	default n
	help
	  huawei touchpad drivers
```

## kernel/drivers/huawei_platform/usb/check_usbmode/Kconfig
```kconfig
#
# check usbmode for usb drivers
#

config CHECK_USBMODE
	bool "CHECK_USBMODE support"
	default n
	help
	  Say Y here to enable check usbmode for usb driver.
```

## kernel/drivers/huawei_platform/usb/net/Kconfig
```kconfig
#
# USB Network devices configuration
#

config USB_RTL8153
	tristate "Realtek RTL8153 driver Based USB Ethernet Adapters"
	depends on USB_NET_DRIVERS
	select MII
	select CRC32
	select CRYPTO
	select CRYPTO_HASH
	select CRYPTO_SHA256
	help
	  This option adds support for RTL8153 based USB
	  Ethernet adapters.

	  To compile this driver as a module, choose M here: the
	  module will be called r8153.
```

## kernel/drivers/huawei_platform/usb/usbhub/Kconfig
```kconfig
#sensor unification for differ platform
menuconfig ARMPC_USB_HUB
	bool "armpc usb hub device"
	default n
	help
	Say yes here to support usb hub for Kirin PC.
```

## kernel/drivers/huawei_platform/uwb/Kconfig
```kconfig
menu "UWB (Ultra-Wideband)"
menuconfig UWB_DEVICES
	tristate "Ultra-Wideband (UWB) devices"
	default n
	help
	  You'll have to say Y if your computer contains an UWB device that
	  you want to use under Linux.

	  You can say N here if you don't have any UWB devices connected to your computer.

source "drivers/huawei_platform/uwb/zl1500/Kconfig"

endmenu
```

## kernel/drivers/huawei_platform/uwb/zl1500/Kconfig
```kconfig
# SPDX-License-Identifier: GPL-2.0-only
#
# SPI driver configuration
#
menuconfig SPI_FR8000
	tristate "FR8000 UWB SPI driver"
	help
	  This supports FR8000 UWB device.
```

## kernel/drivers/huawei_platform/vibrator/pmu_vibrator/Kconfig
```kconfig
config PMU_LINEAR_HAPTIC_EVADE
	bool "pmu linear haptic evade schedule"
	depends on LINEAR_VIBRATOR
	default n
	help
	  Say yes here to support the linear haptic evade schedule.
```

## kernel/drivers/hwbootfail/Kconfig
```kconfig
#
# huawei device state monitor configuration
#

config BOOT_DETECTOR_SINGLE_FRAME
	bool "Boot Detector in single frame"
	default n
	help
	  If you say yes here you get support for huawei Boot Detector solution in single frame.

config SHUT_DETECTOR
	bool "Shut Detector"
	default n
	help
	  If you say yes here you get support for huawei Shut Detector solution.

config BOOT_DETECTOR
	tristate "Boot Detector"
	default n
	help
	  If you say yes here you get support for huawei Boot Detector solution.

config BOOT_DETECTOR_HISI
	bool "Boot Detector for hisi"
	default n
	help
	  If you say yes here you get support for huawei Boot Detector solution on hisi.

config BOOT_DETECTOR_QCOM
	tristate "Boot Detector for qcom"
	default n
	help
	  If you say yes here you get support for huawei Boot Detector solution on qcom.

config BOOT_DETECTOR_MTK
	bool "Boot Detector for mtk"
	default n
	help
	  If you say yes here you get support for huawei Boot Detector solution on mtk.

config BOOT_DETECTOR_MTK_4G
	bool "Boot Detector for mtk-4g"
	default n
	help
	  If you say yes here you get support for huawei Boot Detector solution on mtk-4g.

config BOOT_DETECTOR_HONGHU
	bool "Boot Detector for honghu"
	default n
	help
	  If you say yes here you get support for huawei Boot Detector solution on honghu.

config BOOT_DETECTOR_NVT
	bool "Boot Detector for NVT"
	default n
	help
	  If you say yes here you get support for huawei Boot Detector solution on nvt.

config BOOT_RECOVERY
    bool "use Boot Recovery"
    default n
    help
      If you say yes here you get support for huawei Boot Recovery solution

config BOOT_DETECTOR_DBG
        tristate "Boot Detector debug"
        default n
        help
          If you say yes here you get support for huawei Boot Detector debug.

config ARCH_TARO
        tristate "Arch Taro"
        default n
        help
          If you config this it implents you are using taro
```

## kernel/drivers/hwhungtask/Kconfig
```kconfig
#
# DFX enhanced options for hungtask
#
config DFX_HUNGTASK
	bool "DFX hungtask module"
	depends on DETECT_HUNG_TASK
	default n
	help
	  base DFX hungtask module

config DFX_HUNGTASK_EXT
	bool "DFX hungtask extention module"
	depends on DFX_HUNGTASK
	default n
	help
	  Extention DFX hungtask module

config DFX_HUNGTASK_USER
	bool "DFX hungtask user watchdog module"
	depends on DFX_HUNGTASK
	default n
	help
	  DFX User watchdog hungtask module

config DFX_HUNGTASK_MMAP_SEM
	bool "DFX hungtask mmap semaphore module"
	depends on DFX_HUNGTASK
	default n
	help
	  DFX hungtask mmap semaphore module

config DFX_HUNGTASK_MMAP_SEM_DBG
	bool "DFX hungtask mmap semaphore debug module"
	depends on DFX_HUNGTASK_MMAP_SEM
	default n
	help
	  DFX hungtask mmap semaphore debug module
```

## kernel/drivers/hwmemcheck/Kconfig
```kconfig
config DFX_MEMCHECK
	depends on (HW_LOGGER || HIEVENT)
	bool "DFX memory checker module"
	default n
	help
	  This feature support memory leak check

config DFX_MEMCHECK_STACK
	depends on DFX_MEMCHECK
	bool "DFX memory checker stack info module"
	default n
	help
	  This feature support getting stack info
```

## kernel/drivers/hwnet/hwril_sim_sd/Kconfig
```kconfig
config SIM_SD_MUX
        tristate "kernel sim2 and nmc share same tray"
    default n
    help
          This module adds support for sim2 & sd share same tray
```

## kernel/drivers/hwpower/cc_battery/Kconfig
```kconfig
# SPDX-License-Identifier: GPL-2.0
#
# huawei battery drivers
#

config HUAWEI_BATTERY_CORE
	bool "huawei battery core driver"
	default n
	help
	  Say Y here to enable battery core driver.
	  This driver updates the basic informations of battery
	  through battery model and coul interface, and provides
	  interface for application layer through power supply.

config HUAWEI_MIXED_BATT
	bool "huawei mixed battery power supply"
	help
	  Say Y here to enable support for battery
	  power supply. this module cooperate with multi
	  sub battery power supply for third party
	  fuelguage IC to monitor battery status.

source "drivers/hwpower/cc_battery/battery_ocv/Kconfig"
source "drivers/hwpower/cc_battery/battery_cccv/Kconfig"
source "drivers/hwpower/cc_battery/battery_model/Kconfig"
source "drivers/hwpower/cc_battery/battery_fake/Kconfig"
source "drivers/hwpower/cc_battery/battery_fault/Kconfig"
source "drivers/hwpower/cc_battery/battery_ui_capacity/Kconfig"
source "drivers/hwpower/cc_battery/battery_soh/Kconfig"
source "drivers/hwpower/cc_battery/battery_temp/Kconfig"
source "drivers/hwpower/cc_battery/battery_type_identify/Kconfig"
source "drivers/hwpower/cc_battery/battery_1s2p/Kconfig"
source "drivers/hwpower/cc_battery/battery_charge_balance/Kconfig"
source "drivers/hwpower/cc_battery/battery_cycle/Kconfig"
source "drivers/hwpower/cc_battery/battery_adc_monitor/Kconfig"
```

## kernel/drivers/hwpower/cc_battery/battery_adc_monitor/Kconfig
```kconfig
# SPDX-License-Identifier: GPL-2.0
#
# Huawei battery current configuration
#

config HUAWEI_BATTERY_ADC_MONITOR
	bool "battery adc monitor"
	default n
	help
	  Say Y here to enable battery adc monitor support.
	  Support battery adc monitor management.
	  Compatible with coul driver.
```

## kernel/drivers/hwpower/cc_battery/battery_cccv/Kconfig
```kconfig
# SPDX-License-Identifier: GPL-2.0
#
# huawei battery cccv driver
#

config HUAWEI_BATTERY_CCCV
	bool "huawei battery cccv driver"
	default n
	help
	  Say Y here to enable battery cccv driver.
	  This driver provides a unified interface to
	  get battery max current.
```

## kernel/drivers/hwpower/cc_battery/battery_charge_balance/Kconfig
```kconfig
# SPDX-License-Identifier: GPL-2.0
#
# huawei multi batteries charge balance driver
#

config HUAWEI_BATTERY_CHARGE_BALANCE
	bool "huawei multi batteries balance driver"
	default n
	help
	  Say Y here to enable huawei parallel or serial connection of multi batteries driver.
	  It monitor multi battery infomation and provid multi battery power supply.
	  It merge multi battery infomation for battery power supply.
```

## kernel/drivers/hwpower/cc_battery/battery_cycle/Kconfig
```kconfig
# SPDX-License-Identifier: GPL-2.0
config HUAWEI_BATTERY_CYCLE
	bool "huawei battery cycle"
	default n
	help
	  Say Y here to enable battery cycle normalize driver.
	  This driver is an adaptation layer. It provides
	  channels for modules in the native layer to retrieve
	  relevant data from kernel.
```

## kernel/drivers/hwpower/cc_battery/battery_fake/Kconfig
```kconfig
# SPDX-License-Identifier: GPL-2.0
#
# huawei faulty coul recovery drive
#

config HUAWEI_BATTERY_FAKE
	bool "huawei faulty coul recovery drive"
	default n
	help
	  There is a possibility that the CW and RT coul fail, resulting in charging failure.
	  Adjust the coul by analog coul drive to correct the charging function
```

## kernel/drivers/hwpower/cc_battery/battery_ocv/Kconfig
```kconfig
# SPDX-License-Identifier: GPL-2.0
#
# huawei battery ocv driver
#

config HUAWEI_BATTERY_OCV
	bool "huawei battery ocv driver"
	default n
	help
	  Say Y here to enable battery ocv driver.
	  This driver provides a unified interface to
	  get ocv table.
```

## kernel/drivers/hwpower/cc_charger/Kconfig
```kconfig
# SPDX-License-Identifier: GPL-2.0

config DIRECT_CHARGER
        bool "direct_charger"
        default n

source "drivers/hwpower/cc_charger/reverse_charge/Kconfig"
```

## kernel/drivers/hwpower/cc_charger/reverse_charge/Kconfig
```kconfig
# SPDX-License-Identifier: GPL-2.0
#
# reverse charge drivers
#

config REVERSE_CHARGE_PD
	bool "reverse charge pd"
	default n
	help
	  Say Y here to enable reverse charge pd driver.
	  This driver provides reverse charge func.
```

## kernel/drivers/hwpower/cc_common_module/power_event/Kconfig
```kconfig
# SPDX-License-Identifier: GPL-2.0
#
# huawei power event drivers
#

config HUAWEI_POWER_EXTRA_EVENT
	tristate "huawei power extra event"
	default n
	help
	  Say Y here to enable power extra event driver.
	  Say M here to compile the driver as a module.
```

## kernel/drivers/hwpower/cc_common_module/power_gpio/Kconfig
```kconfig
# SPDX-License-Identifier: GPL-2.0
#
# huawei power gpio drivers
#

config HUAWEI_POWER_GPIO_MISC
	tristate "huawei power gpio misc"
	default n
	help
	  Say Y here to enable power gpio misc driver.
	  Say M here to compile the driver as a module.
```

## kernel/drivers/hwpower/cc_hardware_channel/dischg_boost/Kconfig
```kconfig
# SPDX-License-Identifier: GPL-2.0
#
# dischg boost drivers
#

config HUAWEI_DISCHG_BOOST
	bool "dischg boost"
	default n
	help
	  Say Y here to enable dischg boost driver.
	  Currently supported operating by gpio and triggered by soc.
	  Improves output voltage through the boost circuit.
```

## kernel/drivers/hwpower/cc_hardware_ic/bypass_boost/Kconfig
```kconfig
# SPDX-License-Identifier: GPL-2.0
#
# huawei bypass boost drivers
#

config BYPASS_BOOST
	bool "bypass boost"
	default n
	help
	  Say Y here to enable bypass boost.
	  This driver provides a unified interface to the bypass boost.
	  Currently supported ic as below.
	  hl7603

config BYPASS_BOOST_HL7603
	bool "bypass boost hl7603"
	depends on BYPASS_BOOST
	default n
	help
	  Say Y here to enable bypass boost hl7103 driver.
```
