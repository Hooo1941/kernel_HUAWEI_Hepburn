## kernel/drivers/huawei_platform/boottime/Kconfig
```kconfig
config HUAWEI_BOOT_TIME
	default n
	  bool "huawei boot time"
	help
	  only open on eng mode.
menuconfig HUAWEI_BOOT_TIME_UEFI
	default n
	bool "huawei boot time for uefi"
	help
	only open on eng mode.
```

## kernel/drivers/huawei_platform/echub/Kconfig
```kconfig
#
# Armpc echub driver configuration
#

config ARMPC_ECHUB
	bool "armpc echub drvier"
	depends on I2C
	default n
	help
	  echub handle all EC chipset status and messages required by OS,it's agent of EC in the Linux Kernel.

config ARMPC_ECHUB_I2C
	bool "armpc echub i2c drvier"
	depends on ARMPC_ECHUB
	default n
	help
	  echub i2c drvier handle all EC chipset data read/write.

config ARMPC_ECHUB_DEBUG_FS
	bool "armpc echub debug"
	depends on ARMPC_ECHUB
	default n
	help
	  enable echub debug fs

source "drivers/huawei_platform/echub/keyboard/Kconfig"
source "drivers/huawei_platform/echub/power/Kconfig"
source "drivers/huawei_platform/echub/battery/Kconfig"
source "drivers/huawei_platform/echub/fnled/Kconfig"
source "drivers/huawei_platform/echub/thermal/Kconfig"
source "drivers/huawei_platform/echub/echub_update/Kconfig"
source "drivers/huawei_platform/echub/echub_log/Kconfig"
source "drivers/huawei_platform/echub/rtc/Kconfig"
```

## kernel/drivers/huawei_platform/echub/battery/Kconfig
```kconfig
#
# echub battery moudule
#

config ARMPC_ECHUB_BATTERY
        bool "echub battery"
        depends on ARMPC_ECHUB
        default n
        help
          This driver provides support for echub battery
```

## kernel/drivers/huawei_platform/echub/echub_log/Kconfig
```kconfig
#
# echub log interface
#

config ARMPC_ECHUB_LOG
	bool "echub log"
	depends on ARMPC_ECHUB
	default n
	help
	  This driver supports echub log interface.
```

## kernel/drivers/huawei_platform/echub/echub_update/Kconfig
```kconfig
#
# echub update channel
#

config ARMPC_ECHUB_UPDATE
	bool "echub update channel"
	depends on ARMPC_ECHUB
	default n
	help
	  echub update channel
```

## kernel/drivers/huawei_platform/echub/fnled/Kconfig
```kconfig
#
# Sends commands to the EC through the I2C.
#

config ARMPC_ECHUB_FNLED
	bool "Keyboard fn led"
	depends on ARMPC_ECHUB
	default n
	help
	  This driver supports the fn indicator to return to the restarted state.
```

## kernel/drivers/huawei_platform/echub/keyboard/Kconfig
```kconfig
#
# Keyboard echub driver mute led
#
source "drivers/huawei_platform/echub/keyboard/uart_hid/Kconfig"

config ARMPC_ECHUB_MUTELED
	bool "Keyboard mute led"
	depends on ARMPC_ECHUB
	default n
	help
	  This driver provides support for Keyboard F7 hotkey mute led
	  via I2c. This driver only used by OS.
```

## kernel/drivers/huawei_platform/echub/keyboard/uart_hid/Kconfig
```kconfig
# SPDX-License-Identifier: GPL-2.0-only
menu "UART HID support"
	depends on TTY

config UART_HID
	tristate "HID over uart tty transport layer"
	default n
	depends on TTY && INPUT
	select HID
	help
	  Say Y here if you use a keyboard, a touchpad, a touchscreen, or any
	  other HID based devices which is connected to your computer via uart.

	  If unsure, say N.

	  This support is also available as a module.  If so, the module
	  will be called uart-hid.

endmenu
```

## kernel/drivers/huawei_platform/echub/power/Kconfig
```kconfig
#
# echub power moudule
#

config ARMPC_ECHUB_PMSYNC
        bool "ec state sync"
        depends on ARMPC_ECHUB
        default n
        help
          This driver provides support for ec state sync(suspend / resume)
          via GPIO.

config ARMPC_ECHUB_LID
        bool "ec lid func"
        depends on ARMPC_ECHUB
        default n
        help
          This driver provides support for Lid function
          via GPIO.

config ARMPC_ECHUB_LID_TEST
        bool "lid production test"
        depends on ARMPC_ECHUB
        default n
        help
          This config provides support for Lid production test.

config ARMPC_ECHUB_CHARGE_STATUS
        bool "ec charge func"
        depends on ARMPC_ECHUB
        default n
        help
          This driver provides support for ec charge status function.

config ARMPC_ECHUB_WAKEALARM
        bool "ec wakealarm"
        depends on ARMPC_ECHUB
        default n
        help
          This driver provides support for ec wakealarm function
```

## kernel/drivers/huawei_platform/echub/rtc/Kconfig
```kconfig
#
# Echub RTC driver
#

config ARMPC_ECHUB_RTC
	bool "Echub rtc driver"
	depends on ARMPC_ECHUB
	default n
	help
	  This driver supports the rtc feature of EC or MCU.
```

## kernel/drivers/huawei_platform/echub/thermal/Kconfig
```kconfig
#
# echub thermal moudule
#

config  PC_ECHUB_THERMAL
        bool "echub thermal"
        depends on ARMPC_ECHUB
        default n
        help
          This driver provides support for echub thermal

config THERMAL_DEVICE_INTERFACE
	bool "thermal device interface"
	depends on ARMPC_ECHUB
	default n
	help
	  Say Yes here to support thermal device interface
```

## kernel/drivers/huawei_platform/external_camera/Kconfig
```kconfig
menuconfig HUAWEI_EXTERNAL_CAMERA
	bool "huawei external CAMERA device control"
	default n
	help
	Say yes here to support external CAMERA device control.
```

## kernel/drivers/huawei_platform/hw_cpld/Kconfig
```kconfig
menuconfig CPLD_DRIVER
	tristate "cpld diver"
	default n
	help
	  If you say yes here you get support for cpld.
```

## kernel/drivers/huawei_platform/hw_peripheral/Kconfig
```kconfig
source "drivers/huawei_platform/hw_peripheral/sw/Kconfig"
source "drivers/huawei_platform/hw_peripheral/plc/Kconfig"
source "drivers/huawei_platform/hw_peripheral/mcu/Kconfig"
source "drivers/huawei_platform/hw_peripheral/logo/Kconfig"
source "drivers/huawei_platform/hw_peripheral/fbe/Kconfig"
```

## kernel/drivers/huawei_platform/hw_peripheral/fbe/Kconfig
```kconfig
#
# huawei s4 secimage drivers
#

config HIBERNATE_SECIMAGE
	tristate "s4 secimage"
    depends on HIBERNATION
	default n
	help
	  support encrypted s4 Image.
```

## kernel/drivers/huawei_platform/hw_peripheral/logo/Kconfig
```kconfig
#
# huawei kernel logo drivers
#

config FB_KERNEL_LOGO
	tristate "fb kernel logo"
	default n
	help
	  Kernel logo.
```

## kernel/drivers/huawei_platform/hw_peripheral/mcu/Kconfig
```kconfig
#
# huawei mcu drivers
#

config HW_MCU_DRIVER
	tristate "mcu hc32l110 driver"
	default n
	help
	  MCU hc32l110 I2C driver.
```

## kernel/drivers/huawei_platform/hwdps/Kconfig
```kconfig
config HWDPS
	bool "hwdps System"
	default n
	help
	Huawei Application Authentication System

config HWDPS_OHOS
	bool "hwdps config for ohos kernel build"
	default n
	help
	  Say 'Y' in ohos kernel
```

## kernel/drivers/huawei_platform/net/amax/Kconfig
```kconfig
config HW_WIFI_AMAX
	tristate "kernel huawei driver hook for wifi multilink"
	default n
	help
	  This module adds support for wifi multilink.

config HW_WIFI_CLOCK
	tristate "kernel huawei driver hook for wifi clock"
	default n
	help
	  This module adds support for wifi clock.
```

## kernel/drivers/huawei_platform/nfc/TMS_THN31_64/Kconfig
```kconfig
#
# Near Field Communication (NFC) devices
#
config THN31_NFC_64
	tristate "THN31 NFC driver"
	depends on I2C
	select CRC_CCITT
	default n
	help
	  Say yes if you want THN31 Near Field Communication driver.
	  This is for i2c connected version. If unsure, say N here.

	  To compile this driver as a module, choose m here. The module will
	  be called thn31.
```

## kernel/drivers/huawei_platform/nfc/ca11/Kconfig
```kconfig
#
# Near Field Communication (NFC) devices
#
config NFC_FANLI
	tristate "PRIV NFC driver"
	depends on I2C
	select CRC_CCITT
	default n
	help
	  Say yes if you want NFC Near Field Communication driver.
	  This is for i2c connected version. If unsure, say N here.

	  To compile this driver as a module, choose m here. The module will
	  be called PRIV NFC.

config CA11_NFC
	tristate "CA11 NFC driver"
	depends on I2C
	select CRC_CCITT
	default n
	help
	  Say yes if you want NFC Near Field Communication driver.
	  This is for i2c connected version. If unsure, say N here.

	  To compile this driver as a module, choose m here. The module will
	  be called PRIV NFC.
```

## kernel/drivers/huawei_platform/power/battery/battery_ct/fdw/Kconfig
```kconfig
# SPDX-License-Identifier: GPL-2.0+
#
# IC FM1230 test drivers
#

config HUAWEI_BATTCT_FM1230
	bool
	prompt "Support fm1230 as certification IC."
	depends on HUAWEI_BATTERY_INFORMATION
	default n
	help
	  Say Y here to enable fm1230 ic driver
```

## kernel/drivers/huawei_platform/power/battery/battery_ct/tmc/Kconfig
```kconfig
# SPDX-License-Identifier: GPL-2.0+
#
# IC T91407 test drivers
#

config HUAWEI_BATTCT_T91407
	bool
	prompt "Support t91407 as certification IC."
	depends on HUAWEI_BATTERY_INFORMATION
	default n
	help
	  Say Y here to enable t91407 ic driver
```

## kernel/drivers/huawei_platform/rmeminspect/Kconfig
```kconfig
#
#meminspect config driver configuration
#
config MEM_INSPECT
        tristate "rmeminspect driver"
        default n
        help
        Say yes here to support for dram inspection driver.
config MEM_INSPECT_OHOS
        tristate "rmeminspect driver"
        default n
        help
        Say yes here to support for dram inspection driver.
```

## kernel/drivers/huawei_platform/sensor/fingerprint/Kconfig
```kconfig
#
# fingerprint configuration
#
menuconfig FINGERPRINT
	bool "fingerprint"
	default n
	help
	Say yes here to support for fingerprint.
config FINGERPRINT_TP_DECOUPLE
	bool "fingerprint tp decouple"
	default n
	help
	Say yes here to support for fingerprint_tp_decouple.
```
