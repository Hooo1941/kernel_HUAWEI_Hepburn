## kernel/drivers/hwpower/cc_hardware_ic/switch_capacitor/Kconfig
```kconfig
# SPDX-License-Identifier: GPL-2.0
#
# huawei switch capacitor for direct charge drivers
#

config SWITCHCAP
	bool "switch_capacitor"
	depends on DIRECT_CHARGER
	default n
	help
	  Say Y here to enable switch capacitor driver.
	  This driver provides a unified interface for switch capacitor.
	  Support device:
	  bq25970
	  ltc7820
	  rt9759
	  sc8545
	  hl7139
	  sm5450
	  aw32280
	  sc8562

config BQ25970
	bool "bq25970_for_direct_charge"
	depends on SWITCHCAP
	default n
	help
	  Say Y here to enable bq25970 driver.
	  BQ25970 is a 97% efficient, 8-A battery charging solution using a
	  switched cap architecture.
	  This architecture and the integrated FETs are optimized to enable
	  a 50% duty cycle.

config RT9759
	bool "rt9759_for_direct_charge"
	depends on SWITCHCAP
	default n
	help
	  Say Y here to enable rt9759 driver.
	  rt9759 is a high effiency and high charge current charger. The
	  efficiency is up to 97.8% when VBAT = 4.2V, IBAT = 2.5A and the
	  maximum charge current is up to 8A.

config LTC7820
	bool "ltc7820_for_direct_charge"
	depends on SWITCHCAP
	default n
	help
	  Say Y here to enable ltc7820 driver.
	  LTC7820 is a fixed ratio high voltage high power switched capacitor
	  and charge pump controller.
	  This device achieves a 2:1 step-down ratio form an input voltage as
	  high as 72v.

config SC8545
	  bool "sc8545_for_direct_charge"
	  depends on SWITCHCAP
	  default n
	  help
	  Say Y here to enable sc8545 driver.
	  sc8545 is a fixed ratio high voltage high power switched capacitor
	  and low voltage loadswtich ic.

config HL7139
	  bool "hl7139_for_direct_charge"
	  depends on SWITCHCAP
	  default n
	  help
	  Say Y here to enable hl7139 driver.
	  hl7139 is a fixed ratio high voltage high power switched capacitor
	  and low voltage loadswtich ic.

config SM5450
	bool "sm5450_for_direct_charge"
	depends on SWITCHCAP
	default n
	help
	  Say Y here to enable sm5450 driver.
	  sm5450 is a fixed ratio high voltage high power switched capacitor
	  and low voltage loadswtich ic.

config AW32280
	bool "aw32280_for_direct_charge"
	depends on SWITCHCAP
	default n
	help
	  Say Y here to enable aw32280 driver.
	  aw32280 is a fixed ratio high voltage high power switched capacitor
	  and low voltage loadswtich ic.

config SC8562
	bool "sc8562_for_direct_charge"
	depends on SWITCHCAP
	default n
	help
	  Say Y here to enable sc8562 driver.
	  sc8562 is a variable ratio high voltage high power switched capacitor
	  and low voltage loadswtich ic with six different operation modes:
	  forward 4:1/2:1/1:1 charger mode and reverse 1:4/1:2/1:1 converter mode.

config SC8546
	bool "sc8546_for_direct_charge"
	depends on SWITCHCAP
	default n
	help
	  Say Y here to enable sc8546 driver.
	  sc8546 is a fixed ratio high voltage high power switched capacitor
	  and low voltage loadswtich ic.
	  It also supports scp protocol and ufcs protocol.

config CPS2021
	bool "cps2021_for_direct_charge"
	depends on SWITCHCAP
	default n
	help
	  Say Y here to enable cps2021 driver.
	  cps2021 is a fixed ratio high voltage high power switched capacitor
	  and low voltage loadswtich ic.
	  It also supports scp protocol and ufcs protocol.

config CPS2023
	bool "cps2023_for_direct_charge"
	depends on SWITCHCAP
	default n
	help
	  Say Y here to enable cps2023 driver.
	  cps2023 is a variable ratio high voltage high power switched capacitor
	  and low voltage loadswtich ic with six different operation modes:
	  forward 4:1/2:1/1:1 charger mode and reverse 1:4/1:2/1:1 converter mode
	  It also supports scp protocol and ufcs protocol.

config SC8571
	bool "sc8571_for_direct_charge"
	depends on SWITCHCAP
	default n
	help
	  Say Y here to enable sc8571 driver.
	  sc8571 is a high efficiency 4:2/2:2 fast charger for 2-cell battery.
	  The maximum charge current is up to 8A.

config NU2205
	bool "nu2205_for_direct_charge"
	depends on SWITCHCAP
	default n
	help
	  Say Y here to enable nu2205 driver.
	  sc8571 is a high efficiency 4:2/2:2 fast charger for 2-cell battery.
	  The maximum charge current is up to 8A.

config SC8510
	bool "sc8510_for_direct_charge"
	depends on SWITCHCAP
	default n
	help
	  Say Y here to enable sc8510 driver.
	  sc8510 is a 99.5% efficiency, 10A battery discharging (forward 2:1 conversion) and
	  4A charging (reverse 1:2 conversion) solution using a switched capacitor architecture.

config SY6513
	bool "sy6513_for_direct_charge"
	depends on SWITCHCAP
	default n
	help
	  Say Y here to enable sy6513 driver.
	  sy6513 is a variable ratio high voltage high power switched capacitor
	  and low voltage loadswtich ic with six different operation modes:
	  forward 4:1/2:1/1:1 charger mode and reverse 1:4/1:2/1:1 converter mode.
```

## kernel/drivers/hwpower/cc_hardware_monitor/low_power/Kconfig
```kconfig
# SPDX-License-Identifier: GPL-2.0
#
# low power drivers
#

config HUAWEI_LOW_POWER
	bool "low power"
	default n
	help
	  Say Y here to enable low power driver.
	  Currently supported emergency mode, low temperature mode.
	  Improves battery efficiency through the boost circuit.
```

## kernel/drivers/hwusb/Kconfig
```kconfig
source "drivers/hwusb/hw_gadget/Kconfig"
source "drivers/hwusb/hw_usb/Kconfig"
source "drivers/hwusb/hw_dp/Kconfig"

config HW_PD_COMMON
        bool "Hw pd common"
        default n
        help
          Say Y to enable
```

## kernel/drivers/hwusb/hw_dp/Kconfig
```kconfig
config HUAWEI_DP_SOURCE
	tristate "huawei dp source switch driver"
	help
	  Enable this option to enable the dp source switch

config HUAWEI_DP_DSM
	tristate "huawei dp dsm driver"
	help
	  Enable this option to enable the dp dsm

config HUAWEI_DP_LAHAINA
	tristate "lahaina platform for dp driver"
	help
	  Enable this option to enable the lahaina platform

config HUAWEI_DP_TARO
	tristate "taro platform for dp driver"
	help
	  Enable this option to enable the taro platform
```

## kernel/drivers/hwusb/hw_usb/Kconfig
```kconfig
#
# huawei usb drivers
#

config HUAWEI_USB
	bool "huawei usb"
	default n
	help
	  Say Y here to enable usb driver.

config HUAWEI_USB_VENDOR
	bool "huawei usb extra set"
	default n
	help
	  Enable this option to support extra function.
```

## kernel/drivers/hwzerohung/Kconfig
```kconfig
config DFX_ZEROHUNG
	bool "zero hung driver"
	default n
	help
	  This feature support to catch hung log

config DFX_ZEROHUNG_EXT
	bool "zero hung extention driver"
	default n
	help
	  This feature support to catch hung log

config DFX_ZEROHUNG_SOFTLOCKUP
	bool "softlockup"
	default n
	help
	  This feature use to detect softlockup

config DFX_ZEROHUNG_SOFTLOCKUP_INJECT
	bool "softlockup inject"
	default n
	help
	  This feature use to cause softlockup
```

## kernel/drivers/iommu/arm/smmu/Kconfig
```kconfig
# IOMMU support

config MM_IODOMAIN_API
	bool

config MM_IOMMU
	bool "IOMMU Support"
	select IOMMU_API
	select MM_IODOMAIN_API
	select DMA_OPS
	help
	  IOMMU Support.

config MM_IOMMU_LPAE
	bool "IOMMU LPAE Support"
	select IOMMU_API
	depends on MM_IOMMU
	help
	  IOMMU Support.

config MM_IOMMU_BYPASS
	bool "IOMMU Bypass Support"
	select IOMMU_API
	depends on MM_IOMMU
	help
	  IOMMU Bypass Support.

config MM_IOMMU_LEGACY
	bool "IOMMU SECOND LEVEL PAGE TABLE Support"
	select IOMMU_API
	depends on MM_IOMMU && !MM_IOMMU_LPAE
	help
	  IOMMU Support.

config MM_IOMMU_TEST
	bool "IOMMU TEST Support"
	depends on MM_IOMMU_LPAE
	select IOMMU_API
	help
	  IOMMU Support.

config MM_VIOMMU_TEST
	bool "RDA IOMMU TEST Support"
	depends on MM_IOMMU_LPAE || MM_SMMU_V3
	select IOMMU_API
	help
	  RDA IOMMU Support.

config MM_IOMMU_IOVA_DEBUG
        bool "IOMMU IOVA DEBUG Support"
	depends on MM_IOMMU
	default n
	help
	  IOMMU IOVA DEBUG Support

config MM_SVM
	tristate "SVM driver"
	depends on !ARM_SMMU_V3 && !MM_SMMU_V3
	select MMU_NOTIFIER
	help
	  This option enables support for the svm features base on the ARM
	  smmu v3 hardware. Select this option if you want to use devices by ssid
	  and asid interface.

config MM_SMMUV310
	bool "SMMUV310 Support"
	depends on MM_SVM
	default n
	help
	  SMMUV310 Support

config MM_SMMUV320
	bool "SMMUV320 Support"
	depends on MM_SVM
	default n
	help
	  SMMUV320 Support

config MM_SMMU_V3
	bool "Self-Developed System MMU Version 3 (SMMUv3) Support"
	depends on ARM64 && !ARM_SMMU_V3
	select IOMMU_API
	select IOMMU_IO_PGTABLE_LPAE
	select GENERIC_MSI_IRQ_DOMAIN
	help
	  Support for implementations of the self-developed System MMU architecture
	  version 3 providing translation support to a PCIe root complex.

	  Say Y here if your system includes an IOMMU device implementing
	  the self-developed SMMUv3 architecture.

config LDK_SVM
	bool "LDK_SVM support"
	depends on MM_SMMU_V3
	default n
	help
	  Support svm feature on hm-kernel LDK.

config MM_IO_PGTABLE_EBIT
	bool "build io-pgtable with E-bit"
	depends on MM_SMMU_V3
	default n
	help
	  Support building io-pgtable with E-bit.
	  Only for hardware systems with MDE IP.

config MM_IOMMU_LAST_PAGE
	bool "IOMMU Last Page Support"
	depends on MM_IOMMU
	select IOMMU_API
	help
	  IOMMU Last Page Support

config MM_IOMMU_DMA
	bool "IOMMU DMA Support"
	depends on MM_IOMMU
	default n
	help
	  IOMMU DMA Support

config MM_VIRTIO_IOMMU
	tristate "Virtio IOMMU driver"
	depends on VIRTIO
	help
	  Para-virtualised IOMMU driver with virtio.

config MM_IOMMU_ERRATUM_NHVA_FLUSH_TLB
	bool "IOMMU NHVA leaf(=0) flush tlb bugfix"
	depends on MM_SMMU_V3
	help
	  NHVA flush tlb debug. For some platfprms,
	  when leaf == 0, NHVA flush cannot flush pte entry,
	  so we need to use leaf == 1 to flush pte entry,
	  leaf == 0 to flush pgd/pmd entry.

config MM_RDA_SMMU
	bool "rda_mem IOMMU DRIVER Support"
	select IOMMU_API
	depends on MM_IOMMU
	help
		RDA IOMMU DRIVER Support.

config SMMU_SUPPORT_2_LVL_STETAB
	bool "smmu 2 level stetab support"
	depends on MM_SMMU_V3
	default n
	help
		config smmu 2 level stetab support.

config SMMU_SUPPORT_2_LVL_CDTAB
	bool "smmu 2 level cdtab support"
	depends on MM_SMMU_V3
	default n
	help
		config smmu 2 level cd support.

config SMMU_SUPPORT_FFA
	bool "smmu ffa support"
	depends on ARM_FFA_TRANSPORT
	default n
	help
		config smmu ffa support.

config SMMU_SUPPORT_ECC
	bool "smmu ecc support"
	depends on MM_SMMU_V3
	default n
	help
		config smmu ecc support.
```

## kernel/drivers/lock_detector/Kconfig
```kconfig
#lock detector Kconfig
config LOCK_DETECTOR
    tristate "Hw Lock Detector"
    depends on LOCKDEP
    help
        If you say yes here you get support of lock detector to debug mutex.
```

## kernel/drivers/perf/perf/Kconfig
```kconfig
menu "Huawei Device Usage Big-data Analytics Initiative Support for PERF"

config HUAWEI_PERF
	bool "Huawei Device Usage Big-data Analytics Initiative Support for PERF"
	default n
	help
	  This driver provides PERF feature

endmenu
```

## kernel/drivers/platform_drivers/modem/Kconfig
```kconfig
menu "Modem"
config MODEM_DRIVER
	tristate "ap+modem config for fusion platform"
	default n
	help
	ap+modem config support.

config EXTRA_MODEM_DRIVER
	bool "extra_modem config"
	default n
	help
	ap+modem config support.

config EXTRA_MODEM_DRIVER_MBB
	bool "MBB extra_modem config"
	default n
	help
	ap+modem MBB config support

config MODEM_PS_FUSION_VERSION
        tristate "modem ps fusion version"
        default n
        help
        modem ps fusion

source "drivers/platform_drivers/modem/drv/Kconfig"
endmenu
```

## kernel/drivers/platform_drivers/modem/config/product/charlotte/os/acore/charlotte_modem_user_defconfig
```kconfig
# include modem
CONFIG_INC_MODEM_CONFIG=y

# modem
CONFIG_MODEM_DRIVER=m

#PFA Drivers
#
CONFIG_PFA=y

#IPC
CONFIG_IPC_DRIVER=y

#ICC
CONFIG_ICC_BALONG=n
CONFIG_ICC_BALONG_TEST=n

#SEC_CALL

CONFIG_SEC_CALL=y

#pmom
CONFIG_MODEM_PMOM=n

#mdmpm_debug
CONFIG_MDMPM_DEBUG=n

#c_pm_stress
CONFIG_C_SR_STRESS_TEST=n

#easy_shell
CONFIG_BALONG_EASY_SHELL=y

#IPF
CONFIG_IPF_SUPPORT=n
CONFIG_IPF_TEST=n
#PSAM
CONFIG_PSAM_SUPPORT=n

#DSP
CONFIG_DSP_BALONG=n


#nvim
CONFIG_NVIM=y
CONFIG_NVIM_TEST=n


#OnOff
CONFIG_MODEM_ONOFF_PARA=n
CONFIG_MODEM_ONOFF=y

CONFIG_MAA_BALONG=n
#hwadp
CONFIG_HW_IP_BASE_ADDR=y

#timer
CONFIG_HARD_TIMER=n
CONFIG_SOFT_TIMER=n
CONFIG_BBP_TIMER=n

#UDI
CONFIG_UDI_SUPPORT=y

#RESET

CONFIG_MODEM_POWER_MANAGE=n
CONFIG_HIFI_RESET=n

#S_MEMORY
CONFIG_S_MEMORY=y
CONFIG_S_MEMORY_TEST=n

#SYSCTRL
CONFIG_SYSCTRL=y
CONFIG_SYSCTRL_TEST=n

# efuse
CONFIG_EFUSE_IOT=n
CONFIG_EFUSE_MODEM_AGENT=y

#---------------------------
#dual modem
CONFIG_DUAL_MODEM=n
CONFIG_FRAME_WARN=2048

#OM
CONFIG_AP_DUMP=n

#PMU OCP
CONFIG_PMU_OCP=y
#BBP
CONFIG_BBP_ACORE=n

#PAM_NR MODEM BUILD
CONFIG_PAM_NR_MODEM_BUILD=y

#PS_FUSION
CONFIG_MODEM_PS_FUSION_VERSION=y

#simhotplug
CONFIG_SIM_HOTPLUG_SPMI=y

#DFX MEM
CONFIG_MDM_DFX_MEM=y

#vbat
CONFIG_MODEM_VBAT=y
```

## kernel/drivers/platform_drivers/modem/drv/Kconfig
```kconfig
menu "Modem Drivers"

source "drivers/platform_drivers/modem/drv/ipc/Kconfig"
source "drivers/platform_drivers/modem/drv/sec_call/Kconfig"
source "drivers/platform_drivers/modem/drv/timer/Kconfig"
source "drivers/platform_drivers/modem/drv/reset/Kconfig"
source "drivers/platform_drivers/modem/drv/sec_nvim/Kconfig"
source "drivers/platform_drivers/modem/drv/onoff/Kconfig"
source "drivers/platform_drivers/modem/drv/efuse/Kconfig"
source "drivers/platform_drivers/modem/drv/udi/Kconfig"
source "drivers/platform_drivers/modem/drv/sysctrl/Kconfig"
source "drivers/platform_drivers/modem/drv/pfa/Kconfig"
source "drivers/platform_drivers/modem/drv/c_pm_stress/Kconfig"
source "drivers/platform_drivers/modem/drv/mdmpm_debug/Kconfig"
source "drivers/platform_drivers/modem/drv/pmu/Kconfig"
source "drivers/platform_drivers/modem/drv/sim_hotplug/Kconfig"
source "drivers/platform_drivers/modem/drv/vbat/Kconfig"
source "drivers/platform_drivers/modem/drv/msocket/Kconfig"
source "drivers/platform_drivers/modem/drv/sysview/Kconfig"
source "drivers/platform_drivers/modem/drv/omserver/mprobe/Kconfig"
source "drivers/platform_drivers/modem/drv/vdev/Kconfig"
endmenu
```

## kernel/drivers/platform_drivers/modem/drv/c_pm_stress/Kconfig
```kconfig
config C_SR_STRESS_TEST
	bool "ccore sr stress test"
	default n
	help
	support for ccore sr stress test
```

## kernel/drivers/platform_drivers/modem/drv/efuse/Kconfig
```kconfig
#
# EFUSE infrastructure and drivers
#

config EFUSE_IOT
	tristate "Modem EFUSE Read/Write support"
	default n
	help
	  Support for Modem SoC read or write.

config EFUSE_MODEM_AGENT
	tristate "Modem EFUSE Read/Write Agent"
	default n
	help
	  Support for Modem SoC read or write Agent.
```

## kernel/drivers/platform_drivers/modem/drv/homi/Kconfig
```kconfig
#
# homi driver
#
config HOMI
	tristate "support homi"
	default n
	help
	  homi driver
```

## kernel/drivers/platform_drivers/modem/drv/msocket/Kconfig
```kconfig
#
# om socket driver
#
config OM_SOCKET
	tristate "support om socket"
	default n
	help
	  om socket

config OM_SOCKET_AT_PORT
	tristate "support om socket at port"
	default y
	help
	  om socket at port
```

## kernel/drivers/platform_drivers/modem/drv/nmi/Kconfig
```kconfig
#
# Modem nmi driver
#
config MODEM_NMI
    tristate "nmi driver"
    default n
    help
       modem nmi for tsp
```

## kernel/drivers/platform_drivers/modem/drv/omserver/mprobe/Kconfig
```kconfig
#
# mprobe driver
#
config MPROBE
	tristate "support mprobe"
	default n
	help
	  mprobe driver
```

## kernel/drivers/platform_drivers/modem/drv/onoff/Kconfig
```kconfig
#
# modem onoff management
#

comment "modem onoff management"

config MODEM_ONOFF
	tristate "onoff management"
	default n
	help
	  onoff management

config MODEM_ONOFF_PARA
	tristate "onoff para management"
	default n
	help
	  onoff para management
```

## kernel/drivers/platform_drivers/modem/drv/pfa/Kconfig
```kconfig
config PFA
	tristate "smart packet process module"
	help
	  If this option is enabled, the kernel will include support
	  for soft fast forward.
```
