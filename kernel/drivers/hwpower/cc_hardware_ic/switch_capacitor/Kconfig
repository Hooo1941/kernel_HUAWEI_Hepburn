## kernel/drivers/platform_drivers/modem/drv/pfa/wan/Kconfig
```kconfig
#
#pfa_tft configuration
#

config WAN_SUPPORT
tristate "wan support"
default n
help
wan driver
```

## kernel/drivers/platform_drivers/modem/drv/pmu/Kconfig
```kconfig
config PMU_OCP
    bool "modem pmu ocp"
    default n
    help
    support for pmu ocp
```

## kernel/drivers/platform_drivers/modem/drv/reset/Kconfig
```kconfig
#
# modem reset driver
#

comment "modem reset"

config MODEM_RESET
	tristate "support modem reset feature"
	default n
	help
	  modem reset

config MODEM_RESET_TEST
	tristate "test code of modem reset feature"
	default n
	help
	  modem reset test program
	  
config MODEM_POWER_MANAGE
	tristate "the interface of modem power manage"
	default n
	help
	  modem state
```

## kernel/drivers/platform_drivers/modem/drv/sim_hotplug/Kconfig
```kconfig
#
#SIM hotplug support.
#

config SIM_HOTPLUG_SPMI
	bool "support spmi sim hotplug function"
	default n
	help
	  Say 'Y' here if you want to support the SPMI SIM HOTPLUG.
config ESIM_SUPPORT
	bool "support esim function"
	default n
	help
	  Say 'Y' here if you want to support the eSIM feature.
```
