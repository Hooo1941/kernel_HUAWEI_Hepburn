## kernel/drivers/gpu/hisi/kmd/Kconfig
```kconfig
#
# Copyright (c) Hisilicon Technologies Co., Ltd. 2021-2021. All rights reserved.
#

menuconfig HISI_GPU
	tristate "Hvgr series support"
	select GPU_TRACEPOINTS if ANDROID
	default n
	help
	  Enable this option to support the construction of a Hvgr GPU.

	  Choose M here to compile this driver as a module, called hvgr_kmd.

config HVGR_GPU_DVFS
	bool "Enable legacy DVFS"
	depends on HISI_GPU
	default n
	help
	  Enable legacy DVFS in the Hvgr DDK.

config HVGR_GPU_RT_PM
	bool "Enable Runtime power management"
	depends on HISI_GPU
	depends on PM_RUNTIME || PM
	default n
	help
	  Enable runtime power management in the HVGR DDK.

config HVGR_SYSTEM_CACHE
	bool "Enable system cache"
	depends on HISI_GPU && MM_LB
	default n
	help
	  Enable system cache in the HVGR DDK.

menuconfig HVGR_EXPERT
	depends on HISI_GPU
	bool "Enable Expert Settings"
	default n
	help
	  Enable this option and modify the default settings can make the driver
	  own performance or other limitations.

config HVGR_PLATFORM_NAME
	depends on HISI_GPU && HVGR_EXPERT
	string "Platform name"
	default "p0000000"
	help
	  Enable this option to configure the name of the required platform directory,
	  which will be included in the build.
	  'platform/$(HVGR_PLATFORM_NAME)/Kbuild' must exist.

config HVGR_DEBUG
	bool "Debug build"
	depends on HISI_GPU && HVGR_EXPERT
	default n
	help
	  Enable this option to increase errors checking and reporting.

config HISI_GPU_AI_FENCE_INFO
	bool "GPU AI frequency schedule fence info"
	default n
	help
	  Enable GPU AI frequency schedule in the HVGR DDK.

config HVGR_V1XX
	bool "GPU version v1xx"
	default n
	help
	  Used for V1xx gpu and isolate other versions.

config HVGR_V2XX
	bool "GPU version v2xx"
	default n
	help
	  Used for V2xx gpu and isolate other versions.

config HVGR_V3XX
	bool "GPU version v3xx"
	default n
	help
	  Used for V3xx gpu and isolate other versions.

config HVGR_V350
	bool "GPU version v350"
	default n
	help
	  Used for V350 gpu and isolate other versions.

config HVGR_DFX_DEBUG_BUS_DUMP
	bool "GPU Debug bus dump"
	default n
	help
	  Enable debug bus dump function in the HVGR DDK.

config HVGR_DFX_MNTN_REPORT
	bool "GPU mntn report"
	default n
	help
	  Enable mntn report function in the HVGR DDK.

config HVGR_DFX_MEM_DUMP
	bool "GPU Memory dump"
	default n
	help
	  Enable mem dump function in the HVGR DDK.

config HVGR_DFX_DMD_REPORT
	bool "GPU dmd report"
	depends on HISI_GPU
	default n
	help
	  Enable dmd report function in the HVGR DDK.

config HVGR_DFX_SH
	bool "GPU sh"
	depends on HISI_GPU
	default n
	help
	  Enable sh function in the HVGR DDK.

config HVGR_DFX_DATAN
	bool "GPU Datan"
	depends on HISI_GPU
	default n
	help
	  Enable datan function in the HVGR DDK.

config HVGR_IDLE_AUTO_CLK_DIV
	bool "Idle auto clock divide"
	depends on HISI_GPU && HVGR_EXPERT
	default y
	help
	  Enable this option to decrease the clock rate automatically, when GPU in IDLE state.

config HVGR_GPU_THROTTLE_DEVFREQ
	bool "Enable gpu throttlel devfreq"
	default n
	help
	  Enable gpu throttlel devfreq for user in the HVGR DDK.

config HVGR_GPU_CORE_HOTPLUG
	bool "Enable gpu core hotplug if high temperature scenario"
	depends on HISI_GPU && HVGR_EXPERT
	default n
	help
	  Enable this option to shutdown some cores if the thermal need
	  reduce gpu power consumption in the HVGR DDK.

config HVGR_KUTF
	tristate "HVGR Kernel Unit Test Framework"
	depends on HISI_GPU
	default m
	help
	  Enables HVGR testing framework. To compile it as a module,
	  choose M here - this will generate a single module called kutf.

config HVGR_VIRTUAL
	bool "GPU VIRTUAL"
	default n
	help
	  Enable virtual feature in the HVGR DDK.

config HVGR_VIRTUAL_HOST
	bool "GPU VIRTUAL HOST"
	depends on HVGR_VIRTUAL
	default n
	help
	  Enable host driver in the HVGR DDK.

config HVGR_VIRTUAL_GUEST
	bool "GPU VIRTUAL GUEST"
	depends on HVGR_VIRTUAL
	default n
	help
	  Enable guest driver in the HVGR DDK.

config HVGR_ASYNC_MEM_RECYCLE
	bool "Async GPU memory recycle"
	depends on LIBLINUX
	default n
	help
	  Enable asynchronous recycle of HVGR device memory pages.

config HVGR_SAMEVA_CACHE
	bool "Sameva cache"
	depends on LIBLINUX
	default n
	help
	  Enable same va cache
```

## kernel/drivers/hisi/tzdriver/auth/Kconfig
```kconfig
# Auth Configuration
config CLIENT_AUTH
	bool "Client Application Hash Auth"
	default n
	depends on TZDRIVER
	help
	  TEEOS CA code hash auth

config ANDROID_HIDL
	bool "Android Hidl Adapt"
	default n
	depends on CLIENT_AUTH
	help
	  TEEOS hidl proc auth

config CADAEMON_AUTH
	bool "Teec Daemon Path Hash Auth"
	default n
	depends on TZDRIVER
	help
	  TEEOS TEECD path hash auth

config TZDRIVER_OHOS
	bool "Is in OH"
	default n
	depends on TZDRIVER
	help
	  OH Cadaemon uid
```

## kernel/drivers/hisi/tzdriver/tui/Kconfig
```kconfig
config TEE_TUI
	bool "Trusted User Interface Driver"
	default n
	depends on TZDRIVER
	help
	  Trusted user interface diver

config TEE_TUI_FP
	bool "Trusted User Interface Driver For FP"
	default n
	depends on TZDRIVER
	help
	  Trusted user interface diver

config TEE_TUI_DISPLAY_3_0
	bool "Trusted User Interface Driver For DSS3.0"
	default n
	depends on TEE_TUI
	help
	  Trusted user interface diver
```

## kernel/drivers/huawei_platform/Kconfig
```kconfig
menu "Huawei Platform Drivers"

menuconfig HUAWEI_PLATFORM
       bool "Huawei platform drivers support"
       default n
       help
       Say yes here to support the huawei platform

if HUAWEI_PLATFORM

source "drivers/huawei_platform/antenna_board_match/Kconfig"
#source "drivers/huawei_platform/antenna_fpga/Kconfig"
source "drivers/huawei_platform/audio/Kconfig"
source "drivers/huawei_platform/riltcp/Kconfig"
source "drivers/huawei_platform/connectivity/Kconfig"
source "drivers/huawei_platform/devdetect/Kconfig"
#source "drivers/huawei_platform/dsm/Kconfig"
source "drivers/huawei_platform/iotrace/Kconfig"
source "drivers/huawei_platform/ext_modem/Kconfig"
source "drivers/huawei_platform/inputhub/Kconfig"
source "drivers/huawei_platform/irda/Kconfig"
#source "drivers/huawei_platform/lcd/Kconfig"
#source "drivers/huawei_platform/log/Kconfig"
source "drivers/huawei_platform/mm/Kconfig"
source "drivers/huawei_platform/net/Kconfig"
source "drivers/huawei_platform/nfc/Kconfig"
source "drivers/huawei_platform/uwb/Kconfig"
source "drivers/huawei_platform/power/Kconfig"
source "drivers/huawei_platform/sensor/Kconfig"
source "drivers/huawei_platform/storage/Kconfig"
source "drivers/huawei_platform/touthscreen/Kconfig"
source "drivers/huawei_platform/touch_key/Kconfig"
source "drivers/huawei_platform/usb/Kconfig"
source "drivers/huawei_platform/antenna_board_gpio_match/Kconfig"
source "drivers/huawei_platform/vibrator/Kconfig"
source "drivers/huawei_platform/ocp/Kconfig"
source "drivers/huawei_platform/madapt/Kconfig"
source "drivers/huawei_platform/handpress_switch/Kconfig"
source "drivers/huawei_platform/led_alwayson/Kconfig"
source "drivers/huawei_platform/boottime/Kconfig"
source "drivers/huawei_platform/hw_led/Kconfig"
source "drivers/huawei_platform/dp_aux_switch/Kconfig"
source "drivers/huawei_platform/dp_source/Kconfig"
source "drivers/huawei_platform/rilsim/Kconfig"
source "drivers/huawei_platform/kirin_chipsets/Kconfig"
source "drivers/huawei_platform/vendor_exception/Kconfig"
source "drivers/huawei_platform/hwdps/Kconfig"
source "drivers/huawei_platform/card_tray/Kconfig"
source "drivers/huawei_platform/rmeminspect/Kconfig"
source "drivers/huawei_platform/pmeminfo/Kconfig"
source "drivers/huawei_platform/hw_peripheral/Kconfig"
source "drivers/huawei_platform/wakeup/Kconfig"
source "drivers/huawei_platform/multichip_skytone/Kconfig"
source "drivers/huawei_platform/thermal/Kconfig"
source "drivers/huawei_platform/hwsdp/Kconfig"
source "drivers/huawei_platform/blpwm/Kconfig"
source "drivers/huawei_platform/piezo_key/Kconfig"
source "drivers/huawei_platform/hw_oled_spi/Kconfig"
source "drivers/huawei_platform/robot_mcu/Kconfig"
source "drivers/huawei_platform/recovery_key/Kconfig"
source "drivers/huawei_platform/hw_fan/Kconfig"
source "drivers/huawei_platform/hw_cpld/Kconfig"
source "drivers/huawei_platform/pcie_misc/Kconfig"
source "drivers/huawei_platform/echub/Kconfig"
source "drivers/huawei_platform/external_camera/Kconfig"
source "drivers/huawei_platform/sparklink/Kconfig"
endif #HUAWEI_PLATFORM

config FACTORY_MODE
	bool "huawei factory mode"
	default n
	help
	  factory version config

config HLTHERM_RUNTEST
	bool "huawei hltherm runtest"
	default n
	help
	  hltherm version config

endmenu
```

## kernel/drivers/huawei_platform/audio/hwcxext_codec_pc/Kconfig
```kconfig
menuconfig HWCXEXT_CODEC_MODULE_PC
	bool "hwcxext codec drivers support"
	default n
	help
	Say yes here to support the hwcxext codec module pc

if HWCXEXT_CODEC_MODULE_PC
config HWCXEXT_CODEC_INTERFACE_PC
	tristate "Support for HWCXEXT_CODEC_INTERFACE_PC"
	default n
	help
	 Say Y here if you want to support HWCXEXT_CODEC_INTERFACE_PC
config HWCXEXT_CODEC_V1_PC
	tristate "Support for hwcxext codec v1 pc"
	default n
	help
	 Say Y here if you want to support hwcxext codec v1 pc
config HWCXEXT_MBHC_PC
	tristate "Support for hwcxext mbhc pc"
	default n
	help
	 Say Y here if you want to support hwcxext mbhc pc
config HWCXEXT_I2C_OPS_PC
	tristate "Support for hwcxext i2c ops pc"
	default n
	help
	 Say Y here if you want to support hwcxext i2c ops pc
endif #HWCXEXT_CODEC_MODULE_PC
```
