## kernel/drivers/connectivity/hisi/Kconfig
```kconfig
#
# Generic huawei hisi misc drivers configuration
#
#source "drivers/connectivity/hisi/tiot_driver/Kconfig"
config TIOT_DRIVER
    tristate "tiot driver"
    default n
    help
        Support for tiot drivers.
```

## kernel/drivers/connectivity/hisi/tiot_driver/Kconfig
```kconfig
#===============================================================================
# @brief    Kconfig file for kernel.
# Copyright (c) @CompanyNameMagicTag 2024-2024. All rights reserved.
#===============================================================================

config TIOT_DRIVER
    tristate "tiot driver"
    default n
    help
        Support for tiot drivers.
```

## kernel/drivers/devkit/audiokit/ana_hs_kit/ana_hs_pop_window/Kconfig
```kconfig
config ANA_HS_POP_WINDOW
	tristate "Support for analog headset pop window"
	default n
	help
	  Say Y here if you want to support analog headset pop window
```

## kernel/drivers/devkit/audiokit/audio_gpio_ctl/Kconfig
```kconfig
config AUDIO_GPIO_CTL
	tristate "audio gpio driver"
	default n
	help
	  Say Y to enable audio gpio driver support
```

## kernel/drivers/devkit/audiokit/audio_misc/Kconfig
```kconfig
config HUAWEI_AUDIO_MISC
    bool "audio misc driver"
    default n
    help
    Say Y to enable audio misc driver support
if HUAWEI_AUDIO_MISC
    source "drivers/devkit/audiokit/audio_misc/vibrator_state/Kconfig"
endif
```

## kernel/drivers/devkit/audiokit/audio_misc/vibrator_state/Kconfig
```kconfig
config AUDIO_VIBRATOR_STATE
    bool "vibrator state driver"
    default n
    help
    Say Y to enable vibrator state driver support
```

## kernel/drivers/devkit/audiokit/audio_vqm/Kconfig
```kconfig
config HUAWEI_AUDIO_VQM
	tristate "audio vqm driver"
    default n
    help
    Say Y to enable audio vqm driver support
```

## kernel/drivers/devkit/audiokit/dsm_audio/Kconfig
```kconfig
###################################################
#                                                 #
# huawei device state monitor audio configuration #
#                                                 #
###################################################

config HUAWEI_DSM_AUDIO
	tristate "huawei dsm audio"
	default n
	depends on HUAWEI_DSM || HUAWEI_OHOS_DSM
	help
	  If you say yes here you get support for huawei dsm audio.
```

## kernel/drivers/devkit/audiokit/smartpakit/Kconfig
```kconfig
config HUAWEI_SMARTPAKIT_AUDIO
	tristate "smartpakit driver"
	default n
	help
		Say Y to enable smartpakit driver support

source "drivers/devkit/audiokit/smartpakit/high_power_smartpa/Kconfig"
```

## kernel/drivers/devkit/audiokit/smartpakit/high_power_smartpa/Kconfig
```kconfig
config HUAWEI_SMARTPA_HIGH_VOLTAGE_CONVERTER
	tristate "smartpa high voltage converter driver"
	default n
	help
		Say Y to enable smartpa high voltage converter support
```

## kernel/drivers/devkit/lcdkit/lcdkit3.0/Kconfig
```kconfig
#
# lcdkit hisi driver configuration
#

menuconfig LCD_KIT_DRIVER
	bool "lcd kit 3.0 driver"
	default n
	help
	    If you say yes here you get support for lcd kit driver.

menuconfig LCD_KIT_DEBUG
	bool "lcd kit 3.0 debug"
	default n
	help
	    If you say yes here you get support for lcd kit debug.

menuconfig LCD_DBV_MAP_OHOS
	bool "lcd dbv map ohos"
	default n
	help
		If you say yes here you get support for lcd dbv map.

source "drivers/devkit/lcdkit/lcdkit3.0/kernel/common/src/Kconfig"
source "drivers/devkit/lcdkit/lcdkit3.0/kernel/hisi/src/Kconfig"
source "drivers/devkit/lcdkit/lcdkit3.0/kernel/hisi/adapt/Kconfig"
source "drivers/devkit/lcdkit/lcdkit3.0/kernel/mtk/src/Kconfig"
source "drivers/devkit/lcdkit/lcdkit3.0/kernel/mtk/adapt/Kconfig"
source "drivers/devkit/lcdkit/lcdkit3.0/kernel/qcom/src/Kconfig"
source "drivers/devkit/lcdkit/lcdkit3.0/kernel/qcom/adapt/Kconfig"
```

## kernel/drivers/devkit/tpkit/3_0/panel_kconfig/Kconfig
```kconfig
#
# huawei touchscreen driver configuration
#

menuconfig ATMEL_TS_KIT_3_0
	tristate "huawei  ts kit atmel 3.0 drivers"
	default n
	help
	  If you say yes here you get support for huawei touchscreen.
menuconfig CHIPONE_TS_KIT_3_0
	tristate "TS_KIT_3_0 chipone drivers"
	default n
	help
	  If you say yes here you get support for huawei touchscreen.
menuconfig CHIPONE_HYBRID_TS_KIT_3_0
	tristate "CHIPONE_HYBRID drivers"
	default n
	help
	  If you say yes here you get support for huawei touchscreen.
menuconfig ELAN_TS_KIT_3_0
	bool "huawei TS_KIT elan 3.0 drivers"
	default n
	help
	  If you say yes here you get support for huawei touchscreen.
menuconfig FOCAL_TS_KIT_3_0
	tristate "TS_KIT_3_0 focaltech drivers"
	default n
	help
	  If you say yes here you get support for huawei touchscreen.
menuconfig GOODIX_GT1X_TS_KIT_3_0
	tristate "TS_KIT_3_0 goodix GT1X drivers"
	default n
	help
	  If you say yes here you get support for huawei touchscreen.
menuconfig GOODIX_GTX8_TS_KIT
	bool "TS_KIT GTX8 drivers"
	default n
	help
	  If you say yes here you get support for huawei touchscreen.
menuconfig GOODIX_GTX8_BRL_TS_KIT_3_0
	bool "TS_KIT GTX8 BRL 3.0 drivers"
	default n
	help
	  If you say yes here you get support for huawei touchscreen.
menuconfig HIMAX_TS_KIT_3_0
	bool "huawei ts kit himax_64 drivers"
	default n
	help
	  If you say yes here you get support for huawei touchscreen.
menuconfig ILITEK_TS_KIT_3_0
	bool "TS_KIT ilitek 3_0 drivers"
	default n
	help
	  If you say yes here you get support for huawei touchscreen.
menuconfig MSTAR_TS_KIT_3_0
	bool "TS_KIT_3_0 mstar drivers"
	default n
	help
	  If you say yes here you get support for huawei touchscreen.
menuconfig NOVATEK_TS_KIT_3_0
	tristate "novatek ts kit 3_0 drivers"
	default n
	help
	  If you say yes here you get support for huawei touchscreen.
menuconfig PARADE_TS_KIT_3_0
	tristate "huawei  ts kit 3.0 parade drivers"
	default n
	help
	  If you say yes here you get support for huawei touchscreen.
menuconfig SAMSUNG_TS_KIT_3_0
	tristate "SAMSUNG_TS_KIT_3_0 samsung.lsi touch drivers"
	default n
	help
	  If you say yes here you get support for huawei touchscreen.
menuconfig ST_TS_KIT_3_0
	tristate "TS_KIT ST 3.0 touch drivers"
	default n
	help
	  If you say yes here you get support for huawei touchscreen.
menuconfig SYNAPTICS_TS_KIT_3_0
	tristate "SYNAPTICS_TS_KIT_3_0 drivers"
	default n
	help
	  If you say yes here you get support for huawei touchscreen.
menuconfig SYNAPTICS_TCM_TS_KIT_3_0
	tristate "SYNAPTICS_TCM_TS_KIT_3_0 touchscreen"
	default n
	help
	  If you say yes here you get support for huawei touchscreen.
menuconfig ZINITIX_TS_KIT_3_0
	tristate "TS_KIT_3_0 zinitix drivers"
	default n
	help
	  If you say yes here you get support for huawei touchscreen.
```

## kernel/drivers/devkit/tpkit/panel_kconfig/Kconfig
```kconfig
#
# huawei touchscreen driver configuration
#

menuconfig ATMEL_TS_KIT
	tristate "huawei  ts kit atmel drivers"
	default n
	help
	  If you say yes here you get support for huawei touchscreen.
menuconfig ELAN_TS_KIT
	bool "TS_KIT elan drivers"
	default n
	help
	  If you say yes here you get support for huawei touchscreen.
menuconfig FOCAL_TS_KIT
	tristate "TS_KIT focaltech drivers"
	default n
	help
	  If you say yes here you get support for huawei touchscreen.
menuconfig GOODIX_TS_KIT
	bool "TS_KIT goodix drivers"
	default n
	help
	  If you say yes here you get support for huawei touchscreen.
menuconfig GOODIX_GT1X_TS_KIT
	tristate "TS_KIT goodix GT1X drivers"
	default n
	help
	  If you say yes here you get support for huawei touchscreen.
menuconfig HIMAX_TS_KIT
	bool "huawei  ts kit himax drivers"
	default n
	help
	  If you say yes here you get support for huawei touchscreen.
menuconfig HIMAX_TS_KIT_64
	bool "huawei  ts kit himax drivers"
	default n
	help
	  If you say yes here you get support for huawei touchscreen.
menuconfig HIMAX_ZF_TS_KIT_64
	bool "huawei  ts kit himax drivers"
	default n
	help
	  If you say yes here you get support for huawei touchscreen.
menuconfig ILITEK_TS_KIT
	bool "TS_KIT ilitek drivers"
	default n
	help
	  If you say yes here you get support for huawei touchscreen.
menuconfig ILITEK_TDDI_TS_KIT
	bool "TS_KIT ilitek tddi drivers"
	default n
	help
	  If you say yes here you get support for huawei touchscreen.
menuconfig MSTAR_TS_KIT
	bool "TS_KIT mstar drivers"
	default n
	help
	  If you say yes here you get support for huawei touchscreen.
menuconfig NOVATEK_TS_KIT
	tristate "novatek ts kit drivers"
	default n
	help
	  If you say yes here you get support for huawei touchscreen.
menuconfig  NOVATEK_HYBRID_TS_KIT
	tristate "TS_KIT novatek_hybrid drivers"
	default n
	help
	  If you say yes here you get support for huawei touchscreen.
menuconfig PARADE_TS_KIT
	tristate "huawei  ts kit parade drivers"
	default n
	help
	  If you say yes here you get support for huawei touchscreen.
menuconfig SAMSUNG_TS_KIT
	tristate "TS_KIT samsung.lsi touch drivers"
	default n
	help
	  If you say yes here you get support for huawei touchscreen.
menuconfig ST_TS_KIT
	tristate "TS_KIT ST touch drivers"
	default n
	help
	  If you say yes here you get support for huawei touchscreen.
menuconfig SYNAPTICS_TS_KIT
	tristate "TS_KIT synaptics drivers"
	default n
	help
	  If you say yes here you get support for huawei touchscreen.
menuconfig SYNAPTICS_TCM_TS_KIT
	tristate "Synaptics TCM touchscreen"
	default n
	help
	If you say yes here you get support for huawei touchscreen.
menuconfig ZINITIX_TS_KIT
	tristate "TS_KIT zinitix drivers"
	default n
	help
	  If you say yes here you get support for huawei touchscreen.
menuconfig OMNIVISION_TCM_TS_KIT
	tristate "OMNIVISION TCM touchscreen"
	default n
	help
	  Say Y here if you have a OMNIVISION TCM touchscreen connected
	  to your system.
	  If unsure, say N.
```

## kernel/drivers/dfx_hck/Kconfig
```kconfig
config DFX_HCK_VENDOR_HOOKS
	bool "Dfx Hck Vendor Hooks"
	depends on TRACEPOINTS
	help
	  Enable dfx vendor hooks implemented as tracepoints
```

## kernel/drivers/dubai/Kconfig
```kconfig
menu "Device Usage Big-data Analytics Initiative Support"

config POWER_DUBAI
	bool "Device Usage Big-data Analytics Initiative Support"
	default n
	select HUAWEI_DUBAI
	help
	  This driver provides DUBAI feature

config POWER_DUBAI_HISYSEVENT
	bool "Use hisysevent to send DUBAI kernel message"
	default n
	depends on POWER_DUBAI && HISYSEVENT
	help
	  This driver provides DUBAI hisysevent feature

config HUAWEI_DUBAI
	bool "Device Usage Big-data Analytics Initiative Support"
	default n
	help
	  This driver provides DUBAI feature

config POWER_DUBAI_TASK_CPU_POWER
	bool "DUBAI Task CPU Power"
	default n
	depends on POWER_DUBAI && (CPU_FREQ_POWER_STAT || ARCH_MSM)
	help
	  Get task cpu power

config POWER_DUBAI_RGB_STATS
	bool "DUBAI Rgb Stats"
	default n
	depends on POWER_DUBAI && FB
	help
	  Get Rgb Stats

config POWER_DUBAI_LTPO_REFRESH_RATE
	bool "DUBAI let LTPO refreshrate statistic only compile in new platform"
	default n
	help
	  This driver limits the compile version

config HUAWEI_DUBAI_TASK_CPU_POWER
	bool "Huawei DUBAI Task CPU Power"
	default n
	depends on HUAWEI_DUBAI && CPU_FREQ_POWER_STAT
	help
	  Get task cpu power

config HUAWEI_DUBAI_RGB_STATS
	bool "Huawei DUBAI Rgb Stats"
	default n
	depends on HUAWEI_DUBAI && FB
	help
	  Get Rgb Stats

endmenu
```

## kernel/drivers/emcom/nstack/Kconfig
```kconfig
menuconfig HW_EMCOM_NSTACK
	bool "Huawei Emcom Nstack"
	depends on HUAWEI_EMCOM
	default n

if HW_EMCOM_NSTACK
source "drivers/emcom/nstack/fi/Kconfig"
source "drivers/emcom/nstack/mintp/Kconfig"
endif # if HW_EMCOM_NSTACK
```

## kernel/drivers/emcom/nstack/mintp/Kconfig
```kconfig
config HW_NSTACK_MINTP
	tristate "Huawei NSTACK MinTP layer2 Reliable Transmission Protocol"
	depends on HW_EMCOM_NSTACK
	default n
```

## kernel/drivers/gpu/Kconfig
```kconfig
menu "HISI GPU Configuration"

config KMD
        tristate "HISI KMD configs"
        default n

-source "drivers/gpu/hisi/kmd/Kconfig"

endmenu
```
