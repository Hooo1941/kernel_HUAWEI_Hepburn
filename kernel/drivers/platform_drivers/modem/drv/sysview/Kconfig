## kernel/kernel/sched/hw_graded_sched/Kconfig
```kconfig
config HW_GRADED_SCHED
	bool "Graded CFS sched policy"
	default n
	help
	  if set, foreground apps and background apps will be graded in CFS nice ranges.

config HW_GRADED_SCHED_WAKEUP_NEW_TASK_FAST
	bool "Wake up new tasks faster"
	depends on HW_GRADED_SCHED
	default n
	help
	  if set, can control wakeup new thread faster.
```

## kernel/kernel/sched/platform/Kconfig
```kconfig
# SPDX-License-Identifier: GPL-2.0

config SCHED_LTS
	bool "sched feature support LTS kernel"
	default n
	help
	  Say Y here if OHOS LTS kernel
	  Say N here if ASOP kernel
```

## kernel/mm/improper_alloc/Kconfig
```kconfig
# SPDX-License-Identifier: GPL-2.0-only
#
# Improper memory alloc behaviours debug
#

config IMPROPER_ALLOC
	bool "Debug improper memory alloc behaviours"
	default n
	help
	  Say Y here if you want to debug improper memory alloc behaviours

config IMPROPER_ALLOC_FAULT
	bool "Fault injection for improper alloc feature"
	depends on IMPROPER_ALLOC
	default n
	help
	  Say Y here if you want to injection improper alloc faults

config IMPROPER_ALLOC_SINGLE_FRAME
	bool "Debug improper memory alloc behaviours in single frame"
	default n
	depends on IMPROPER_ALLOC
	help
	  Say Y here if you want to debug improper memory alloc behaviours in single frame
```
