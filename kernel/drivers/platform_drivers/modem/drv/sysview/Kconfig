## kernel/drivers/platform_drivers/modem/drv/sysview/Kconfig
```kconfig
#
# sysview driver
#
config SYSVIEW
	tristate "support sysview"
	default n
	help
	  sysview driver
```

## kernel/drivers/platform_drivers/modem/drv/vbat/Kconfig
```kconfig
config MODEM_VBAT
	tristate "support modem vbat"
	default n
	help
	  modem vbat driver
```

## kernel/drivers/platform_drivers/modem/drv/vdev/Kconfig
```kconfig
#
# modem control interface
#

comment "modem control interface"

config MCI_CUST
	tristate "mci support customize"
	default n
	help
	  open for mbb

config MCI_SWITCH
    tristate "mci support switch"
    default n
    help
      open for mbb, support PCUI/MODEM/UART/CMUX/APPVCOM switch
```

## kernel/drivers/platform_drivers/tzdriver/tzdriver_internal/Kconfig
```kconfig
config TZDRIVER_INTERNAL
	tristate "Secure Execution Communicator driver private code"
	default n
	depends on TZDRIVER
	help
	  include tzdriver features which not open-source.

source "drivers/platform_drivers/tzdriver/tzdriver_internal/tee_trace_event/Kconfig"
```

## kernel/drivers/platform_drivers/tzdriver/tzdriver_internal/tee_trace_event/Kconfig
```kconfig
config TEE_TRACE
    bool "TEE trace event"
    default n
    depends on TZDRIVER_INTERNAL
    help
      TEE trace event is used to track key events while swithing between TEE and REE
```

## kernel/drivers/video/fbdev/dkmd/dpu/begonia/Kconfig
```kconfig
config DKMD_DPU_ENABLE
	bool "DKMD dpu driver support"
	default n
	depends on DKMD_ENABLE
	select DKMD_DKSM
	select DKMD_CMDLIST_ENABLE
	select DKMD_DPU_DEVICE
	select DKMD_DPU_COMMON
	help
	  This feature driver supports dpu begonia driver.

config DKMD_DPU_DEVICE
	tristate "DKMD FB Framebuffer support"
	default n
	depends on FB
	select FB_CFB_FILLRECT
	select FB_SYS_FOPS
	select FB_CFB_COPYAREA
	select FB_CFB_IMAGEBLIT
	help
	  This framebuffer driver supports Dkmd FB.

config DKMD_DPU_COMPOSER
	bool "DKMD driver support composer device"
	default n
	depends on DKMD_DPU_DEVICE
	help
	  This feature driver supports dpu composer device driver.

config DKMD_DPU_RES_MGR
	bool "DKMD driver support resource manager"
	default n
	help
	  This feature driver supports dpu resource manager driver.

config DKMD_DPU_COMMON
	bool "DKMD driver support common utils"
	default n
	help
	  This feature driver supports dpu common utils driver.

config DKMD_DPU_AOD
	tristate "DKMD aod support"
	depends on DKMD_DPU_COMPOSER
	help
	  This feature driver supports aod.

config WLT_DISPLAY
	bool "wireless low latency support"
	default n
	help
	  This feature driver supports wireless low latency.

config DKMD_DPU_OHOS
	bool "dkmd dpu ohos adapter feature switch"
	default n
	help
	  ohos adapter features be opened by setting y

config DPU_TBU_ECC
	bool "tbu ecc is support"
	default n
	help
	  This feature driver supports tbu ecc.

source "drivers/video/fbdev/dkmd/dpu/begonia/device/virtio/Kconfig"
```

## kernel/include/hwnet/Kconfig
```kconfig
source "drivers/hwnet/ipv4/Kconfig"
source "drivers/hwnet/booster/Kconfig"
source "drivers/hwnet/chr/Kconfig"
source "drivers/hwnet/hw_dpi_mark/Kconfig"
source "drivers/hwnet/hw_dual_connection/Kconfig"
source "drivers/hwnet/waudio/Kconfig"
source "drivers/hwnet/hwril/Kconfig"
source "drivers/hwnet/hwril_sim_sd/Kconfig"
source "drivers/hwnet/hw_sate_comm/Kconfig"
source "drivers/hwnet/rsmc/Kconfig"
source "drivers/hwnet/network_dcp/Kconfig"
```

## kernel/include/hwnet/hw_sate_comm/Kconfig
```kconfig
config HW_SATE_COMM
	tristate "kernel space communicate with user space use vcom."
    default n
    help
	  sate kernel driver.
```

## kernel/include/hwnet/hwril/Kconfig
```kconfig
config VSIM_ADAPT
        tristate "kernel vsim adapt"
    default n
    help
          This module adds support for vsim
```

## kernel/include/hwnet/network_dcp/Kconfig
```kconfig
config HW_NETWORK_DCP
    bool "weixin cloud server proxy"
    default n
    help
        This module adds support for dnat socket to specifical server.
```

## kernel/include/hwnet/rsmc/Kconfig
```kconfig
config HW_RSMC
	tristate "kernel space communicate with user space use netlink socket."
    default n
    help
	  BeiDou short packet kernel driver, used to adapt to the short packet chip.
config HW_RSMC_X800
	tristate "x800 driver"
    depends on HW_RSMC
    default n
    help
	  x800 driver Implementation
config HW_RSMC_X801
	tristate "x801 driver"
    depends on HW_RSMC
    default n
    help
	  x801 driver Implementation
```

## kernel/include/hwnet/tv_coldstart/Kconfig
```kconfig
config HW_COLDSTART
	tristate "kernel huawei custom packet startclod for wlan"
	default n
	help
		This module adds support cold start feature.
```

## kernel/include/linux/platform_drivers/ana_hs_kit/Kconfig
```kconfig
menuconfig HUAWEI_ANA_HS_KIT_AUDIO
	tristate "analog headset drivers support"
	default n
	help
	  Say yes here to support the  analog headset module

if HUAWEI_ANA_HS_KIT_AUDIO
config ANA_HS
	tristate "Support for analog headset"
	default n
	help
	  Say Y here if you want to support analog headset
config ANA_HS_CORE
	tristate "Support for analog headset core"
	default n
	help
	  Say Y here if you want to support analog headset core
config INVERT_HS_CORE
	tristate "Support for invert headset"
	default n
	help
	  Say Y here if you want to support invert headset
config ANA_HS_EXTERN_OPS_KIT
	bool "Support for ana hs extern ops"
	default n
	help
	  Say Y here if you want to enable water detect
config ANA_HS_POP_WINDOW
	tristate "Support for analog headset pop window"
	default n
	help
	  Say Y here if you want to support analog headset pop window
endif #HUAWEI_ANA_HS_KIT_AUDIO
```

## kernel/kernel/cpu_netlink/Kconfig
```kconfig
config HW_IAWARE_THREAD_BOOST
    bool "iaware 2.0 binder thread boost"
    default n
    help
      if set, binder thread will be set to new group. if thread is in background group, set it to foreground group, else set it to boost group.

config HW_FORK_THREAD_CHANGE_CGROUP
    bool "enable thread group switchover"
    depends on HW_VIP_THREAD
    default n
    help
      if set, enable thread group switchover function in kernel.
```

## kernel/kernel/hw_stat/Kconfig
```kconfig
config HW_STAT
	bool "HW_STAT support."
	default n
	help
	  HW_STAT provides a basic framework for kernel statistics.
config HW_STAT_TRACING_MARK_WRITE
	bool "HW_STAT_TRACING_MARK_WRITE support."
	default n
	help
	  If enabled, we can use hw_stat_trace() to print debugging
	  slices on perfetto traces.
config HW_STAT_TRACE_PAGEFAULT
	bool "HW_STAT_TRACE_PAGEFAULT support."
	depends on HW_STAT_TRACING_MARK_WRITE
	default n
	help
	  If enabled, print major page fault info
	  into trace using tracing_mark_write.
config HW_STAT_TRACE_MMAP
	bool "HW_STAT_TRACE_MMAP support."
	depends on HW_STAT_TRACING_MARK_WRITE
	default n
	help
	  If enabled, print mmap info
	  into trace using tracing_mark_write.
config HW_STAT_TRACE_FULLPATH
	bool "HW_STAT_TRACE_FULLPATH support."
	depends on HW_STAT_TRACING_MARK_WRITE
	default n
	help
	  If HW_STAT_TRACE_FULLPATH is enabled, HW_STAT_TRACE
	  may print out some file path.

source "kernel/hw_stat/fault_stat/Kconfig"
source "kernel/hw_stat/hw_iostat/Kconfig"
source "kernel/hw_stat/psi/Kconfig"
source "kernel/hw_stat/blk_info/Kconfig"
source "kernel/hw_stat/phymem/Kconfig
```

## kernel/kernel/hw_stat/blk_info/Kconfig
```kconfig
config HW_STAT_BLK_INFO
	bool "HW_STAT_BLK_INFO support."
	depends on HW_STAT && MAS_BLK
	default n
	help
	  HW_STAT_BLK_INFO support, provide depth, MQ tags, hardware tags info of block layer
```

## kernel/kernel/hw_stat/fault_stat/Kconfig
```kconfig
config HW_STAT_FAULT
	bool "HW_STAT_FAULT support."
	depends on HW_STAT
	default n
	help
	  Expose statistics about page fault, which helps to monitor file cache
	  status.
```

## kernel/kernel/hw_stat/hw_iostat/Kconfig
```kconfig
config HW_STAT_IOSTAT
	bool "hw_iostat support"
	depends on HW_STAT
	default n
	help
	  Expose io statistics by size, priority and latency
config HW_STAT_IOSTAT_VFS
	bool "hw_stat_iostat vfs io stat"
	depends on HW_STAT_IOSTAT
	default n
	help
	  hw_iostat, io statistics in vfs layer
config HW_STAT_IOSTAT_BLK
	bool "hw_stat_iostat blk io stat"
	depends on HW_STAT_IOSTAT
	default n
	help
	  hw_iostat, io statistics in block layer
```

## kernel/kernel/hw_stat/phymem/Kconfig
```kconfig
config HW_STAT_PHYMEM
	bool "HW_STAT_PHYMEM support."
	depends on HW_STAT
	default n
	help
	  HW_STAT_PHYMEM support.
```

## kernel/kernel/hw_stat/psi/Kconfig
```kconfig
config HW_STAT_PSI
    bool "HW_STAT_PSI support."
    depends on HW_STAT
    depends on PSI
    default n
    help
      hw_stat psi base.

config HW_STAT_PSI_LRB
    bool "HW_STAT_PSI_LRB support."
    depends on HW_STAT_PSI
    default n
    help
      Pressure stall information for lrb_in_use.
```
