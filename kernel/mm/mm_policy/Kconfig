## kernel/mm/mm_policy/Kconfig
```kconfig
# SPDX-License-Identifier: GPL-2.0-only
config HW_MM_POLICY
	bool "memory policy module"
	default n
	help
	  Huawei memory policy.
```

## kernel/mm/slub_debug_ext/Kconfig
```kconfig
# SPDX-License-Identifier: GPL-2.0-only
config SLUB_DEBUG_ENHANCED
	bool "Enhanced slub debug info, to show slab usage by pid"
	depends on SLUB && SLUB_DEBUG
	default n
	help
	  Debug slub usage by process id
```

## kernel/platform_source/ai/Kconfig
```kconfig
menu "NPU Kernel Configuration"

source "platform_source/ai/drivers/npu/Kconfig"


endmenu
```

## kernel/platform_source/ai/drivers/igs/camera/Kconfig
```kconfig
config CONTEXTHUB_IGS_CAM
	bool "igs cam driver"
	depends on INPUTHUB_20&&KERNEL_CAMERA
	default n
	help
	Igs driver support camera.

config CONTEXTHUB_IGS_CAM_20
	bool "igs cam_20 driver"
	depends on INPUTHUB_20&&KERNEL_CAMERA
	default n
	help
	Igs driver support camera.
```

## kernel/platform_source/ai/drivers/npu/Kconfig
```kconfig
menu "NPU Driver Configuration"

-source "platform_source/ai/drivers/npu/nkd/Kconfig"
-source "platform_source/ai/drivers/npu/npd/Kconfig"
-source "platform_source/ai/drivers/npu/pcie/Kconfig"
-source "platform_source/ai/drivers/npu/bbit_debugfs/Kconfig"
-source "platform_source/ai/drivers/npu/load_ts/Kconfig"

endmenu
```

## kernel/platform_source/ai/drivers/npu/nkd/Kconfig
```kconfig
config NPU_KERNEL_DRIVER
	tristate "NPU_KERNEL_DRIVER"
	depends on MODULES
	default n
	help
	  Say m here to support npu kernel driver ko.

config NPU_DPM_ENABLED
	bool "NPU_DPM_ENABLED depends on DPM_HWMON"
	depends on DPM_HWMON
	default n
	help
	  Driver for npu dpm

config NPU_DEBUG
	tristate "NPU_DEBUG"
	default n

config NPU_FFA_SUPPORT
	bool "NPU_FFA_SUPPORT depends on ARM_FFA_TRANSPORT"
	depends on ARM_FFA_TRANSPORT
	default n
	help
	  Driver for npu ffa

config NPU_VIRTUAL
	bool "NPU_VIRTUAL"
	default n
```

## kernel/platform_source/ai/drivers/npu/npd/Kconfig
```kconfig
config NPU_PLATFORM_DRIVER
    tristate "NPU_PLATFORM_DRIVER"
    depends on MODULES
    default n
    help
	Say m here to support npu platform driver ko.
```

## kernel/platform_source/audio/Kconfig
```kconfig
menu "audio Kernel Configuration"

menuconfig SND_SOC_PLATFORM
	bool "Enable ASoC platform drivers"
	depends on SND_SOC
	default y
	help
	Say yes here to support ASoC platform drivers

if SND_SOC_PLATFORM
source "platform_source/audio/sound/Kconfig"
endif

source "platform_source/audio/drivers/Kconfig"

endmenu
```

## kernel/platform_source/audio/drivers/Kconfig
```kconfig
if SND_SOC_PLATFORM
endif

source "platform_source/audio/drivers/hifi_dsp/Kconfig"
source "platform_source/audio/drivers/hifi_mailbox/Kconfig"
source "platform_source/audio/drivers/soundtrigger/Kconfig"
source "platform_source/audio/drivers/soc_mad/Kconfig"
source "platform_source/audio/drivers/rdr/Kconfig"
```

## kernel/platform_source/audio/drivers/hifi_dsp/Kconfig
```kconfig
menu "Hifimisc driver serve HIFI dsp"

config HIFI_DSP_ONE_TRACK
     bool "hifi low power play device support"
     help
          hifi lpp device provide service for HIFI and AP, in case of HIFI ultra-low power audio play.
config HIFI_MEMORY_21M
    bool "hifi memory is 21M"
    help
         hifi memory is 21M
config HIFI_MEMORY_15M
    bool "hifi memory is 15M"
    help
         hifi memory is 15M
config DSP_VAD_WAKEUP
    bool "4mic 4ec vad wakeup"
    help
         4mic 4ec vad wakeup
config 2MIC_LP_WAKEUP
    bool "2mic lp wakeup"
    help
         2mic lp wakeup
config SOCDSP_CMA_SIZE_7M
    bool "socdsp cma size 7M"
    help
         socdsp cma size 7M
config AUDIO_DEBUG
    bool "support audio debug function"
    help
        support audio debug function
config HIFI_EXTRA_MODEM_MODE
    bool "support a+b function"
    help
        support a+b function
config HIFI_RESET_CDEV
    bool "support hifi reset cdev"
    help
        support hifi reset cdev
config HIFI_SUPPORT_VIBRATOR
    bool "support transfer vibrator data"
    help
        support transfer vibrator data
config DP_MULTI_CHANNELS
    bool "support dp audio multi channels"
    help
        support dp audio multi channels
config HIFI_SECOS_LOAD
        tristate "Support secos load hifi"
        default n
        help
          Enables secos load hifi.
config HIFI_NPU_ROUTE
    bool "hifi npu route support"
    default n
    help
        hifi npu route.
config HIFI_SPATIAL_AUDIO_SUPPORT
    bool "hifi spatial audio support"
    help
        hifi spatial audio.
config RDA_AUDIO
    bool "audio funcs for CDC RDA support"
    help
        audio funcs for CDC RDA.
config HIFI_EXTEND_MISC
    bool "hifi extend misc support"
    default n
    help
        hifi extend misc.
source "platform_source/audio/drivers/hifi_dsp/voice_proxy/Kconfig"
endmenu
```

## kernel/platform_source/audio/sound/Kconfig
```kconfig
menu "sound Configuration"

source "platform_source/audio/sound/soc/platforms/Kconfig"
source "platform_source/audio/sound/soc/codecs/Kconfig"
source "platform_source/audio/sound/usb/hifi/Kconfig"
source "platform_source/audio/sound/usb/usbaudio_mailbox/Kconfig"
endmenu
```

## kernel/platform_source/audio/sound/soc/codecs/Kconfig
```kconfig
config SND_SOC_DA_COMBINE_V3
	tristate "Support Sound SoC DA combine v3 Codec"
	depends on DA_COMBINE_V3_CODEC

config SND_SOC_DA_COMBINE_V5
	tristate "Support Sound SoC DA combine v5 Codec"


config SND_SOC_DP_AUDIO
	tristate "Support Sound SoC DP audio"

# Supported au pa
source "platform_source/audio/sound/soc/codecs/vendor/au_pa/Kconfig"

config SND_SOC_CODEC_DA_SEPARATE_V2
	tristate "Soc Smartstar Codec DA separate v2 support"

config SND_SOC_CODEC_DEBUG
	bool "Codec debug support"

config SND_SOC_ASP_CODEC
	tristate "Soc Smartstar asp codec"

config SND_SOC_ASP_CODEC_CODECLESS
	tristate "Soc Smartstar asp codec for codecless support"

config SND_SOC_ASP_CODEC_ANA
	tristate "Soc Smartstar asp codec for ana support"

# Support codecless series audio ana codec

# Supported da separate codecs
source "platform_source/audio/sound/soc/codecs/vendor/legacy/da_separate/Kconfig"
```

## kernel/platform_source/audio/sound/soc/platforms/pcm_codec/Kconfig
```kconfig
config SND_SOC_PCM_CODECS
	tristate "SoC Audio support for pcm codec"
	default n

config SND_SOC_CDC_CUSTOM
	tristate "Soc Audio support for cdc custom"
	depends on SND_SOC_PCM_CODECS
	default n

config SND_SOC_ARMPC_CUSTOM
	tristate "Soc Audio support for armpc custom"
	depends on SND_SOC_PCM_CODECS
	default n

config SND_SOC_PCM_AXI2TDM
	tristate "Soc Audio support for pcm axi2tdm"
	depends on SND_SOC_PCM_CODECS
	default n
```

## kernel/platform_source/basicplatform/Kconfig
```kconfig
menu "basicplatform Kernel Configuration"

config VENDOR_CHIP_PREFIX
    string "SOC chip prefix"
    help
        Indicates the chip prefix.

config VENDOR_CHIP_SUFFIX
    string "SOC chip suffix"
    help
        Indicates the chip suffix.

source "platform_source/basicplatform/drivers/Kconfig"
source "platform_source/basicplatform/block/Kconfig"
source "platform_source/basicplatform/fs/Kconfig"
source "platform_source/basicplatform/kernel/Kconfig"
source "platform_source/basicplatform/mm/Kconfig"

endmenu
```

## kernel/platform_source/basicplatform/block/Kconfig
```kconfig
menu "mas_block_Configuration"

config MAS_BLK
	bool "MAS Block feature"
	depends on BLOCK
	default n
	help
		MAS Block feature

config MAS_DEBUG_FS
	bool "mas debug fs"
	depends on MAS_BLK
	default n

config MAS_BKOPS
	bool "MAS BKOPS"
	depends on MAS_BLK
	default n
	help
	MAS BKOPS feature

config MAS_QOS_MQ
	bool "MAS QoS MQ IO scheduler"
	depends on MAS_BLK && HUFS_HC_CORE_UTR
	default n
	help
	MAS QoS MQ IO scheduler

config MAS_STORAGE
	bool "MAS Storage related change"
	default n
	help
		MAS Storage related change of Linux source code

config MAS_BLK_BW_OPTIMIZE
	bool "Enlarge async inflight when dirty page flashing"
	depends on MAS_BLK
	default n

config MMC_BLOCK_IOMMU_64BIT
	bool "Block bounce limit"
	depends on BLOCK
	default n
	help
		Blk-setting will use address >4G for IOMMU.

choice
	prompt "Select IO classify method"
	depends on MAS_BLK

config MAS_IO_CLASSIFY_FG
	bool "use iaware FG classification"
config MAS_IO_CLASSIFY_SCHED_TUNE
	bool "use AI sched tune"
	depends on SCHED_TUNE
endchoice

config MAS_MQ_USING_CP
	bool "MAS UFS Command Priority"
	depends on MAS_BLK
	default n
	help
		MAS UFS Command Priority, good for foreground APP's IO performance

config MAS_MQ_USING_CPP
	bool "MAS UFS Command Priority"
	depends on MAS_BLK && MAS_UNISTORE_PRESERVE && MAS_MQ_USING_CP
	default n
	help
		MAS UFS Command Priority, good for foreground APP's IO performance

config MAS_ORDER_PRESERVE
	bool "MAS UFS Order Preserving"
	depends on MAS_BLK
	default n
	help
		MAS UFS Order Preserving, good for SQL's IO performance

config MAS_UNISTORE_PRESERVE
	bool "MAS BLK Unistorage Preserving"
	depends on MAS_BLK
	default n
	help
		mas unistorage preserving in block layer

config MAS_IO_TRACE
	bool "MAS_IO_TRACE"
	depends on MAS_DEBUG_FS
	default n
	help
		MAS io trace event, as supplement to block_rq_issue and block_rq_complete

config MAS_IO_DEBUG_TRACE
	bool "MAS_IO_DEBUG_TRACE"
	depends on MAS_IO_TRACE
	default n
	help
		MAS io debug trace event

config MAS_HEALTH
	bool "check ufs health"
	depends on MAS_BLK
	default n
	help
		MAS interface for ufs health check

config MAS_UFS_GEAR_CTRL
	bool "MAS UFS gear ctrl"
	depends on MAS_BLK && SCSI_UFS_GEAR_CTRL
	default n
	help
		MAS manual/auto gear ctrl.

config VIRTIO_BLK_COOKIE_FE
	tristate "Virtio block cookie front end"
	depends on VIRTIO_BLK && (SCSI_UFS_INLINE_CRYPTO || MAS_BLK)
	default n
	help
		Virtio block cookie front end.

config VIRTIO_BLK_COOKIE_BE
	tristate "Virtio block cookie back end"
	depends on LIBLINUX
	default n
	help
		Virtio block cookie back end.

config MAS_VIRTIO_BLK_FE
	bool "MAS Virtio Block feature front end"
	depends on VIRTIO_BLK && MAS_BLK
	default n
	help
		MAS Virtio Block feature front end

config MAS_VIRTIO_BLK_BE
	bool "MAS Virtio Block feature back end"
	depends on VIRTIO_BLK_COOKIE_BE
	default n
	help
		MAS Virtio Block feature back end

config MAS_MCQ
	bool "MAS Block feature with Multi-Circular Queue"
	depends on MAS_BLK
	default n
	help
		MAS Block feature with Multi-Circular Queue

config MAS_BLK_HM
	bool "MAS Block HM"
	depends on LIBLINUX
	default n
	help
		MAS Block HM
endmenu
```

## kernel/platform_source/basicplatform/drivers/Kconfig
```kconfig
menu "driver Configuration"

source "platform_source/basicplatform/drivers/spmi_platform/Kconfig"
source "platform_source/basicplatform/drivers/bootdevice/Kconfig"
source "platform_source/basicplatform/drivers/mfd/Kconfig"
source "platform_source/basicplatform/drivers/clk/Kconfig"
source "platform_source/basicplatform/drivers/regulator/Kconfig"
source "platform_source/basicplatform/drivers/gpio/Kconfig"
source "platform_source/basicplatform/drivers/pinctrl/Kconfig"
source "platform_source/basicplatform/drivers/hwspinlock/Kconfig"
source "platform_source/basicplatform/drivers/pwm/Kconfig"
source "platform_source/basicplatform/drivers/rtc/Kconfig"
source "platform_source/basicplatform/drivers/i2c/Kconfig"
source "platform_source/basicplatform/drivers/i3c/Kconfig"
source "platform_source/basicplatform/drivers/cmdline/Kconfig"
source "platform_source/basicplatform/drivers/mailbox/Kconfig"
source "platform_source/basicplatform/drivers/mm_lb/Kconfig"
source "platform_source/basicplatform/drivers/sdcu/Kconfig"
source "platform_source/basicplatform/drivers/modem_decoupl/Kconfig"
source "platform_source/basicplatform/drivers/noc/Kconfig"
source "platform_source/basicplatform/drivers/hisi_dummy_ko/Kconfig"
source "platform_source/basicplatform/drivers/qic/Kconfig"
source "platform_source/basicplatform/drivers/rpmb/Kconfig"
source "platform_source/basicplatform/drivers/usb_phy_chip/Kconfig"
source "platform_source/basicplatform/drivers/phy/Kconfig"
source "platform_source/basicplatform/drivers/hid/Kconfig"
source "platform_source/basicplatform/drivers/usb/Kconfig"
source "platform_source/basicplatform/drivers/secmem/Kconfig"
source "platform_source/basicplatform/drivers/dma-buf/Kconfig"
source "platform_source/basicplatform/drivers/bg_dmabuf_reclaim/Kconfig"
source "platform_source/basicplatform/drivers/memory_dump/Kconfig"
source "platform_source/basicplatform/drivers/watchpoint/Kconfig"
source "platform_source/basicplatform/drivers/mntn/Kconfig"
source "platform_source/basicplatform/drivers/watchdog/Kconfig"
source "platform_source/basicplatform/drivers/dieid/Kconfig"
source "platform_source/basicplatform/drivers/timekeeper/Kconfig"
source "platform_source/basicplatform/drivers/hisi_lmk/Kconfig"
source "platform_source/basicplatform/drivers/hck/Kconfig"
source "platform_source/basicplatform/drivers/dma/Kconfig"
source "platform_source/basicplatform/drivers/spi/Kconfig"
source "platform_source/basicplatform/drivers/fan/Kconfig"
source "platform_source/basicplatform/drivers/tty/serial/Kconfig"
source "platform_source/basicplatform/drivers/pci/Kconfig"
source "platform_source/basicplatform/drivers/leds/Kconfig"
source "platform_source/basicplatform/drivers/switch/Kconfig"
source "platform_source/basicplatform/drivers/input/keyboard/Kconfig"
source "platform_source/basicplatform/drivers/input/misc/Kconfig"
source "platform_source/basicplatform/drivers/bootctrl/Kconfig"
source "platform_source/basicplatform/drivers/nve/Kconfig"
source "platform_source/basicplatform/drivers/partition/Kconfig"
source "platform_source/basicplatform/drivers/spi_nor_agent/Kconfig"
source "platform_source/basicplatform/drivers/power/Kconfig"
source "platform_source/basicplatform/drivers/scsi/ufs/Kconfig"
source "platform_source/basicplatform/drivers/mmc/Kconfig"
source "platform_source/basicplatform/drivers/hitest/Kconfig"
source "platform_source/basicplatform/drivers/block/Kconfig"
source "platform_source/basicplatform/drivers/boardid/Kconfig"
source "platform_source/basicplatform/drivers/hp_ohos/Kconfig"
source "platform_source/basicplatform/drivers/tcp/Kconfig"
if ETHERNET
source "platform_source/basicplatform/drivers/net/ethernet/hisi/Kconfig"
endif
source "platform_source/basicplatform/drivers/net/phy/Kconfig"
source "platform_source/basicplatform/drivers/hw_info/Kconfig"
source "platform_source/basicplatform/drivers/soc_pg_feature_modem/Kconfig"
source "platform_source/basicplatform/drivers/ata/Kconfig"
source "platform_source/basicplatform/drivers/hsdt_bus/Kconfig"
endmenu
```

## kernel/platform_source/basicplatform/drivers/ata/Kconfig
```kconfig
# SPDX-License-Identifier: GPL-2.0

config VENDOR_SATA
    bool "Enable sata driver for 10cc controller"
    depends on SATA_AHCI
    default n
    help
          If you say yes here, the 10cc controller driver will be enabled

config VENDOR_SATA_ANTLIA
    bool "Enable sata antlia driver"
    depends on VENDOR_SATA
    default n
    help
          If you say yes here, the 10cc controller driver will be enabled
```

## kernel/platform_source/basicplatform/drivers/bg_dmabuf_reclaim/Kconfig
```kconfig
config BG_DMABUF_RECLAIM
    bool "background application dmabuf reclaim"
    depends on ION_SYSTEM_HEAP
    help
      Choose this option to enable the Background Application
      Dmabuf Reclaim of System Heap. Reclaiming and restoring
      the buffer are initiated by the caller, so the content
      of the buffer is also saved or restored by the caller.

config BG_DMABUF_TEST
    bool "background application dmabuf manager test"
    depends on BG_DMABUF_RECLAIM
    help
      Choose this option to enable the Background Application
      Dmabuf test program. This program needs to be used with
      the hal layer code.

config BG_DMABUF_DROP_CACHE
    bool "bg dmabuf alloc speedup by drop cache"
    depends on BG_DMABUF_RECLAIM
    help
      Choose this option to enable bg dmabuf memory alloc speedup
      feature when memory is low or ion_cache is zero. Currently,
      no specific performance problem is encountered, Therefore,
      this feature is disabled first.
```
