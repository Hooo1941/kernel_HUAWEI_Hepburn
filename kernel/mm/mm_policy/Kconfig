## kernel/platform_source/basicplatform/drivers/block/Kconfig
```kconfig
config BLK_DEV_RAM_EMULATION
	bool "Support EMU RAM block devices"
	depends on BLK_DEV_RAM && DFX_DEBUG_FS
	default n
	help
	  Support create a emulator ram filesystem.
```

## kernel/platform_source/basicplatform/drivers/boardid/Kconfig
```kconfig
config SOFTWARE_BOARDID
	bool "Support Platform BOARDID driver"
	default n
	help
	Say yes here if you want to use platform boardid
```

## kernel/platform_source/basicplatform/drivers/dma-buf/Kconfig
```kconfig
source "platform_source/basicplatform/drivers/dma-buf/heaps/Kconfig"
source "platform_source/basicplatform/drivers/dma-buf/mm/Kconfig"
```

## kernel/platform_source/basicplatform/drivers/dma-buf/heaps/Kconfig
```kconfig
config DMABUF_HEAPS_SECSG
	bool "DMA-BUF Secsg Heap"
	depends on DMABUF_HEAPS
	select DMABUF_MM
	help
	  Choose this option to enable the secsg dmabuf heap. The secsg heap
	  can init many heaps and is backed by cma allocate. If in doubt, say Y.

config DMABUF_HEAPS_SECCG
	bool "DMA-BUF Seccg Heap"
	depends on DMABUF_HEAPS
	select DMABUF_MM
	help
	  Choose this option to enable the seccg dmabuf heap. The seccg heap
	  can init many heaps and is backed by cma allocate. If in doubt, say Y.

config DMABUF_HEAPS_CPA
	bool "DMA-BUF CPA Heap"
	depends on DMABUF_HEAPS
	select DMABUF_MM
	help
	  Choose this option to enable the cpa dmabuf heap. The cpa heap
	  is backed by pages from the buddy allocator. If in doubt, say Y.

config DMABUF_HEAPS_DMA_POOL
	bool "DMA-BUF DMA POOL Heap"
	depends on DMABUF_HEAPS
	select DMABUF_MM
	help
	  Choose this option to enable the dma_pool dmabuf heap. The dma_pool heap
	  is backed by pages from the cma allocator. If in doubt, say Y.

config DMABUF_HEAPS_CARVEOUT
	bool "DMA-BUF CARVEOUT Heap"
	depends on DMABUF_HEAPS
	select DMABUF_MM
	help
	  Choose this option to enable the carveout dmabuf heap. The carveout heap
	  is backed by pages from the reserved memory. If in doubt, say Y.
```

## kernel/platform_source/basicplatform/drivers/dma-buf/mm/Kconfig
```kconfig
config MM_DMA_HEAP_FLUSH_CACHE_ALL
	bool "Enable flush all cpu cache when alloc mm dma-heap memory"
	depends on DMABUF_HEAPS
	help
	  When alloc from mm dma-heap memory, flush all cpu caches regardless of cpu-idle status.
```

## kernel/platform_source/basicplatform/drivers/fan/Kconfig
```kconfig
# SPDX-License-Identifier: GPL-2.0

config FAN_CTRL
	tristate "fan ctrl support"
	default n
	help
	  Support the fan for some devices.
```
